#include "GitCheckoutMac.h"
#include "GitWorkMac.h"
#include "GitGraph.h"
#include <Errors.h>
#include <Script.h>
#include <stdlib.h>
#include <string.h>
#include <stdio.h>

/* All private files/directories are retained. No recursive deletion and no
   age-based ownership. A complete area is sealed before intent publication. */
typedef struct {
    long ready, backup;
    GFCatalog oldFile, newFile;
} GXFile;
typedef struct {
    char *path;
    int original;
    long slot;
    GFCatalog catalog;
} GXDirectory;
struct GXState {
    unsigned char binding[32];
    GFCatalog root, database, storage, area;
    GCTransaction plan;
    GXFile *files;
    GXDirectory *directories;
    size_t directoryCount;
    const GQPlan *candidate;
    const GFInventory *inventory;
    int starting, handedLease;
};
static GBWord GXWord(const unsigned char *p) {
    return ((GBWord)p[0] << 24) | ((GBWord)p[1] << 16) | ((GBWord)p[2] << 8) | p[3];
}
static void GXPut(unsigned char *p, GBWord v) {
    p[0] = (unsigned char)(v >> 24);
    p[1] = (unsigned char)(v >> 16);
    p[2] = (unsigned char)(v >> 8);
    p[3] = (unsigned char)v;
}
static void GXHash(const void *p, size_t n, unsigned char out[20]) {
    GBSHA1 h;
    GBSHA1Start(&h);
    GBSHA1Update(&h, p, n);
    GBSHA1Finish(&h, out);
}
static int GXError(GXCheckout *x, OSErr e) {
    x->lastError = e;
    return e == fnfErr || e == dirNFErr ? GS_NOT_FOUND : e == dupFNErr ? GS_CONFLICT : GS_IO;
}
static int GXPoint(GXCheckout *x, const char *name) {
    return x->checkpoint ? x->checkpoint(x->checkpointContext, name) : 0;
}
static void GXName(const char *s, Str31 p) {
    size_t n = strlen(s);
    p[0] = (unsigned char)n;
    memcpy(p + 1, s, n);
}
static const char *GXLeaf(const char *p) {
    const char *q = strrchr(p, ':');
    return q ? q + 1 : p;
}
/* Compare native COMPONENTS with the destination's File Manager collation.
   Full paths may exceed Str31; '/' is an ordinary native leaf character.
   1=same path, 2=a is parent of b, 3=b is parent of a, 0=unrelated/invalid. */
static int GXPathRelation(const char *a, const char *b) {
    const char *ae, *be;
    char x[32], y[32];
    size_t n, m;
    if (!a || !b || !*a || !*b)
        return 0;
    for (;;) {
        ae = strchr(a, ':');
        be = strchr(b, ':');
        if (!ae)
            ae = a + strlen(a);
        if (!be)
            be = b + strlen(b);
        n = (size_t)(ae - a);
        m = (size_t)(be - b);
        if (!n || n > 31 || !m || m > 31)
            return 0;
        memcpy(x, a, n);
        x[n] = 0;
        memcpy(y, b, m);
        y[m] = 0;
        if (!GWMacNameEqual(NULL, x, y))
            return 0;
        if (!*ae && !*be)
            return 1;
        if (!*ae)
            return 2;
        if (!*be)
            return 3;
        a = ae + 1;
        b = be + 1;
    }
}
static size_t GXPathDepth(const char *p) {
    size_t n = 1;
    for (; *p; ++p)
        if (*p == ':')
            ++n;
    return n;
}
static int GXSpec(GXCheckout *x, long parent, const char *name, FSSpec *spec, int *exists) {
    Str31 p;
    OSErr e;
    if (!name || !*name || strlen(name) > 31 || strchr(name, ':'))
        return GB_BAD;
    GXName(name, p);
    e = FSMakeFSSpec(x->store.volume, parent, p, spec);
    *exists = e == noErr;
    return !e || e == fnfErr ? 0 : GXError(x, e);
}
static int GXCreateDir(GXCheckout *x, long parent, const char *name, GFCatalog *out) {
    FSSpec spec;
    Str31 p;
    long id;
    int exists, result = GXSpec(x, parent, name, &spec, &exists);
    OSErr e;
    if (result || exists)
        return result ? result : GS_CONFLICT;
    GXName(name, p);
    e = DirCreate(x->store.volume, parent, p, &id);
    if (e)
        return GXError(x, e);
    result = GFDirectoryAt(x->store.volume, id, out, &x->lastError);
    if (!result && (out->spec.parID != parent || out->id != id))
        result = GS_CONFLICT;
    return result;
}
static int GXUnique(GXCheckout *x, long parent, const char *prefix, GFCatalog *out) {
    static unsigned long serial;
    char name[32];
    FSSpec spec;
    int result, exists;
    unsigned long i;
    for (i = 0; i < 4096; ++i) {
        sprintf(name, "%s%08lx", prefix, serial++);
        result = GXSpec(x, parent, name, &spec, &exists);
        if (result)
            return result;
        if (!exists) {
            result = GXCreateDir(x, parent, name, out);
            if (result != GS_CONFLICT)
                return result;
        }
    }
    return GS_CONFLICT;
}
static int GXAreaIO(GXCheckout *x, long area, const char *key, unsigned char **p, size_t *n,
                    const void *bytes, size_t length, int write) {
    GSMacStore child = x->store;
    GSRepository r = x->raw;
    child.directory = area;
    r.context = &child;
    if (write)
        return r.replace(r.context, key, NULL, 0, bytes, length);
    return r.read(r.context, key, p, n);
}
static int GXMark(GXCheckout *x, long area, const char *key, const void *p, size_t n) {
    unsigned char *old = NULL;
    size_t size = 0;
    int result = GXAreaIO(x, area, key, &old, &size, NULL, 0, 0);
    if (!result)
        result = size == n && !memcmp(old, p, n) ? 0 : GS_CONFLICT;
    else if (result == GS_NOT_FOUND)
        result = GXAreaIO(x, area, key, NULL, NULL, p, n, 1);
    free(old);
    return result;
}
static int GXFlush(GXCheckout *x, const char *point) {
    OSErr e = FlushVol(NULL, x->store.volume);
    return e ? GXError(x, e) : GXPoint(x, point);
}
/* Directory catalog metadata is compared without modification time/child count:
   our own child moves legitimately change those two fields. Full IDs, Finder
   fields, creation/backup dates and attributes remain guarded. */
static int GXDirSame(const GFCatalog *a, const GFCatalog *b) {
    return a->id == b->id && a->attributes == b->attributes && a->created == b->created &&
           a->backup == b->backup && !memcmp(a->finderInfo, b->finderInfo, 32);
}
static int GXAreaValid(GXCheckout *x) {
    GXState *s = x->state;
    GFCatalog area, storage, database;
    int result = GFDirectoryAt(x->store.volume, s->area.id, &area, &x->lastError);
    if (!result)
        result = GFDirectoryAt(x->store.volume, s->storage.id, &storage, &x->lastError);
    if (!result)
        result = GFDirectoryAt(x->store.volume, s->database.id, &database, &x->lastError);
    if (!result &&
        (area.spec.parID != storage.id || storage.spec.parID != database.id ||
         database.spec.parID != x->root.directory || area.created != s->area.created ||
         storage.created != s->storage.created || database.created != s->database.created ||
         area.spec.name[0] != 29 || memcmp(area.spec.name + 1, s->plan.token, 29) ||
         storage.spec.name[0] != 15 || memcmp(storage.spec.name + 1, "checkout-native", 15) ||
         database.spec.name[0] != 4 || memcmp(database.spec.name + 1, ".git", 4)))
        result = GS_CONFLICT;
    return result;
}
static int GXSlot(GXCheckout *x, long id, GFCatalog *out) {
    int result = GXAreaValid(x);
    if (!result)
        result = GFDirectoryAt(x->store.volume, id, out, &x->lastError);
    if (!result && (out->spec.parID != x->state->area.id || !(out->attributes & 16)))
        result = GS_CONFLICT;
    return result;
}
/* Empty-only atomic relocation; unknown children are never deleted. If a peer
   inserts a child in the narrow catalog-call window, restore the directory to
   its original parent when possible and report conflict. */
static int GXMoveDirectory(GXCheckout *x, const GFCatalog *expected, long parent) {
    GFCatalog before, after;
    FSSpec target;
    CMovePBRec pb;
    int result;
    OSErr e;
    result = GFDirectoryAt(x->store.volume, expected->id, &before, &x->lastError);
    if (!result && (!GXDirSame(&before, expected) || before.spec.parID != expected->spec.parID ||
                    before.children))
        result = GS_CONFLICT;
    if (!result) {
        e = FSMakeFSSpec(x->store.volume, parent, before.spec.name, &target);
        result = e == fnfErr ? 0 : !e ? GS_CONFLICT : GXError(x, e);
    }
    if (result)
        return result;
    memset(&pb, 0, sizeof(pb));
    pb.ioVRefNum = x->store.volume;
    pb.ioDirID = before.spec.parID;
    pb.ioNamePtr = before.spec.name;
    pb.ioNewDirID = parent;
    e = PBCatMoveSync(&pb);
    if (e)
        return GXError(x, e);
    result = GFDirectoryAt(x->store.volume, before.id, &after, &x->lastError);
    if (!result && (!GXDirSame(&before, &after) || after.spec.parID != parent))
        result = GS_CONFLICT;
    if (!result && after.children) {
        memset(&pb, 0, sizeof(pb));
        pb.ioVRefNum = x->store.volume;
        pb.ioDirID = parent;
        pb.ioNamePtr = after.spec.name;
        pb.ioNewDirID = before.spec.parID;
        /* Never overwrite a new occupant at the original location. */
        e = PBCatMoveSync(&pb);
        if (e)
            x->lastError = e;
        result = GS_CONFLICT;
    }
    e = FlushVol(NULL, x->store.volume);
    if (!result && e)
        result = GXError(x, e);
    if (!result)
        result = GXPoint(x, "directory-move");
    return result;
}
static void GXClearPlan(GXState *s) {
    size_t i;
    GCFree(&s->plan);
    free(s->files);
    s->files = NULL;
    for (i = 0; i < s->directoryCount; ++i)
        free(s->directories[i].path);
    free(s->directories);
    s->directories = NULL;
    s->directoryCount = 0;
    memset(&s->area, 0, sizeof(s->area));
}
void GXInit(GXCheckout *x) {
    memset(x, 0, sizeof(*x));
    GFLockInit(&x->held);
}
int GXClose(GXCheckout *x) {
    int result;
    if (!x)
        return GB_BAD;
    result = GFUnlockFile(&x->held, &x->lastError);
    if (!result && x->store.leaseHeld)
        result = GSMacLeave(&x->store);
    if (result)
        return result;
    if (x->state) {
        GXClearPlan(x->state);
        free(x->state);
    }
    GXInit(x);
    return 0;
}
int GXAttach(GXCheckout *x, const FSSpec *folder) {
    GSRepository unused;
    FSSpec database;
    Str31 name;
    int result;
    OSErr e;
    if (!x || !folder || x->state || x->store.leaseHeld || x->held.haveData || x->held.haveResource)
        return GB_BAD;
    result = GSMacAttach(&unused, &x->root, folder, 0);
    if (result)
        return result;
    GXName(".git", name);
    e = FSMakeFSSpec(x->root.volume, x->root.directory, name, &database);
    if (e)
        return GXError(x, e);
    result = GSMacAttach(&x->raw, &x->store, &database, 0);
    if (result)
        return result;
    x->state = (GXState *)calloc(1, sizeof(*x->state));
    if (!x->state)
        return GB_MEMORY;
    GCInit(&x->state->plan);
    return 0;
}
/* Binding survives volume-reference reassignment and root renaming. It binds
   HFS initialization/signature and catalog IDs/creation dates of root/.git/area.
   NULL storage uses a distinct domain for read-only repository/list binding;
   existing native-area bindings keep exactly their original wire identity.
   It detects accidental relocation, not a malicious cloned filesystem. */
static int GXBinding(GXCheckout *x, const GFCatalog *storage, unsigned char binding[32]) {
    HParamBlockRec pb;
    unsigned char bytes[44], digest[20];
    GXState *s = x->state;
    int result;
    OSErr e;
    result = GFDirectoryAt(x->root.volume, x->root.directory, &s->root, &x->lastError);
    if (!result)
        result = GFDirectoryAt(x->store.volume, x->store.directory, &s->database, &x->lastError);
    if (result)
        return result;
    if (x->root.volume != x->store.volume || s->database.spec.parID != s->root.id ||
        (storage && storage->spec.parID != s->database.id))
        return GS_CONFLICT;
    memset(&pb, 0, sizeof(pb));
    pb.volumeParam.ioVRefNum = x->store.volume;
    e = PBHGetVInfoSync(&pb);
    if (e)
        return GXError(x, e);
    memset(bytes, 0, sizeof(bytes));
    memcpy(bytes, storage ? "GXBOUND1" : "GXREPO01", 8);
    GXPut(bytes + 8, (GBWord)pb.volumeParam.ioVCrDate);
    GXPut(bytes + 12, (GBWord)(unsigned short)pb.volumeParam.ioVSigWord);
    GXPut(bytes + 16, (GBWord)s->root.id);
    GXPut(bytes + 20, s->root.created);
    GXPut(bytes + 24, (GBWord)s->database.id);
    GXPut(bytes + 28, s->database.created);
    if(storage){GXPut(bytes + 32, (GBWord)storage->id);GXPut(bytes + 36, storage->created);}
    GXHash(bytes, sizeof(bytes), binding);
    bytes[40] = 1;
    GXHash(bytes, sizeof(bytes), digest);
    memcpy(binding + 20, digest, 12);
    return 0;
}
static int GXStorage(GXCheckout *x, int create) {
    GXState *s = x->state;
    GFCatalog storage;
    FSSpec spec;
    Str31 name;
    unsigned char binding[32], *p = NULL;
    size_t n = 0;
    int result, exists;
    OSErr e;
    result = GXSpec(x, x->store.directory, "checkout-native", &spec, &exists);
    if (result)
        return result;
    if (exists) {
        result = GFCatalogRead(&spec, &storage, &x->lastError);
        if (!result && !(storage.attributes & 16))
            result = GS_CONFLICT;
        if (!result)
            result = GXBinding(x, &storage, binding);
        if (!result)
            result = GXAreaIO(x, storage.id, "identity", &p, &n, NULL, 0, 0);
        if (!result && (n != 32 || memcmp(p, binding, 32)))
            result = GS_CONFLICT;
        free(p);
    } else {
        if (!create)
            return GS_NOT_FOUND;
        result = GXUnique(x, x->store.directory, ".gxn", &storage);
        if (!result)
            result = GXBinding(x, &storage, binding);
        if (!result)
            result = GXMark(x, storage.id, "identity", binding, 32);
        if (!result)
            result = GXFlush(x, "storage-sealed");
        if (!result) {
            GXName("checkout-native", name);
            e = FSpRename(&storage.spec, name);
            if (e)
                result = GXError(x, e);
        }
        if (!result)
            result = GFDirectoryAt(x->store.volume, storage.id, &storage, &x->lastError);
        if (!result)
            result = GXFlush(x, "storage-published");
    }
    if (!result) {
        s->storage = storage;
        memcpy(s->binding, binding, 32);
    }
    return result;
}

/* Catalog wire record: portable big-endian fields, never a native FSSpec dump.
   The parent/name are supplied by the sealed plan/slot; IDs are authoritative. */
#define GX_CAT_SIZE 68
static void GXCatPut(unsigned char *p, const GFCatalog *c) {
    GXPut(p, (GBWord)c->id);
    GXPut(p + 4, c->attributes);
    GXPut(p + 8, c->created);
    GXPut(p + 12, c->modified);
    GXPut(p + 16, c->backup);
    GXPut(p + 20, c->dataLength);
    GXPut(p + 24, c->resourceLength);
    GXPut(p + 28, c->children);
    memcpy(p + 32, c->finderInfo, 32);
    GXPut(p + 64, (GBWord)c->spec.parID);
}
static int GXCatGet(const unsigned char *p, GFCatalog *c) {
    memset(c, 0, sizeof(*c));
    if (GXWord(p + 4) > 255 || GXWord(p + 28) > 65535)
        return GS_FORMAT;
    c->id = (long)GXWord(p);
    c->attributes = (unsigned char)GXWord(p + 4);
    c->created = GXWord(p + 8);
    c->modified = GXWord(p + 12);
    c->backup = GXWord(p + 16);
    c->dataLength = GXWord(p + 20);
    c->resourceLength = GXWord(p + 24);
    c->children = (unsigned short)GXWord(p + 28);
    memcpy(c->finderInfo, p + 32, 32);
    c->spec.parID = (long)GXWord(p + 64);
    return 0;
}
static int GXSeal(GXCheckout *x) {
    GXState *s = x->state;
    unsigned char *plan = NULL, *p = NULL;
    size_t pn = 0, n, i, at;
    int result = GCEncode(&s->plan, GWMacNameEqual, NULL, &plan, &pn);
    if (result)
        return result;
    n = 56 + pn + s->plan.fileCount * (8 + 2 * GX_CAT_SIZE) + 20;
    for (i = 0; i < s->directoryCount; ++i) {
        size_t add = 12 + GX_CAT_SIZE + strlen(s->directories[i].path);
        if (n > (size_t)-1 - add) {
            free(plan);
            return GB_SPACE;
        }
        n += add;
    }
    p = (unsigned char *)malloc(n);
    if (!p) {
        free(plan);
        return GB_MEMORY;
    }
    memcpy(p, "GXAREA01", 8);
    memcpy(p + 8, s->binding, 32);
    GXPut(p + 40, (GBWord)s->area.id);
    GXPut(p + 44, (GBWord)pn);
    GXPut(p + 48, (GBWord)s->plan.fileCount);
    GXPut(p + 52, (GBWord)s->directoryCount);
    memcpy(p + 56, plan, pn);
    at = 56 + pn;
    for (i = 0; i < s->plan.fileCount; ++i) {
        GXFile *f = s->files + i;
        GXPut(p + at, (GBWord)f->ready);
        GXPut(p + at + 4, (GBWord)f->backup);
        GXCatPut(p + at + 8, &f->oldFile);
        GXCatPut(p + at + 8 + GX_CAT_SIZE, &f->newFile);
        at += 8 + 2 * GX_CAT_SIZE;
    }
    for (i = 0; i < s->directoryCount; ++i) {
        GXDirectory *d = s->directories + i;
        size_t length = strlen(d->path);
        GXPut(p + at, (GBWord)length);
        GXPut(p + at + 4, (GBWord)d->original);
        GXPut(p + at + 8, (GBWord)d->slot);
        GXCatPut(p + at + 12, &d->catalog);
        at += 12 + GX_CAT_SIZE;
        memcpy(p + at, d->path, length);
        at += length;
    }
    GXHash(p, at, p + at);
    result = GXMark(x, s->area.id, "manifest", p, n);
    free(plan);
    free(p);
    return result;
}
static int GXLoad(GXCheckout *x, const char *token) {
    GXState *s = x->state;
    GFCatalog area;
    unsigned char *p = NULL, digest[20];
    FSSpec spec;
    size_t n = 0, pn, count, dirs, at, i;
    int result, exists;
    result = GXSpec(x, s->storage.id, token, &spec, &exists);
    if (!result && !exists)
        result = GS_NOT_FOUND;
    if (!result)
        result = GFCatalogRead(&spec, &area, &x->lastError);
    if (!result && !(area.attributes & 16))
        result = GS_CONFLICT;
    if (!result)
        result = GXAreaIO(x, area.id, "manifest", &p, &n, NULL, 0, 0);
    if (result) {
        free(p);
        return result;
    }
    if (n < 76 || memcmp(p, "GXAREA01", 8))
        result = GS_FORMAT;
    if (!result) {
        GXHash(p, n - 20, digest);
        if (memcmp(digest, p + n - 20, 20))
            result = GB_CHECKSUM;
        else if (memcmp(p + 8, s->binding, 32) || GXWord(p + 40) != (GBWord)area.id)
            result = GS_CONFLICT;
    }
    if (result) {
        free(p);
        return result;
    }
    pn = (size_t)GXWord(p + 44);
    count = (size_t)GXWord(p + 48);
    dirs = (size_t)GXWord(p + 52);
    if (pn > n - 76 || count > (n - 76 - pn) / (8 + 2 * GX_CAT_SIZE) ||
        dirs > (n - 76 - pn - count * (8 + 2 * GX_CAT_SIZE)) / (13 + GX_CAT_SIZE)) {
        free(p);
        return GS_FORMAT;
    }
    GXClearPlan(s);
    s->area = area;
    result = GCParse(p + 56, pn, GWMacNameEqual, NULL, &s->plan);
    if (!result &&
        (strcmp(s->plan.token, token) || s->plan.phase != GC_PREPARE || s->plan.fileCount != count))
        result = GS_FORMAT;
    if (!result && count) {
        s->files = (GXFile *)calloc(count, sizeof(*s->files));
        if (!s->files)
            result = GB_MEMORY;
    }
    if (!result && dirs) {
        s->directories = (GXDirectory *)calloc(dirs, sizeof(*s->directories));
        if (!s->directories)
            result = GB_MEMORY;
    }
    at = 56 + pn;
    for (i = 0; !result && i < count; ++i) {
        GXFile *f = s->files + i;
        f->ready = (long)GXWord(p + at);
        f->backup = (long)GXWord(p + at + 4);
        result = GXCatGet(p + at + 8, &f->oldFile);
        if (!result)
            result = GXCatGet(p + at + 8 + GX_CAT_SIZE, &f->newFile);
        at += 8 + 2 * GX_CAT_SIZE;
    }
    for (i = 0; !result && i < dirs; ++i) {
        GXDirectory *d = s->directories + i;
        size_t length;
        if (at > n - 20 || n - 20 - at < 12 + GX_CAT_SIZE) {
            result = GS_FORMAT;
            break;
        }
        length = (size_t)GXWord(p + at);
        d->original = (int)GXWord(p + at + 4);
        d->slot = (long)GXWord(p + at + 8);
        result = GXCatGet(p + at + 12, &d->catalog);
        at += 12 + GX_CAT_SIZE;
        if (!result && (!length || length > n - 20 - at || (d->original != 0 && d->original != 1) ||
                        !(d->catalog.attributes & 16)))
            result = GS_FORMAT;
        if (!result) {
            d->path = (char *)malloc(length + 1);
            if (!d->path)
                result = GB_MEMORY;
            else {
                memcpy(d->path, p + at, length);
                d->path[length] = 0;
                if (memchr(d->path, 0, length))
                    result = GS_FORMAT;
                ++s->directoryCount;
            }
        }
        at += length;
    }
    if (!result && at != n - 20)
        result = GS_FORMAT;
    free(p);
    if (result)
        GXClearPlan(s);
    return result;
}
static int GXAddDirectory(GXCheckout *x, const char *path, const GFCatalog *original) {
    GXState *s = x->state;
    GXDirectory *grown, *d;
    GFCatalog slot;
    size_t i, n = strlen(path);
    char name[32];
    int result;
    for (i = 0; i < s->directoryCount; ++i)
        if (GXPathRelation(s->directories[i].path, path) == 1)
            return 0;
    if (s->directoryCount >= (size_t)-1 / sizeof(*grown))
        return GB_SPACE;
    grown = (GXDirectory *)realloc(s->directories, (s->directoryCount + 1) * sizeof(*grown));
    if (!grown)
        return GB_MEMORY;
    s->directories = grown;
    d = grown + s->directoryCount;
    memset(d, 0, sizeof(*d));
    d->path = (char *)malloc(n + 1);
    if (!d->path)
        return GB_MEMORY;
    memcpy(d->path, path, n + 1);
    ++s->directoryCount;
    sprintf(name, "d%08lx", (unsigned long)(s->directoryCount - 1));
    result = GXCreateDir(x, s->area.id, name, &slot);
    if (result)
        return result;
    d->slot = slot.id;
    d->original = original != NULL;
    if (original)
        d->catalog = *original;
    else
        result = GXCreateDir(x, slot.id, GXLeaf(path), &d->catalog);
    return result;
}
static int GXBlob(GXCheckout *x, const unsigned char oid[20], unsigned char **p, size_t *n) {
    char type[7];
    int result = GSGetObject(&x->raw, oid, type, p, n);
    return result ? result : strcmp(type, "blob") ? GS_FORMAT : 0;
}
static int GXWriteFork(GXCheckout *x, short ref, const unsigned char *bytes, size_t n) {
    size_t done = 0;
    long count;
    OSErr e = noErr;
    if (n > 0x7fffffffUL)
        return GB_SPACE;
    while (!e && done < n) {
        count = (long)(n - done > 32768 ? 32768 : n - done);
        e = FSWrite(ref, &count, bytes + done);
        if (count > 0 && (size_t)count <= n - done)
            done += (size_t)count;
        else if (!e)
            e = ioErr;
    }
    if (!e)
        e = SetEOF(ref, (long)n);
    return e ? GXError(x, e) : 0;
}
static int GXFileSame(const GFCatalog *a, const GFCatalog *b) {
    return a->id == b->id && (a->attributes & ~0x8cU) == (b->attributes & ~0x8cU) &&
           a->created == b->created && a->modified == b->modified && a->backup == b->backup &&
           a->dataLength == b->dataLength && a->resourceLength == b->resourceLength &&
           !memcmp(a->finderInfo, b->finderInfo, 32);
}
/* Both forks are fully prepared/checked in an unpublished private area. No
   working-file publication occurs until the complete manifest and intent exist. */
static int GXPrepareFile(GXCheckout *x, size_t i) {
    GXState *s = x->state;
    const GCOperation *o = s->plan.files + i;
    unsigned char *data = NULL, *metadata = NULL, info[32], hash[20];
    const unsigned char *resource = NULL;
    size_t n = 0, rn = 0, mn = 0;
    char *logical = NULL,*direct=NULL;
    GPMap map;
    FSSpec spec;
    CInfoPBRec pb;
    GCFile identity;
    size_t j;
    int exists, result;
    OSErr e;
    GPInit(&map);
    result = GXBlob(x, o->newFile.dataOID, &data, &n);
    memcpy(info, o->newFile.finderInfo, 32);
    memset(hash, 0, 20);
    if (!result && memcmp(o->metadataOID, hash, 20)) {
        result = GXBlob(x, o->metadataOID, &metadata, &mn);
        if (!result)
            result = GIMacDecode(metadata, mn, &logical, info, &resource, &rn);
        for (j = 0; !result && j < s->plan.metadataCount; ++j)
            if (!strcmp(s->plan.metadata[j].path, "ghclient-map")) {
                const GCMetadata *m = s->plan.metadata + j;
                if(m->afterPresent)result = GPParse(m->after, m->afterLength, GWMacNameEqual, NULL, &map);
                break;
            }
        if (!result) {
            /* A restored working file may be untracked, use the preserved
               Finder case, or sit below a staged file-shaped map entry.
               Resolve its actual path with the same transition/collision
               policy as inventory; still require exact metadata Git identity. */
            result=GPResolveWork(&map,o->newPath,GWMacNameEqual,NULL,&direct);
            if(!result && strcmp(direct,logical))result=GS_FORMAT;
        }
        info[8] &= (unsigned char)~1U;
        memset(info + 10, 0, 6);
        memset(info + 28, 0, 4);
        if (!result && memcmp(info, o->newFile.finderInfo, 32))
            result = GS_FORMAT;
    }
    if (!result)
        result = GBObjectID("blob", resource, rn, hash);
    if (!result && memcmp(hash, o->newFile.resourceOID, 20))
        result = GS_FORMAT;
    if (!result)
        result = GXSpec(x, s->files[i].ready, GXLeaf(o->newPath), &spec, &exists);
    if (!result && exists)
        result = GS_CONFLICT;
    if (!result) {
        e = FSpCreate(&spec, 'GHCl', 'BINA', smSystemScript);
        if (!e)
            e = FSpOpenDF(&spec, fsWrPerm, &x->held.dataRef);
        if (!e) {
            x->held.haveData = 1;
            e = FSpOpenRF(&spec, fsWrPerm, &x->held.resourceRef);
            if (!e)
                x->held.haveResource = 1;
        }
        if (e)
            result = GXError(x, e);
        if (!result)
            result = GXWriteFork(x, x->held.dataRef, data, n);
        if (!result)
            result = GXWriteFork(x, x->held.resourceRef, resource, rn);
        {
            int closed = GFUnlockFile(&x->held, &x->lastError);
            if (!result)
                result = closed;
        }
        memset(&pb, 0, sizeof(pb));
        pb.hFileInfo.ioVRefNum = spec.vRefNum;
        pb.hFileInfo.ioDirID = spec.parID;
        pb.hFileInfo.ioNamePtr = spec.name;
        if (!result) {
            e = PBGetCatInfoSync(&pb);
            if (e)
                result = GXError(x, e);
        }
        if (!result) {
            memcpy(&pb.hFileInfo.ioFlFndrInfo, info, 16);
            memcpy(&pb.hFileInfo.ioFlXFndrInfo, info + 16, 16);
            pb.hFileInfo.ioDirID = spec.parID;
            e = PBSetCatInfoSync(&pb);
            if (e)
                result = GXError(x, e);
        }
    }
    if (!result)
        result = GFIdentity(&spec, &identity, &s->files[i].newFile, &x->lastError);
    if (!result && !GCFileEqual(&identity, &o->newFile))
        result = GS_CONFLICT;
    free(data);
    free(metadata);
    free(logical);
    free(direct);
    GPFree(&map);
    return result;
}
static int GXBuildArea(GXCheckout *x, const char *token) {
    GXState *s = x->state;
    GCTransaction initial;
    unsigned char *encoded = NULL, *old = NULL;
    size_t length = 0, oldLength = 0, i, j;
    GFCatalog slot, existing, archive;
    FSSpec spec;
    Str31 rename;
    char name[32];
    int result, exists;
    OSErr e;
    /* Retry a failed pre-intent preparation by archiving only a valid owned,
       unstarted area. Completed or unknown directories are never reused. */
    result = GXSpec(x, s->storage.id, token, &spec, &exists);
    if (!result && exists) {
        result = GXLoad(x, token);
        if (!result) {
            int found = GXAreaIO(x, s->area.id, "started", &old, &oldLength, NULL, 0, 0);
            free(old);
            old = NULL;
            if (found != GS_NOT_FOUND)
                result = found ? found : GS_CONFLICT;
        }
        if (!result)
            result = GXUnique(x, s->storage.id, "archive", &archive);
        if (!result) {
            CMovePBRec pb;
            existing = s->area;
            memset(&pb, 0, sizeof(pb));
            pb.ioVRefNum = x->store.volume;
            pb.ioDirID = existing.spec.parID;
            pb.ioNamePtr = existing.spec.name;
            pb.ioNewDirID = archive.id;
            e = PBCatMoveSync(&pb);
            if (e)
                result = GXError(x, e);
        }
        if (!result)
            result = GXFlush(x, "orphan-archived");
    }
    if (result)
        return result;
    GXClearPlan(s);
    initial = s->candidate->transaction;
    initial.generation = (GBWord)strtoul(token, NULL, 16);
    initial.phase = GC_PREPARE;
    initial.rollbackFrom = 0;
    result = GCEncode(&initial, GWMacNameEqual, NULL, &encoded, &length);
    if (!result)
        result = GCParse(encoded, length, GWMacNameEqual, NULL, &s->plan);
    free(encoded);
    if (!result && strcmp(s->plan.token, token))
        result = GS_CONFLICT;
    if (!result)
        result = GXUnique(x, s->storage.id, "pending", &s->area);
    if (!result && s->plan.fileCount) {
        s->files = (GXFile *)calloc(s->plan.fileCount, sizeof(*s->files));
        if (!s->files)
            result = GB_MEMORY;
    }
    for (i = 0; !result && i < s->plan.fileCount; ++i) {
        const GCOperation *o = s->plan.files + i;
        sprintf(name, "r%08lx", (unsigned long)i);
        result = GXCreateDir(x, s->area.id, name, &slot);
        if (!result)
            s->files[i].ready = slot.id;
        sprintf(name, "b%08lx", (unsigned long)i);
        if (!result)
            result = GXCreateDir(x, s->area.id, name, &slot);
        if (!result)
            s->files[i].backup = slot.id;
        if (!result && o->oldFile.present) {
            for (j = 0; j < s->inventory->count; ++j)
                if (GXPathRelation(s->inventory->items[j].native, o->oldPath) == 1)
                    break;
            if (j == s->inventory->count || s->inventory->items[j].file.present != 1 ||
                !GCFileEqual(&s->inventory->items[j].file, &o->oldFile))
                result = GS_CONFLICT;
            else
                s->files[i].oldFile = s->inventory->catalog[j];
        }
        if (!result && o->newFile.present)
            result = GXPrepareFile(x, i);
    }
    for (i = 0; !result && i < s->inventory->count; ++i)
        if (s->inventory->items[i].file.present == 2)
            result = GXAddDirectory(x, s->inventory->items[i].native, s->inventory->catalog + i);
    for (i = 0; !result && i < s->plan.fileCount; ++i) {
        const GCOperation *o = s->plan.files + i;
        const char *p;
        char *prefix;
        if (!o->newFile.present)
            continue;
        prefix = (char *)malloc(strlen(o->newPath) + 1);
        if (!prefix) {
            result = GB_MEMORY;
            break;
        }
        strcpy(prefix, o->newPath);
        for (p = o->newPath; !result && *p; ++p)
            if (*p == ':') {
                size_t at = (size_t)(p - o->newPath);
                prefix[at] = 0;
                result = GXAddDirectory(x, prefix, NULL);
                prefix[at] = ':';
            }
        free(prefix);
    }
    for(i=0;!result && i<s->plan.createdDirectoryCount;++i) {
        const GCDirectory *wanted=s->plan.createdDirectories+i;
        char *prefix=(char *)malloc(strlen(wanted->path)+1);
        size_t at;
        GXDirectory *d=NULL;GFCatalog desired;
        if(!prefix){result=GB_MEMORY;break;}
        strcpy(prefix,wanted->path);
        for(at=0;!result;++at)
            if(!prefix[at] || prefix[at]==':') {
                char last=prefix[at];prefix[at]=0;result=GXAddDirectory(x,prefix,NULL);prefix[at]=last;
                if(!last)break;
            }
        free(prefix);
        for(j=0;!result && j<s->directoryCount;++j)
            if(GXPathRelation(s->directories[j].path,wanted->path)==1){d=s->directories+j;break;}
        if(!result && (!d || d->original))result=GS_CONFLICT;
        if(!result) {
            desired=d->catalog;desired.attributes=wanted->attributes;
            desired.created=wanted->created;desired.modified=wanted->modified;desired.backup=wanted->backup;
            memcpy(desired.finderInfo,wanted->finderInfo,32);
            result=GFDirectoryRestore(&desired,&d->catalog,&x->lastError);
            if(!result)result=GFDirectoryAt(x->store.volume,d->catalog.id,&d->catalog,&x->lastError);
        }
    }
    if (!result)
        result = GXSeal(x);
    if (!result)
        result = GXFlush(x, "area-sealed");
    if (!result) {
        GXName(token, rename);
        e = FSpRename(&s->area.spec, rename);
        if (e)
            result = GXError(x, e);
    }
    if (!result)
        result = GFDirectoryAt(x->store.volume, s->area.id, &s->area, &x->lastError);
    if (!result)
        result = GXFlush(x, "area-published");
    return result;
}

static GXDirectory *GXFindDirectory(GXState *s, const char *path) {
    size_t i;
    for (i = 0; i < s->directoryCount; ++i)
        if (GXPathRelation(s->directories[i].path, path) == 1)
            return s->directories + i;
    return NULL;
}
/* Validate every live parent by ID; an identical-looking replacement folder
   cannot inherit our ownership. This function never creates directories. */
static int GXParents(GXCheckout *x, const char *path, int ensure, long *parent) {
    GXState *s = x->state;
    const char *p;
    char *prefix = (char *)malloc(strlen(path) + 1);
    GFCatalog current, slot;
    FSSpec spec;
    long id;
    int result = 0, kind;
    if (!prefix)
        return GB_MEMORY;
    strcpy(prefix, path);
    *parent = x->root.directory;
    for (p = path; !result && *p; ++p)
        if (*p == ':') {
            size_t at = (size_t)(p - path);
            GXDirectory *d;
            prefix[at] = 0;
            d = GXFindDirectory(s, prefix);
            if (!d) {
                result = GS_CONFLICT;
                break;
            }
            result = GFResolve(&x->root, prefix, &spec, &kind, &id, &x->lastError);
            if (!result && !kind && ensure) {
                result = GXSlot(x, d->slot, &slot);
                if (!result)
                    result = GFDirectoryAt(x->store.volume, d->catalog.id, &current, &x->lastError);
                if (!result && (current.spec.parID != d->slot || !GXDirSame(&current, &d->catalog)))
                    result = GS_CONFLICT;
                if (!result)
                    result = GXMoveDirectory(x, &current, *parent);
                if (!result)
                    result = GFResolve(&x->root, prefix, &spec, &kind, &id, &x->lastError);
            }
            if (!result && kind == 2) {
                result = GFCatalogRead(&spec, &current, &x->lastError);
                if (!result && !GXDirSame(&current, &d->catalog))
                    result = GS_CONFLICT;
                if (!result)
                    *parent = current.id;
            } else if (!result) {
                if (ensure)
                    result = GS_CONFLICT;
                else {
                    *parent = 0;
                    break;
                }
            }
            prefix[at] = ':';
        }
    free(prefix);
    return result;
}
static int GXVacate(GXCheckout *x, const char *path, int allNew) {
    GXState *s = x->state;
    GFCatalog current, slot;
    FSSpec spec;
    size_t max = 0, depth, i;
    long id;
    int kind, result = 0;
    for (i = 0; i < s->directoryCount; ++i)
        if (GXPathDepth(s->directories[i].path) > max)
            max = GXPathDepth(s->directories[i].path);
    /* Child-before-parent, including nested empty original directories. */
    for (depth = max; !result && depth; --depth)
        for (i = 0; !result && i < s->directoryCount; ++i) {
            GXDirectory *d = s->directories + i;
            if (GXPathDepth(d->path) != depth || (allNew && d->original))
                continue;
            if (!allNew) {
                int relation = GXPathRelation(path, d->path);
                if (relation != 1 && relation != 2)
                    continue;
            }
            result = GFResolve(&x->root, d->path, &spec, &kind, &id, &x->lastError);
            if (result || !kind || kind == 1)
                continue;
            result = GFCatalogRead(&spec, &current, &x->lastError);
            if (!result && !GXDirSame(&current, &d->catalog))
                result = GS_CONFLICT;
            if (!result)
                result = GXSlot(x, d->slot, &slot);
            if (!result)
                result = GXMoveDirectory(x, &current, d->slot);
        }
    return result;
}
static int GXRestoreDirectories(GXCheckout *x) {
    GXState *s = x->state;
    size_t max = 0, depth, i;
    int result = GXVacate(x, NULL, 1);
    for (i = 0; i < s->directoryCount; ++i)
        if (GXPathDepth(s->directories[i].path) > max)
            max = GXPathDepth(s->directories[i].path);
    for (depth = 1; !result && depth <= max; ++depth)
        for (i = 0; !result && i < s->directoryCount; ++i) {
            GXDirectory *d = s->directories + i;
            GFCatalog current, slot;
            FSSpec spec;
            long parent, id;
            int kind;
            if (!d->original || GXPathDepth(d->path) != depth)
                continue;
            result = GXParents(x, d->path, 1, &parent);
            if (!result)
                result = GFResolve(&x->root, d->path, &spec, &kind, &id, &x->lastError);
            if (!result && kind == 2) {
                result = GFCatalogRead(&spec, &current, &x->lastError);
                if (!result && !GXDirSame(&current, &d->catalog))
                    result = GS_CONFLICT;
            } else if (!result && !kind) {
                result = GXSlot(x, d->slot, &slot);
                if (!result)
                    result = GFDirectoryAt(x->store.volume, d->catalog.id, &current, &x->lastError);
                if (!result && (current.spec.parID != d->slot || !GXDirSame(&current, &d->catalog)))
                    result = GS_CONFLICT;
                if (!result)
                    result = GXMoveDirectory(x, &current, parent);
            } else if (!result)
                result = GS_CONFLICT;
        }
    return result;
}
static int GXPlanMatch(GXCheckout *x, const GCTransaction *t) {
    GCTransaction copy = *t;
    unsigned char *a = NULL, *b = NULL;
    size_t an = 0, bn = 0;
    int result;
    copy.phase = GC_PREPARE;
    copy.rollbackFrom = 0;
    result = GCEncode(&copy, GWMacNameEqual, NULL, &a, &an);
    if (!result)
        result = GCEncode(&x->state->plan, GWMacNameEqual, NULL, &b, &bn);
    if (!result && (an != bn || memcmp(a, b, an)))
        result = GS_CONFLICT;
    free(a);
    free(b);
    return result;
}
static int GXBegin(void *context, const GCTransaction *t) {
    GXCheckout *x = (GXCheckout *)context;
    int result = GXAreaValid(x);
    if (!result)
        result = GXPlanMatch(x, t);
    if (!result)
        result = GXMark(x, x->state->area.id, "started", t->token, 29);
    return result;
}
static int GXInspect(void *context, const GCTransaction *t, int area, size_t i, const char *path,
                     GCFile *out) {
    GXCheckout *x = (GXCheckout *)context;
    GXState *s = x->state;
    FSSpec spec;
    GFCatalog current, slot;
    GXFile *f;
    long id, parent;
    int result, kind, exists;
    const char *leaf;
    if ((area!=GC_LIVE && i>=s->plan.fileCount) || strcmp(t->token,s->plan.token))
        return GB_BAD;
    result = GXAreaValid(x);
    if (result)
        return result;
    memset(out, 0, sizeof(*out));
    f = i<s->plan.fileCount?s->files+i:NULL;
    if (area == GC_LIVE) {
        result = GXParents(x, path, 0, &parent);
        if (!result)
            result = GFResolve(&x->root, path, &spec, &kind, &id, &x->lastError);
        if (result || !kind)
            return result;
    } else {
        if (area != GC_READY && area != GC_BACKUP)
            return GB_BAD;
        parent = area == GC_READY ? f->ready : f->backup;
        result = GXSlot(x, parent, &slot);
        leaf = area == GC_READY ? t->files[i].newPath : t->files[i].oldPath;
        if (!leaf || !*leaf)
            return result;
        if (!result)
            result = GXSpec(x, parent, GXLeaf(leaf), &spec, &exists);
        if (result || !exists)
            return result;
    }
    result = GFIdentity(&spec, out, &current, &x->lastError);
    if (!result && out->present == 1) {
        const GFCatalog *expected = NULL;
        size_t j;
        if (area == GC_READY)
            expected = &f->newFile;
        else if (area == GC_BACKUP)
            expected = &f->oldFile;
        else
            for (j = 0; j < s->plan.fileCount; ++j) {
                const GCOperation *o = s->plan.files + j;
                if (o->oldPath && GXPathRelation(o->oldPath, path) == 1 &&
                    current.id == s->files[j].oldFile.id)
                    expected = &s->files[j].oldFile;
                if (o->newPath && GXPathRelation(o->newPath, path) == 1 &&
                    current.id == s->files[j].newFile.id)
                    expected = &s->files[j].newFile;
            }
        if (!expected)
            return GS_CONFLICT;
        if (!GXFileSame(expected, &current))
            return GS_CONFLICT;
    } else if (!result && out->present == 2 && area == GC_LIVE) {
        GXDirectory *d = GXFindDirectory(s, path);
        if (!d || !GXDirSame(&d->catalog, &current))
            result = GS_CONFLICT;
    } else if (!result && out->present == 2)
        result = GS_CONFLICT;
    return result;
}
static int GXPrepared(void *context, const GCTransaction *t, size_t i) {
    GCFile f;
    int result = GXInspect(context, t, GC_READY, i, NULL, &f);
    return result ? result : GCFileEqual(&f, &t->files[i].newFile) ? 0 : GS_CONFLICT;
}
static int GXMove(void *context, const GCTransaction *t, size_t i, int from, const char *fromPath,
                  int to, const char *toPath, const GCFile *identity) {
    GXCheckout *x = (GXCheckout *)context;
    GXState *s = x->state;
    GCFile actual;
    GFCatalog current, slot, after;
    FSSpec spec;
    long parent, id;
    int result, kind, exists, closed;
    const char *leaf;
    if (i >= s->plan.fileCount || (from != GC_LIVE && to != GC_LIVE))
        return GB_BAD;
    result = GXInspect(x, t, from, i, fromPath, &actual);
    if (!result && !GCFileEqual(identity, &actual))
        result = GS_CONFLICT;
    if (result)
        return result;
    if (from == GC_LIVE) {
        result = GFResolve(&x->root, fromPath, &spec, &kind, &id, &x->lastError);
    } else {
        parent = from == GC_READY ? s->files[i].ready : s->files[i].backup;
        leaf = from == GC_READY ? t->files[i].newPath : t->files[i].oldPath;
        result = GXSpec(x, parent, GXLeaf(leaf), &spec, &exists);
    }
    current = from == GC_BACKUP || to == GC_BACKUP ? s->files[i].oldFile : s->files[i].newFile;
    current.spec = spec;
    if (!result)
        result = GFLockFile(&spec, identity, &current, &x->held, &x->lastError);
    if (!result && to == GC_LIVE) {
        result = GXVacate(x, toPath, 0);
        if (!result)
            result = GXParents(x, toPath, 1, &parent);
        if (!result && strcmp(GXLeaf(toPath),
                              GXLeaf(from == GC_READY ? t->files[i].newPath : t->files[i].oldPath)))
            result = GS_CONFLICT;
    } else if (!result) {
        parent = to == GC_READY ? s->files[i].ready : s->files[i].backup;
        result = GXSlot(x, parent, &slot);
    }
    if (!result)
        result = GFMoveLocked(&x->held, parent, &after, &x->lastError);
    if (!result)
        result = GXPoint(x, "file-move");
    closed = GFUnlockFile(&x->held, &x->lastError);
    return result ? result : closed;
}
static int GXErase(void *context, const char *key, const void *p, size_t n) {
    GXCheckout *x = (GXCheckout *)context;
    return GSMacErase(&x->store, key, p, n);
}
static int GXFinish(void *context, const GCTransaction *t, int committed) {
    GXCheckout *x = (GXCheckout *)context;
    unsigned char marker[30];
    memcpy(marker, t->token, 29);
    marker[29] = (unsigned char)committed;
    return GXMark(x, x->state->area.id, "finished", marker, sizeof(marker));
}
static int GXDirectories(void *context,const GCTransaction *t,int restore) {
    GXCheckout *x=(GXCheckout *)context;
    GXState *s=x->state;
    size_t i;
    int result=GXAreaValid(x);
    if(!result)result=GXPlanMatch(x,t);
    /* A path witness never substitutes for the original sealed catalog ID. */
    for(i=0;!result && i<t->directoryCount;++i) {
        GXDirectory *d=GXFindDirectory(s,t->directories[i]);
        GFCatalog current,slot;
        FSSpec spec;
        int kind;
        long id;
        if(!d || !d->original){result=GS_CONFLICT;break;}
        result=GFDirectoryAt(x->store.volume,d->catalog.id,&current,&x->lastError);
        if(!result && !GXDirSame(&current,&d->catalog))result=GS_CONFLICT;
        if(!result && current.spec.parID==d->slot)result=GXSlot(x,d->slot,&slot);
        else if(!result) {
            result=GFResolve(&x->root,d->path,&spec,&kind,&id,&x->lastError);
            if(!result && (kind!=2 || id!=d->catalog.id))result=GS_CONFLICT;
        }
    }
    if(!result && restore)result=GXRestoreDirectories(x);
    for(i=0;!result && !restore && i<t->directoryCount;++i)
        result=GXVacate(x,t->directories[i],0);
    if(!result)result=GXFlush(x,restore?"directories-restored":"directories-retained");
    return result;
}
static int GXDirectChild(const char *parent,const char *child) {
    size_t n=strlen(parent);
    return GXPathRelation(parent,child)==2 && !strchr(child+n+1,':');
}
static int GXCreatedDirectories(void *context,const GCTransaction *t,int action) {
    GXCheckout *x=(GXCheckout *)context;GXState *s=x->state;
    size_t i,j,children;int result=GXAreaValid(x),kind;long parent,id;
    GFCatalog current,slot,desired;FSSpec spec;
    if(!result)result=GXPlanMatch(x,t);
    if(!result && action!=GC_DIR_INSTALL && action!=GC_DIR_VERIFY && action!=GC_DIR_UNINSTALL)return GB_BAD;
    if(!result && action==GC_DIR_UNINSTALL) {
        result=GXVacate(x,NULL,1);
        return result?result:GXFlush(x,"created-directories-uninstalled");
    }
    for(i=0;!result && i<t->createdDirectoryCount;++i) {
        const GCDirectory *wanted=t->createdDirectories+i;
        GXDirectory *d=GXFindDirectory(s,wanted->path);
        if(!d || d->original){result=GS_CONFLICT;break;}
        result=GXParents(x,wanted->path,action==GC_DIR_INSTALL,&parent);
        if(!result)result=GFResolve(&x->root,wanted->path,&spec,&kind,&id,&x->lastError);
        if(!result && !kind && action==GC_DIR_INSTALL) {
            result=GXSlot(x,d->slot,&slot);
            if(!result)result=GFDirectoryAt(x->store.volume,d->catalog.id,&current,&x->lastError);
            if(!result && (current.spec.parID!=d->slot || !GXDirSame(&current,&d->catalog)))result=GS_CONFLICT;
            if(!result)result=GXMoveDirectory(x,&current,parent);
            if(!result)result=GFResolve(&x->root,wanted->path,&spec,&kind,&id,&x->lastError);
        }
        if(!result && (kind!=2 || id!=d->catalog.id))result=GS_CONFLICT;
        if(!result)result=GFCatalogRead(&spec,&current,&x->lastError);
        if(!result && !GXDirSame(&current,&d->catalog))result=GS_CONFLICT;
        if(!result && action==GC_DIR_VERIFY) {
            children=0;
            for(j=0;j<t->fileCount;++j)
                if(t->files[j].newPath && GXDirectChild(wanted->path,t->files[j].newPath))++children;
            for(j=0;j<s->directoryCount;++j)
                if(!s->directories[j].original && GXDirectChild(wanted->path,s->directories[j].path))++children;
            if(children!=current.children){result=GS_CONFLICT;break;}
            /* Child installation changes the folder's modification date. */
            desired=current;desired.modified=wanted->modified;
            result=GFDirectoryRestore(&desired,&current,&x->lastError);
            if(!result)result=GXPoint(x,"created-directory-metadata");
        }
    }
    return result?result:GXFlush(x,action==GC_DIR_INSTALL?"created-directories-installed":"created-directories-verified");
}
static int GXEnter(void *context) {
    GXCheckout *x = (GXCheckout *)context;
    if (x->state->handedLease) {
        x->state->handedLease = 0;
        return 0;
    }
    return GSMacEnter(&x->store, 1);
}
static int GXLeave(void *context) {
    GXCheckout *x = (GXCheckout *)context;
    int result = GFUnlockFile(&x->held, &x->lastError);
    return result ? result : GSMacLeave(&x->store);
}
static int GXOwner(void *context, const char *token) {
    GXCheckout *x = (GXCheckout *)context;
    int result = GSMacOwnerToken(&x->store, token);
    if (!result)
        result = x->state->starting ? GXBuildArea(x, token) : GXLoad(x, token);
    return result;
}
static int GXGuard(void *context, const char *key, int action) {
    GXCheckout *x = (GXCheckout *)context;
    return action == GT_VERIFY ? GSMacGuardCheck(&x->store, key)
                               : GSMacGuard(&x->store, key, action == GT_CLAIM);
}
static int GXRead(void *context, const char *key, unsigned char **p, size_t *n) {
    GXCheckout *x = (GXCheckout *)context;
    return x->raw.read(x->raw.context, key, p, n);
}
static int GXReplace(void *context, const char *key, const void *old, size_t on, const void *p,
                     size_t n) {
    GXCheckout *x = (GXCheckout *)context;
    int result = 0;
    if (!strcmp(key, "checkout-journal") && n >= 28 &&
        (!memcmp(p,"GHCO0001",8) || !memcmp(p,"GHCO0002",8) || !memcmp(p,"GHCO0003",8)) &&
        GXWord((const unsigned char *)p + 12) == GC_ROLLED_BACK)
        result = GXRestoreDirectories(x);
    if (!result)
        result = x->raw.replace(x->raw.context, key, old, on, p, n);
    if (!result)
        result = GXPoint(x, key);
    return result;
}
static void GXCallbacks(GXCheckout *x, GSRepository *r, GCBackend *b, GTControl *c) {
    memset(b, 0, sizeof(*b));
    memset(c, 0, sizeof(*c));
    r->context = x;
    r->read = GXRead;
    r->replace = GXReplace;
    b->context = x;
    b->begin = GXBegin;
    b->inspect = GXInspect;
    b->prepare = GXPrepared;
    b->move = GXMove;
    b->erase = GXErase;
    b->finish = GXFinish;
    b->directories = GXDirectories;
    b->createdDirectories = GXCreatedDirectories;
    c->context = x;
    c->enter = GXEnter;
    c->leave = GXLeave;
    c->owner = GXOwner;
    c->guard = GXGuard;
}
static int GXGraphRead(void *context, const char *key, unsigned char **p, size_t *n) {
    return GSMacReadLimit((GSMacStore *)context, key, p, n,
                         !strncmp(key, "objects/", 8) ? 3UL * 1024 * 1024 : 2048);
}
static int GXGraphProgress(void *context, size_t count) {
    (void)count;
    return GXPoint((GXCheckout *)context, "check ancestry");
}
static int GXForwardPolicy(GXCheckout *x, const char *branch, const unsigned char *expectedTip,
                            const unsigned char *targetTip, int *advance) {
    GSRepository reader = x->raw;
    GVLimits limits;
    char *current = NULL;
    unsigned char tip[20];
    int result, found = 0;
    *advance = 0;
    reader.context = &x->store; reader.read = GXGraphRead;
    result = GSHead(&reader, &current, tip);
    if (result == GS_NOT_FOUND && !expectedTip && current) result = 0;
    else if (!result && (!expectedTip || memcmp(tip, expectedTip, 20))) result = GS_CONFLICT;
    if (!result && (!current || strcmp(current, branch))) result = GS_CONFLICT;
    free(current);
    if (result) return result;
    limits.objects = 65536; limits.objectBytes = 2UL * 1024 * 1024;
    limits.readBytes = 64UL * 1024 * 1024;
    result = GVIsAncestor(&reader, expectedTip ? expectedTip : targetTip, targetTip,
                          &limits, GXGraphProgress, x, &found);
    if (result) return result;
    if (found) {
        *advance = !expectedTip || memcmp(expectedTip, targetTip, 20) != 0;
        return 0;
    }
    result = GVIsAncestor(&reader, targetTip, expectedTip, &limits, GXGraphProgress, x, &found);
    return result ? result : found ? 0 : GX_DIVERGED;
}
static int GXForwardHeadPlan(const GQPlan *plan, const char *branch) {
    size_t i, n = strlen(branch);
    const GCMetadata *head;
    if (n > (size_t)-1 - 6) return GB_SPACE;
    for (i = 0; i < plan->transaction.metadataCount; ++i) {
        head = plan->transaction.metadata + i;
        if (strcmp(head->path, "HEAD")) continue;
        /* Even a writer ignoring our lease must not make Pull switch back to
           a branch it silently stopped being on during ancestry traversal.
           The transaction subsequently guards this exact captured HEAD. */
        return head->beforePresent && head->beforeLength == n + 6 &&
               !memcmp(head->before, "ref: ", 5) && !memcmp(head->before + 5, branch, n) &&
               head->before[n + 5] == '\n' ? 0 : GS_CONFLICT;
    }
    return GS_CONFLICT;
}
static int GXCheckCondition(GXCheckout *x) {
    int result;
    if(!x->store.leaseHeld)return GS_CONFLICT;
    result=x->precondition?x->precondition(x->preconditionContext,&x->store):0;
    return !result && !x->store.leaseHeld?GS_CONFLICT:result;
}
static int GXCheckoutTo(GXCheckout *x, const char *branch, const unsigned char *expectedTip,
                        const unsigned char *targetTip, GQError *why, int forward, int *advanced) {
    GXState *s;
    GQPlan plan;
    GFInventory inventory;
    GPMap map;
    GSRepository r;
    GCBackend b;
    GTControl c;
    int result, closed, advance = 1;
    if (!x || !x->state || !branch || x->store.leaseHeld || x->held.haveData ||
        x->held.haveResource)
        return GB_BAD;
    if (why) memset(why, 0, sizeof(*why));
    s = x->state;
    GXClearPlan(s);
    GQInit(&plan);
    GFInit(&inventory);
    GPInit(&map);
    result = GSMacEnter(&x->store, 0);
    if(!result)result=GXCheckCondition(x);
    if (!result && forward)
        result = GXForwardPolicy(x, branch, expectedTip, targetTip, &advance);
    if (result || !advance) goto done;
    if (!result)
        result = GXStorage(x, 1);
    if (!result)
        result = GPLoad(&x->raw, GWMacNameEqual, NULL, &map);
    if (!result)
        result = GFCollect(&x->root, &map, &inventory, &x->lastError);
    if (!result) {
        if (targetTip)
            result = GQToCommit(&x->raw, branch, expectedTip, targetTip, inventory.items,
                                inventory.count, GWMacNameEqual, NULL, &plan, why);
        else
            result = GQToBranch(&x->raw, branch, inventory.items, inventory.count, GWMacNameEqual,
                                NULL, &plan, why);
    }
    if (!result && forward) result = GXForwardHeadPlan(&plan, branch);
    if(!result)result=GXCheckCondition(x);
    if (!result) {
        /* The same lease spans planning and GT. Only this private store context
           is promoted; ordinary UI writers never acquire recovery privilege. */
        x->store.recoveryOwner = 1;
        s->handedLease = 1;
        s->starting = 1;
        s->candidate = &plan;
        s->inventory = &inventory;
        GXCallbacks(x, &r, &b, &c);
        result = GTStart(&r, &b, &c, s->binding, GWMacNameEqual, NULL, &plan.transaction);
        if (!result && advanced) *advanced = 1;
    }
done:
    s->candidate = NULL;
    s->inventory = NULL;
    s->starting = 0;
    s->handedLease = 0;
    if (x->store.leaseHeld && !x->held.haveData && !x->held.haveResource) {
        closed = GSMacLeave(&x->store);
        if (!result)
            result = closed;
    }
    GPFree(&map);
    GFFree(&inventory);
    GQFree(&plan);
    return result;
}
int GXBranch(GXCheckout *x, const char *branch, GQError *why) {
    return GXCheckoutTo(x, branch, NULL, NULL, why, 0, NULL);
}
int GXToCommit(GXCheckout *x, const char *branch, const unsigned char *expectedTip,
               const unsigned char targetTip[20], GQError *why) {
    if (!targetTip) return GB_BAD;
    return GXCheckoutTo(x, branch, expectedTip, targetTip, why, 0, NULL);
}
int GXFastForward(GXCheckout *x, const char *branch, const unsigned char *expectedTip,
                   const unsigned char targetTip[20], GQError *why, int *advanced) {
    if (!advanced) return GB_BAD;
    *advanced = 0;
    if (!targetTip || !GSValidRef(branch)) return GB_BAD;
    return GXCheckoutTo(x, branch, expectedTip, targetTip, why, 1, advanced);
}
static int GXMergeRead(void *context,const char *key,unsigned char **bytes,size_t *n) {
    char stash[64];
    if(!strcmp(key,SP_LOG_KEY))return GSMacReadLimit((GSMacStore *)context,key,bytes,n,1048576);
    if(!strncmp(key,"refs/",5)){
        int result=GSRefKey("refs/stash",stash);if(result)return result;
        if(!strcmp(key,stash))return GSMacReadLimit((GSMacStore *)context,key,bytes,n,52);
    }
    return GSMacReadLimit((GSMacStore *)context,key,bytes,n,
                         !strcmp(key,WS_LIST_KEY)?32UL+128UL*20:
                         !strncmp(key,"objects/",8)?3UL*1024*1024:4UL*1024*1024);
}
static int GXMergeProgress(void *context) { return GXPoint((GXCheckout *)context,"prepare merge"); }
static int GXBranchEditProgress(void *context) {return GXPoint((GXCheckout *)context,"review branch metadata");}
static int GXDiscardProgress(void *context) {return GXPoint((GXCheckout *)context,"review working changes");}
typedef struct {GSRepository *metadata,*objects;} GXDiscardReader;
static int GXDiscardRead(void *context,const char *key,unsigned char **p,size_t *n) {
    GXDiscardReader *r=(GXDiscardReader *)context;
    GSRepository *source=!strncmp(key,"objects/",8)?r->objects:r->metadata;
    return source->read(source->context,key,p,n);
}
static int GXDiscardObject(void *context,const char *key,const void *a,size_t an,const void *b,size_t bn) {
    GXDiscardReader *r=(GXDiscardReader *)context;
    if(strncmp(key,"objects/",8))return GB_BAD;
    return r->metadata->replace(r->metadata->context,key,a,an,b,bn);
}
void GXDiscardInit(GXDiscardReview *p) {memset(p,0,sizeof(*p));}
void GXDiscardFree(GXDiscardReview *p) {GQFree(&p->plan);GFFree(&p->inventory);GXDiscardInit(p);}
static void GXSaveLimits(WSLimits *l) {
    memset(l,0,sizeof(*l));l->stateBytes=2UL*1024*1024;l->files=8192;l->paths=8192;
    l->pathBytes=16384;l->forkBytes=2UL*1024*1024;l->workBytes=32UL*1024*1024;l->entries=128;
}
void GXSavedListInit(GXSavedList *list) {memset(list,0,sizeof(*list));}
void GXSavedListFree(GXSavedList *list) {
    size_t i;if(list->rows)for(i=0;i<list->list.count;++i)free(list->rows[i].branch);
    free(list->rows);WSListFree(&list->list);GXSavedListInit(list);
}
static int GXSavedSummary(const WSRecord *record,GXSavedRow *row) {
    size_t i,n;const GCMetadata *head=NULL;
    for(i=0;i<record->discard.metadataCount;++i)
        if(!strcmp(record->discard.metadata[i].path,"HEAD"))head=record->discard.metadata+i;
    if(!head || !head->beforePresent || head->beforeLength<7)return GS_FORMAT;
    n=head->beforeLength-6;if(n>1024)return GB_SPACE;
    row->branch=malloc(n+1);if(!row->branch)return GB_MEMORY;
    memcpy(row->branch,head->before+5,n);row->branch[n]=0;
    memcpy(row->base,record->base,20);memcpy(row->staged,record->staged,20);
    memcpy(row->working,record->working,20);memcpy(row->untracked,record->untracked,20);
    row->haveBase=record->haveBase;row->haveUntracked=record->haveUntracked;
    row->generation=record->discard.generation;row->pathCount=record->pathCount;return 0;
}
int GXSavedListRead(GXCheckout *x,GXSavedList *out) {
    GXSavedList next;WSLimits l;WSRecord record;GOLimits limits;GOReader budget;
    GSRepository reader,objects;unsigned char *p=NULL;size_t n=0,i;char type[7];int result,closed;
    if(!x || !x->state || !out || x->store.leaseHeld || x->held.haveData || x->held.haveResource)return GB_BAD;
    GXSavedListInit(&next);WSInit(&record);GXSaveLimits(&l);reader=x->raw;reader.read=GXMergeRead;
    memset(&limits,0,sizeof(limits));limits.objectBytes=l.stateBytes;limits.encodedBytes=3UL*1024*1024;
    /* At most128 bounded envelopes, one live parsed envelope at a time. This
       is an IO budget, not a512MiB allocation or a full-graph verification. */
    limits.readBytes=512UL*1024*1024;limits.reads=512;
    result=GSMacEnter(&x->store,0);
    if(!result)result=GXCheckCondition(x);
    if(!result)result=GTNormalWriteAllowed(&reader);
    if(!result)result=WSListRead(&reader,&l,&next.list);
    if(!result && next.list.count)result=GXStorage(x,0);
    if(!result && next.list.count) {
        memcpy(next.backendBinding,x->state->binding,32);
        next.rows=calloc(next.list.count,sizeof(*next.rows));if(!next.rows)result=GB_MEMORY;
    }
    if(!result)result=GOReadStart(&reader,&limits,GXDiscardProgress,x,&budget,&objects);
    for(i=0;!result && i<next.list.count;++i) {
        GXSavedRow *row=next.rows+i;
        row->status=GSGetObjectLimit(&objects,next.list.ids[i],type,&p,&n,l.stateBytes);
        if(!row->status && strcmp(type,"blob"))row->status=GS_FORMAT;
        if(!row->status)row->status=WSParse(p,n,&l,GWMacNameEqual,NULL,&record);
        free(p);p=NULL;n=0;
        if(!row->status && memcmp(record.binding,next.backendBinding,32))row->status=GS_CONFLICT;
        if(!row->status)row->status=GXSavedSummary(&record,row);
        WSFree(&record);
        if(row->status && row->status!=GS_FORMAT && row->status!=GS_NOT_FOUND &&
           row->status!=GB_CHECKSUM && row->status!=GS_CONFLICT && row->status!=GI_UNSUPPORTED)result=row->status;
    }
    if(!result)result=GXCheckCondition(x);
    if(x->store.leaseHeld){closed=GSMacLeave(&x->store);if(!result)result=closed;}
    if(!result){GXSavedListFree(out);*out=next;GXSavedListInit(&next);}
    free(p);WSFree(&record);GXSavedListFree(&next);return result;
}
int GXSavedInspect(GXCheckout *x,const unsigned char oid[20],WSRecord *out) {
    WSRecord next;WSList list;WSLimits l;GOLimits limits;GOReader budget;
    GSRepository reader,objects,bounded;GXDiscardReader mux;size_t i;int result,closed,found=0;
    if(!x || !x->state || !oid || !out || x->store.leaseHeld || x->held.haveData || x->held.haveResource)return GB_BAD;
    WSInit(&next);WSListInit(&list);GXSaveLimits(&l);reader=x->raw;reader.read=GXMergeRead;
    memset(&limits,0,sizeof(limits));limits.objectBytes=l.stateBytes;limits.encodedBytes=3UL*1024*1024;
    limits.readBytes=64UL*1024*1024;limits.reads=32768;
    result=GSMacEnter(&x->store,0);
    if(!result)result=GXCheckCondition(x);
    if(!result)result=GTNormalWriteAllowed(&reader);
    if(!result)result=WSListRead(&reader,&l,&list);
    for(i=0;!result && i<list.count;++i)if(!memcmp(list.ids[i],oid,20))found=1;
    if(!result && !found)result=GS_CONFLICT;
    if(!result)result=GXStorage(x,0);
    if(!result)result=GOReadStart(&reader,&limits,GXDiscardProgress,x,&budget,&objects);
    mux.metadata=&reader;mux.objects=&objects;bounded.context=&mux;bounded.read=GXDiscardRead;bounded.replace=GXDiscardObject;
    if(!result)result=WSOpen(&bounded,oid,&l,GWMacNameEqual,NULL,&next);
    if(!result && memcmp(next.binding,x->state->binding,32))result=GS_CONFLICT;
    if(!result)result=GXCheckCondition(x);
    if(x->store.leaseHeld){closed=GSMacLeave(&x->store);if(!result)result=closed;}
    if(!result){WSFree(out);*out=next;WSInit(&next);}
    WSListFree(&list);WSFree(&next);return result;
}
int GXDropPrepare(GXCheckout *x,const unsigned char oid[20],GXDiscardReview *out) {
    GXDiscardReview next;WSLimits l;GOLimits limits;GOReader budget;
    GSRepository reader,objects,bounded;GXDiscardReader mux;int result,closed;
    if(!x || !x->state || !oid || !out || x->store.leaseHeld || x->held.haveData || x->held.haveResource)return GB_BAD;
    GXDiscardInit(&next);GXSaveLimits(&l);reader=x->raw;reader.read=GXMergeRead;
    memset(&limits,0,sizeof(limits));limits.objectBytes=l.stateBytes;limits.encodedBytes=3UL*1024*1024;
    limits.readBytes=64UL*1024*1024;limits.reads=32768;
    result=GSMacEnter(&x->store,0);
    if(!result)result=GXCheckCondition(x);
    if(!result)result=GXStorage(x,0);
    if(!result)result=GOReadStart(&reader,&limits,GXDiscardProgress,x,&budget,&objects);
    mux.metadata=&reader;mux.objects=&objects;bounded.context=&mux;bounded.read=GXDiscardRead;bounded.replace=GXDiscardObject;
    if(!result)result=WRPrepareDrop(&bounded,oid,x->state->binding,&l,GWMacNameEqual,NULL,&next.plan);
    if(!result)result=GXCheckCondition(x);
    if(!result){memcpy(next.backendBinding,x->state->binding,32);memcpy(next.snapshotOID,oid,20);}
    if(x->store.leaseHeld){closed=GSMacLeave(&x->store);if(!result)result=closed;}
    if(!result){GXDiscardFree(out);*out=next;GXDiscardInit(&next);}
    GXDiscardFree(&next);return result;
}
typedef struct {GXCheckout *checkout;const GFInventory *inventory;} GXSaveReader;
static int GXSaveDirectoryEqual(const GFCatalog *a,const GFCatalog *b) {
    return GXDirSame(a,b) && a->modified==b->modified && a->children==b->children &&
        a->spec.vRefNum==b->spec.vRefNum && a->spec.parID==b->spec.parID &&
        a->spec.name[0]==b->spec.name[0] && !memcmp(a->spec.name+1,b->spec.name+1,a->spec.name[0]);
}
static int GXSaveReadDirectory(void *context,const GQWork *work,WSDirectory *out) {
    GXSaveReader *reader=context;GXCheckout *x=reader->checkout;GFCatalog current;size_t i;int result;
    for(i=0;i<reader->inventory->count && reader->inventory->items+i!=work;++i){}
    if(i==reader->inventory->count || work->file.present!=2)return GB_BAD;
    result=GFCatalogRead(&reader->inventory->catalog[i].spec,&current,&x->lastError);
    if(!result && !GXSaveDirectoryEqual(&current,reader->inventory->catalog+i))result=GS_CONFLICT;
    if(!result) {
        out->attributes=current.attributes;out->created=current.created;out->modified=current.modified;out->backup=current.backup;
        memcpy(out->finderInfo,current.finderInfo,32);
    }
    return result;
}
static int GXSaveReadWork(void *context,const GQWork *work,size_t cap,unsigned char **data,size_t *dn,
    unsigned char **resource,size_t *rn,unsigned char info[32]) {
    GXSaveReader *reader=context;GXCheckout *x=reader->checkout;size_t i;int result,closed;
    *data=*resource=NULL;*dn=*rn=0;
    for(i=0;i<reader->inventory->count && reader->inventory->items+i!=work;++i){}
    if(i==reader->inventory->count)return GB_BAD;
    result=GFLockFile(&reader->inventory->catalog[i].spec,&work->file,
        reader->inventory->catalog+i,&x->held,&x->lastError);
    if(!result)result=GFReadLocked(&x->held,cap,data,dn,resource,rn,&x->lastError);
    if(!result)memcpy(info,x->held.identity.finderInfo,32);
    closed=GFUnlockFile(&x->held,&x->lastError);return result?result:closed;
}
static int GXSavePrepare(GXCheckout *x,const char *branch,const unsigned char *expected,
    const GQProtection *paths,const char *identity,const char *seconds,const char *zone,
    int stash,GXDiscardReview *out,GQError *why) {
    GXDiscardReview next;GPMap map;GSRepository reader,objects,bounded;GOReader budget;GOLimits limits;GXDiscardReader mux;
    int result,closed;WSLimits saveLimits;WSPlan saved;SPPlan stashed;SLLimits logs;GXSaveReader saveReader;
    if(!x || !x->state || !out || x->store.leaseHeld || x->held.haveData || x->held.haveResource)return GB_BAD;
    GXDiscardInit(&next);GPInit(&map);WSPlanInit(&saved);SPInit(&stashed);reader=x->raw;reader.read=GXMergeRead;
    logs.bytes=1048576;logs.entries=8192;logs.lineBytes=32767;
    memset(&saveLimits,0,sizeof(saveLimits));saveLimits.stateBytes=2UL*1024*1024;
    saveLimits.files=8192;saveLimits.paths=8192;saveLimits.pathBytes=16384;saveLimits.forkBytes=2UL*1024*1024;
    saveLimits.workBytes=32UL*1024*1024;saveLimits.entries=128;
    saveReader.checkout=x;saveReader.inventory=&next.inventory;
    memset(&limits,0,sizeof(limits));limits.objectBytes=2UL*1024*1024;limits.encodedBytes=3UL*1024*1024;
    limits.readBytes=64UL*1024*1024;limits.reads=32768;
    result=GSMacEnter(&x->store,0);
    if(!result)result=GXCheckCondition(x);
    if(!result)result=GTNormalWriteAllowed(&reader);
    if(!result)result=GXStorage(x,1);
    if(!result)result=GOReadStart(&reader,&limits,GXDiscardProgress,x,&budget,&objects);
    mux.metadata=&reader;mux.objects=&objects;bounded.context=&mux;bounded.read=GXDiscardRead;bounded.replace=GXDiscardObject;
    if(!result)result=GPLoad(&bounded,GWMacNameEqual,NULL,&map);
    if(!result)result=GFCollect(&x->root,&map,&next.inventory,&x->lastError);
    if(!result)result=GQDiscard(&bounded,branch,expected,next.inventory.items,next.inventory.count,
        paths,GWMacNameEqual,NULL,&next.plan,why);
    if(!result)result=GTNormalWriteAllowed(&reader);
    if(!result)result=GTNextGeneration(&reader,&next.plan.transaction.generation);
    if(!result)result=WSPrepareDiscard(&bounded,&next.plan,x->state->binding,next.inventory.items,
        next.inventory.count,paths,GXSaveReadWork,GXSaveReadDirectory,&saveReader,&saveLimits,GWMacNameEqual,NULL,&saved);
    if(!result && stash)result=SPPrepareStore(&bounded,&saved,&saveLimits,&logs,identity,seconds,zone,GWMacNameEqual,NULL,&stashed);
    if(!result) {
        GCFree(&next.plan.transaction);
        if(stash){next.plan.transaction=stashed.transaction;GCInit(&stashed.transaction);memcpy(next.snapshotOID,stashed.saved,20);}
        else {next.plan.transaction=saved.transaction;GCInit(&saved.transaction);memcpy(next.snapshotOID,saved.oid,20);}
    }
    if(!result)result=GXCheckCondition(x);
    if(!result)memcpy(next.backendBinding,x->state->binding,32);
    if(x->store.leaseHeld && !x->held.haveData && !x->held.haveResource){closed=GSMacLeave(&x->store);if(!result)result=closed;}
    if(!result){GXDiscardFree(out);*out=next;GXDiscardInit(&next);}
    GPFree(&map);WSPlanFree(&saved);SPFree(&stashed);GXDiscardFree(&next);return result;
}
int GXDiscardPrepare(GXCheckout *x,const char *branch,const unsigned char *expected,
    const GQProtection *paths,GXDiscardReview *out,GQError *why){
    return GXSavePrepare(x,branch,expected,paths,NULL,NULL,NULL,0,out,why);
}
int GXStashStorePrepare(GXCheckout *x,const char *branch,const unsigned char *expected,
    const GQProtection *paths,const char *identity,const char *seconds,const char *zone,GXDiscardReview *out,GQError *why){
    if(!identity || !seconds || !zone)return GB_BAD;
    return GXSavePrepare(x,branch,expected,paths,identity,seconds,zone,1,out,why);
}
void GXStashListInit(GXStashList *list){memset(list,0,sizeof(*list));SPStateInit(&list->state);}
void GXStashListFree(GXStashList *list){SPStateFree(&list->state);GXStashListInit(list);}
int GXStashListRead(GXCheckout *x,GXStashList *out){
    GXStashList next;GSRepository reader;SLLimits logs;unsigned char binding[32];int result,closed;
    if(!x || !x->state || !out || x->store.leaseHeld || x->held.haveData || x->held.haveResource)return GB_BAD;
    GXStashListInit(&next);reader=x->raw;reader.read=GXMergeRead;
    logs.bytes=1048576;logs.entries=8192;logs.lineBytes=32767;
    result=GSMacEnter(&x->store,0);
    if(!result)result=GXCheckCondition(x);
    if(!result)result=GTNormalWriteAllowed(&reader);
    if(!result)result=GXBinding(x,NULL,next.repositoryBinding);
    if(!result)result=SPRead(&reader,&logs,&next.state);
    if(!result)result=GXBinding(x,NULL,binding);
    if(!result && memcmp(binding,next.repositoryBinding,32))result=GS_CONFLICT;
    if(!result)result=GXCheckCondition(x);
    if(x->store.leaseHeld){closed=GSMacLeave(&x->store);if(!result)result=closed;}
    if(!result){GXStashListFree(out);*out=next;GXStashListInit(&next);}
    GXStashListFree(&next);return result;
}
int GXStashDropPrepare(GXCheckout *x,const GXStashList *list,size_t index,
    const unsigned char expected[20],GXDiscardReview *out){
    GXDiscardReview next;GSRepository reader,objects,bounded;GXDiscardReader mux;
    GOLimits limits;GOReader budget;SLLimits logs;unsigned char binding[32];int result,closed;
    if(!x || !x->state || !list || !expected || !out || x->store.leaseHeld || x->held.haveData || x->held.haveResource)return GB_BAD;
    GXDiscardInit(&next);reader=x->raw;reader.read=GXMergeRead;
    logs.bytes=1048576;logs.entries=8192;logs.lineBytes=32767;
    memset(&limits,0,sizeof(limits));limits.objectBytes=2UL*1024*1024;limits.encodedBytes=3UL*1024*1024;
    limits.readBytes=64UL*1024*1024;limits.reads=32768;
    result=GSMacEnter(&x->store,0);
    if(!result)result=GXCheckCondition(x);
    if(!result)result=GTNormalWriteAllowed(&reader);
    if(!result)result=GXBinding(x,NULL,binding);
    if(!result && memcmp(binding,list->repositoryBinding,32))result=GS_CONFLICT;
    if(!result)result=GOReadStart(&reader,&limits,GXDiscardProgress,x,&budget,&objects);
    mux.metadata=&reader;mux.objects=&objects;bounded.context=&mux;bounded.read=GXDiscardRead;bounded.replace=GXDiscardObject;
    if(!result)result=SDPrepareDrop(&bounded,&list->state,index,expected,&logs,2UL*1024*1024,GWMacNameEqual,NULL,&next.plan.transaction);
    if(!result)result=GXStorage(x,1);
    if(!result)result=GXBinding(x,NULL,binding);
    if(!result && memcmp(binding,list->repositoryBinding,32))result=GS_CONFLICT;
    if(!result)result=GXCheckCondition(x);
    if(!result){memcpy(next.backendBinding,x->state->binding,32);memcpy(next.snapshotOID,expected,20);}
    if(x->store.leaseHeld){closed=GSMacLeave(&x->store);if(!result)result=closed;}
    if(!result){GXDiscardFree(out);*out=next;GXDiscardInit(&next);}
    GXDiscardFree(&next);return result;
}
static int GXStashRead(void *context,const char *key,unsigned char **p,size_t *n){
    char stash[64];size_t cap=2UL*1024*1024;int result;
    if(!strncmp(key,"objects/",8))cap=3UL*1024*1024;
    else if(!strcmp(key,SP_LOG_KEY))cap=1048576;
    else if(!strcmp(key,WS_LIST_KEY))cap=32UL+128UL*20;
    else if(!strncmp(key,"refs/",5)){
        result=GSRefKey("refs/stash",stash);if(result)return result;if(!strcmp(key,stash))cap=52;
    }
    return GSMacReadLimit((GSMacStore *)context,key,p,n,cap);
}
void GXStashReviewInit(GXStashReview *p){memset(p,0,sizeof(*p));SAInit(&p->review);}
void GXStashReviewFree(GXStashReview *p){SAFree(&p->review);GXStashReviewInit(p);}
int GXStashApplyPrepare(GXCheckout *x,const GXStashList *shown,size_t selected,const unsigned char stash[20],
    const char *branch,const unsigned char tip[20],const TMLimits *limits,char newline,GXStashReview *out){
    GXStashReview next;GSRepository r;WSLimits saved;SLLimits logs;unsigned char binding[32];int result,closed;
    if(!x || !x->state || !shown || !stash || !branch || !tip || !limits || !out || x->store.leaseHeld || x->held.haveData || x->held.haveResource)return GB_BAD;
    GXStashReviewInit(&next);r=x->raw;r.read=GXStashRead;GXSaveLimits(&saved);logs.bytes=1048576;logs.entries=8192;logs.lineBytes=32767;
    result=GSMacEnter(&x->store,0);
    if(!result)result=GXCheckCondition(x);
    if(!result)result=GTNormalWriteAllowed(&r);
    if(!result)result=GXBinding(x,NULL,next.repositoryBinding);
    if(!result && memcmp(next.repositoryBinding,shown->repositoryBinding,32))result=GS_CONFLICT;
    if(!result)result=SAPrepare(&r,&shown->state,selected,stash,branch,tip,&logs,&saved,limits,newline,GWMacNameEqual,NULL,GXDiscardProgress,x,&next.review);
    if(!result)result=GXBinding(x,NULL,binding);
    if(!result && memcmp(binding,next.repositoryBinding,32))result=GS_CONFLICT;
    if(!result)result=GXCheckCondition(x);
    if(x->store.leaseHeld){closed=GSMacLeave(&x->store);if(!result)result=closed;}
    if(!result){GXStashReviewFree(out);*out=next;GXStashReviewInit(&next);}
    GXStashReviewFree(&next);return result;
}
int GXStashApplyBuild(GXCheckout *x,const GXStashReview *review,const TMResolution *working,size_t wc,
    const TMResolution *staged,size_t sc,int pop,GXDiscardReview *out,GQError *why){
    GXDiscardReview next;SAPlan plan;GPMap map;GSRepository r;WSLimits saved;unsigned char binding[32];int result,closed;
    if(!x || !x->state || !review || !out || x->store.leaseHeld || x->held.haveData || x->held.haveResource)return GB_BAD;
    GXDiscardInit(&next);SAPlanInit(&plan);GPInit(&map);GXSaveLimits(&saved);r=x->raw;r.read=GXStashRead;
    result=GSMacEnter(&x->store,0);
    if(!result)result=GXCheckCondition(x);
    if(!result)result=GTNormalWriteAllowed(&r);
    if(!result)result=GXBinding(x,NULL,binding);
    if(!result && memcmp(binding,review->repositoryBinding,32))result=GS_CONFLICT;
    if(!result)result=GPLoad(&r,GWMacNameEqual,NULL,&map);
    if(!result)result=GFCollect(&x->root,&map,&next.inventory,&x->lastError);
    if(!result)result=SABuild(&r,&review->review,working,wc,staged,sc,pop,next.inventory.items,next.inventory.count,&saved,
        GWMacNameEqual,NULL,GXDiscardProgress,x,&plan,why);
    if(!result)result=GXStorage(x,1);
    if(!result)result=GXBinding(x,NULL,binding);
    if(!result && memcmp(binding,review->repositoryBinding,32))result=GS_CONFLICT;
    if(!result)result=GXCheckCondition(x);
    if(!result){next.plan=plan.checkout;GQInit(&plan.checkout);memcpy(next.backendBinding,x->state->binding,32);memcpy(next.snapshotOID,review->review.stash,20);}
    if(x->store.leaseHeld){closed=GSMacLeave(&x->store);if(!result)result=closed;}
    if(!result){GXDiscardFree(out);*out=next;GXDiscardInit(&next);}
    GPFree(&map);SAPlanFree(&plan);GXDiscardFree(&next);return result;
}
int GXRestorePrepare(GXCheckout *x,const unsigned char oid[20],GXDiscardReview *out,GQError *why) {
    GXDiscardReview next;GPMap map;GSRepository reader,objects,bounded;GOReader budget;GOLimits limits;
    GXDiscardReader mux;WSLimits saveLimits;int result,closed;
    if(!x || !x->state || !oid || !out || x->store.leaseHeld || x->held.haveData || x->held.haveResource)return GB_BAD;
    GXDiscardInit(&next);GPInit(&map);reader=x->raw;reader.read=GXMergeRead;
    memset(&saveLimits,0,sizeof(saveLimits));saveLimits.stateBytes=2UL*1024*1024;
    saveLimits.files=8192;saveLimits.paths=8192;saveLimits.pathBytes=16384;saveLimits.forkBytes=2UL*1024*1024;
    saveLimits.workBytes=32UL*1024*1024;saveLimits.entries=128;
    memset(&limits,0,sizeof(limits));limits.objectBytes=2UL*1024*1024;limits.encodedBytes=3UL*1024*1024;
    limits.readBytes=64UL*1024*1024;limits.reads=32768;
    result=GSMacEnter(&x->store,0);
    if(!result)result=GXCheckCondition(x);
    if(!result)result=GXStorage(x,1);
    if(!result)result=GOReadStart(&reader,&limits,GXDiscardProgress,x,&budget,&objects);
    mux.metadata=&reader;mux.objects=&objects;bounded.context=&mux;bounded.read=GXDiscardRead;bounded.replace=GXDiscardObject;
    if(!result)result=GPLoad(&bounded,GWMacNameEqual,NULL,&map);
    if(!result)result=GFCollect(&x->root,&map,&next.inventory,&x->lastError);
    if(!result)result=WRPrepareRestore(&bounded,oid,x->state->binding,next.inventory.items,next.inventory.count,
        &saveLimits,GWMacNameEqual,NULL,&next.plan,why);
    if(!result)result=GXCheckCondition(x);
    if(!result){memcpy(next.backendBinding,x->state->binding,32);memcpy(next.snapshotOID,oid,20);}
    if(x->store.leaseHeld && !x->held.haveData && !x->held.haveResource){closed=GSMacLeave(&x->store);if(!result)result=closed;}
    if(!result){GXDiscardFree(out);*out=next;GXDiscardInit(&next);}
    GPFree(&map);GXDiscardFree(&next);return result;
}
static int GXReviewMetadata(GXCheckout *x,const GCTransaction *t) {
    GSRepository reader=x->raw;unsigned char *p=NULL;size_t i,n=0;GBWord generation;int result;
    reader.read=GXMergeRead;result=GTNextGeneration(&reader,&generation);
    if(!result && generation!=t->generation)result=GS_CONFLICT;
    for(i=0;!result && i<t->metadataCount;++i) {
        const GCMetadata *m=t->metadata+i;
        result=reader.read(reader.context,m->path,&p,&n);
        if(result==GS_NOT_FOUND)result=m->beforePresent?GS_CONFLICT:0;
        else if(!result && (!m->beforePresent || n!=m->beforeLength ||
            (n && (!p || !m->before || memcmp(p,m->before,n)))))result=GS_CONFLICT;
        free(p);p=NULL;n=0;
    }
    return result;
}
int GXDiscardApply(GXCheckout *x,const GXDiscardReview *review) {
    GXState *s;GSRepository r;GCBackend b;GTControl c;GXSaveReader reader;WSDirectory directory;
    size_t i,j;int result,closed;
    if(!x || !x->state || !review || x->store.leaseHeld || x->held.haveData || x->held.haveResource)return GB_BAD;
    s=x->state;GXClearPlan(s);result=GSMacEnter(&x->store,0);
    if(!result)result=GXCheckCondition(x);
    if(!result)result=GXStorage(x,1);
    if(!result && memcmp(review->backendBinding,s->binding,32))result=GS_CONFLICT;
    if(!result)result=GTNormalWriteAllowed(&x->raw);
    reader.checkout=x;reader.inventory=&review->inventory;
    for(i=0;!result && i<review->plan.transaction.directoryCount;++i) {
        for(j=0;j<review->inventory.count && strcmp(review->inventory.items[j].native,
            review->plan.transaction.directories[i]);++j){}
        if(j==review->inventory.count)result=GS_CONFLICT;
        else result=GXSaveReadDirectory(&reader,review->inventory.items+j,&directory);
    }
    if(!result)result=GXCheckCondition(x);
    if(!result)result=GXReviewMetadata(x,&review->plan.transaction);
    if(!result) {
        s->candidate=&review->plan;s->inventory=&review->inventory;s->starting=1;s->handedLease=1;
        x->store.recoveryOwner=1;GXCallbacks(x,&r,&b,&c);
        result=GTStartAtGeneration(&r,&b,&c,s->binding,GWMacNameEqual,NULL,
            review->plan.transaction.generation,&review->plan.transaction);
    }
    s->candidate=NULL;s->inventory=NULL;s->starting=0;s->handedLease=0;
    if(x->store.leaseHeld && !x->held.haveData && !x->held.haveResource) {
        closed=GSMacLeave(&x->store);if(!result)result=closed;
    }
    return result;
}
int GXBranchEditPrepare(GXCheckout *x,int kind,const char *current,const unsigned char *currentTip,
    const char *source,const unsigned char *sourceTip,const char *target,const BELimits *limits,
    BENamespace names,void *nameCtx,BEPlan *out) {
    BEPlan next;GSRepository reader;int result,closed;
    if(!x || !x->state || !out || x->store.leaseHeld || x->held.haveData || x->held.haveResource)return GB_BAD;
    BEInit(&next);reader=x->raw;reader.read=GXMergeRead;
    result=GSMacEnter(&x->store,0);
    if(!result)result=GXCheckCondition(x);
    if(!result)result=GXStorage(x,1);
    if(!result)result=BEPrepare(&reader,kind,current,currentTip,source,sourceTip,target,limits,
        names,nameCtx,GXBranchEditProgress,x,&next);
    if(!result)result=GXCheckCondition(x);
    if(!result)memcpy(next.backendBinding,x->state->binding,32);
    if(x->store.leaseHeld){closed=GSMacLeave(&x->store);if(!result)result=closed;}
    if(!result){BEFree(out);*out=next;BEInit(&next);}
    BEFree(&next);return result;
}
int GXBranchEditApply(GXCheckout *x,const BEPlan *plan,BENamespace names,void *nameCtx,int allowUnmerged) {
    GXState *s;GQPlan candidate;GFInventory empty;GSRepository reader,r;GCBackend b;GTControl c;
    int result,closed;
    if(!x || !x->state || !plan || x->store.leaseHeld || x->held.haveData || x->held.haveResource)return GB_BAD;
    s=x->state;GXClearPlan(s);GQInit(&candidate);GFInit(&empty);
    reader=x->raw;reader.read=GXMergeRead;
    result=GSMacEnter(&x->store,0);
    if(!result)result=GXCheckCondition(x);
    if(!result)result=GXStorage(x,1);
    if(!result && memcmp(plan->backendBinding,s->binding,32))result=GS_CONFLICT;
    if(!result)result=BECheck(&reader,plan,names,nameCtx,allowUnmerged);
    if(!result)result=GXCheckCondition(x);
    if(!result) {
        candidate.transaction=plan->transaction; /* Borrowed; caller keeps it. */
        s->candidate=&candidate;s->inventory=&empty;s->starting=1;s->handedLease=1;
        x->store.recoveryOwner=1;GXCallbacks(x,&r,&b,&c);
        result=GTStartAtGeneration(&r,&b,&c,s->binding,GWMacNameEqual,NULL,
            plan->transaction.generation,&plan->transaction);
    }
    s->candidate=NULL;s->inventory=NULL;s->starting=0;s->handedLease=0;
    if(x->store.leaseHeld && !x->held.haveData && !x->held.haveResource) {
        closed=GSMacLeave(&x->store);if(!result)result=closed;
    }
    return result;
}
static int GXMergeState(GSRepository *r,const MMPlan *p) {
    unsigned char *bytes=NULL;
    size_t i,n;
    int error=GTWriteAllowed(r),present;
    for(i=0;!error && i<5;++i) {
        error=r->read(r->context,p->guards[i].key,&bytes,&n);present=!error;
        if(error==GS_NOT_FOUND)error=0;
        if(!error && (present!=p->guards[i].present || (present &&
            (n!=p->guards[i].length || memcmp(bytes,p->guards[i].bytes,n)))))error=GS_CONFLICT;
        free(bytes);bytes=NULL;
    }
    return error;
}
int GXMergePrepare(GXCheckout *x,const char *branch,const unsigned char current[20],const char *other,
                     const unsigned char incoming[20],unsigned options,char newline,const MMLimits *limits,MMPlan *out) {
    MMPlan next;
    GSRepository reader;
    int result,closed;
    if(!x || !x->state || !out || x->store.leaseHeld || x->held.haveData || x->held.haveResource)return GB_BAD;
    MMInit(&next);reader=x->raw;reader.read=GXMergeRead;
    result=GSMacEnter(&x->store,0);
    if(!result)result=GXCheckCondition(x);
    if(!result)result=MMPrepare(&reader,branch,current,other,incoming,options,newline,limits,GXMergeProgress,x,&next);
    if(!result)result=GXCheckCondition(x);
    if(x->store.leaseHeld) {
        closed=GSMacLeave(&x->store);if(!result)result=closed;
    }
    if(!result){MMFree(out);*out=next;MMInit(&next);}
    MMFree(&next);return result;
}
int GXMergeApply(GXCheckout *x,const MMPlan *p,const char *author,const char *committer,const char *seconds,
                   const char *zone,const char *message,GQError *why,int *advanced,unsigned char oid[20]) {
    MMCheckout candidate;
    GFInventory inventory;
    GPMap map;
    GXState *s;
    GSRepository reader,r;
    GCBackend b;
    GTControl c;
    int result,closed;
    if(!advanced)return GB_BAD;
    *advanced=0;
    if(!x || !x->state || !p || p->kind<MM_UPTODATE || p->kind>MM_UNRELATED || x->store.leaseHeld ||
        x->held.haveData || x->held.haveResource)return GB_BAD;
    if(why)memset(why,0,sizeof(*why));
    if(p->kind==MM_CONFLICT)return GI_UNMERGED;
    if(p->kind==MM_MULTIPLE_BASES || p->kind==MM_UNRELATED)return MM_POLICY;
    s=x->state;GXClearPlan(s);MMCheckoutInit(&candidate);GFInit(&inventory);GPInit(&map);
    reader=x->raw;reader.read=GXMergeRead;
    result=GSMacEnter(&x->store,0);
    if(!result)result=GXCheckCondition(x);
    if(!result)result=GXMergeState(&reader,p);
    if(result || p->kind==MM_UPTODATE)goto done;
    if(!result)result=GPLoad(&reader,GWMacNameEqual,NULL,&map);
    if(!result)result=GFCollect(&x->root,&map,&inventory,&x->lastError);
    if(!result)result=MMBuildCheckout(&reader,p,inventory.items,inventory.count,GWMacNameEqual,NULL,
        author,committer,seconds,zone,message,GXMergeProgress,x,&candidate,why);
    if(result==MM_NO_CHANGE){result=0;goto done;}
    if(!result)result=GXStorage(x,1);
    if(!result)result=GXCheckCondition(x);
    if(!result) {
        x->store.recoveryOwner=1;s->handedLease=1;s->starting=1;
        s->candidate=&candidate.checkout;s->inventory=&inventory;
        GXCallbacks(x,&r,&b,&c);
        result=GTStart(&r,&b,&c,s->binding,GWMacNameEqual,NULL,&candidate.checkout.transaction);
        if(!result){*advanced=1;if(oid)memcpy(oid,candidate.commit,20);}
    }
done:
    s->candidate=NULL;s->inventory=NULL;s->starting=0;s->handedLease=0;
    if(x->store.leaseHeld && !x->held.haveData && !x->held.haveResource) {
        closed=GSMacLeave(&x->store);if(!result)result=closed;
    }
    GPFree(&map);GFFree(&inventory);MMCheckoutFree(&candidate);return result;
}
int GXMergeBegin(GXCheckout *x,const MMPlan *p,const MSChoices *choices,const MSLimits *limits,GQError *why,int *started) {
    MWPlan candidate;GFInventory inventory;GPMap map;GXState *s;GSRepository reader,r;GCBackend b;GTControl c;
    int result,closed;
    if(!started)return GB_BAD;
    *started=0;
    if(!x || !x->state || !p || p->kind!=MM_CONFLICT || !choices || !limits || x->store.leaseHeld ||
        x->held.haveData || x->held.haveResource)return GB_BAD;
    if(why)memset(why,0,sizeof(*why));
    s=x->state;GXClearPlan(s);MWInit(&candidate);GFInit(&inventory);GPInit(&map);reader=x->raw;reader.read=GXMergeRead;
    result=GSMacEnter(&x->store,0);
    if(!result)result=GXCheckCondition(x);
    if(!result)result=GXMergeState(&reader,p);
    if(!result)result=GXStorage(x,1);
    if(!result)result=GPLoad(&reader,GWMacNameEqual,NULL,&map);
    if(!result)result=GFCollect(&x->root,&map,&inventory,&x->lastError);
    if(!result)result=MWBegin(&reader,p,choices,limits,s->binding,inventory.items,inventory.count,
        GWMacNameEqual,NULL,GXMergeProgress,x,&candidate,why);
    if(!result)result=GXCheckCondition(x);
    if(!result) {
        x->store.recoveryOwner=1;s->handedLease=1;s->starting=1;s->candidate=&candidate.checkout;s->inventory=&inventory;
        GXCallbacks(x,&r,&b,&c);result=MWStart(&r,&b,&c,s->binding,GWMacNameEqual,NULL,&candidate);
        if(!result)*started=1;
    }
    s->candidate=NULL;s->inventory=NULL;s->starting=0;s->handedLease=0;
    if(x->store.leaseHeld && !x->held.haveData && !x->held.haveResource) {
        closed=GSMacLeave(&x->store);if(!result)result=closed;
    }
    GPFree(&map);GFFree(&inventory);MWFree(&candidate);return result;
}
int GXMergeOpen(GXCheckout *x,const MMLimits *limits,const MSLimits *sl,MWSession *out) {
    MWSession next;GSRepository reader;int result,closed;
    if(!x || !x->state || !limits || !sl || !out || x->store.leaseHeld ||
        x->held.haveData || x->held.haveResource)return GB_BAD;
    GXClearPlan(x->state);MWSessionInit(&next);reader=x->raw;reader.read=GXMergeRead;
    result=GSMacEnter(&x->store,1);
    if(!result)result=GXStorage(x,0);
    if(!result)result=MWOpen(&reader,limits,sl,x->state->binding,GWMacNameEqual,NULL,GXMergeProgress,x,&next);
    if(x->store.leaseHeld && !x->held.haveData && !x->held.haveResource) {
        closed=GSMacLeave(&x->store);if(!result)result=closed;
    }
    if(!result){MWSessionFree(out);*out=next;MWSessionInit(&next);}
    MWSessionFree(&next);return result;
}
int GXMergeResolve(GXCheckout *x,const void *expected,size_t length,const TMResolution *values,size_t count,
    const MMLimits *limits,const MSLimits *sl,GQError *why,int *installed) {
    MWSession opened;MWPlan candidate;MSChoices choices;GFInventory inventory;GXState *s;
    GSRepository reader,r;GCBackend b;GTControl c;char hex[41],token[32];int result,closed;
    if(!installed)return GB_BAD;
    *installed=0;
    if(!x || !x->state || !expected || !length || (count && !values) || !limits || !sl ||
        x->store.leaseHeld || x->held.haveData || x->held.haveResource)return GB_BAD;
    if(why)memset(why,0,sizeof(*why));
    s=x->state;GXClearPlan(s);MWSessionInit(&opened);MWInit(&candidate);MSChoicesInit(&choices);GFInit(&inventory);
    reader=x->raw;reader.read=GXMergeRead;result=GSMacEnter(&x->store,1);
    if(!result)result=GXStorage(x,0);
    if(!result)result=MWOpen(&reader,limits,sl,s->binding,GWMacNameEqual,NULL,GXMergeProgress,x,&opened);
    if(!result && (length!=opened.state.originalLength || memcmp(expected,opened.state.original,length)))result=GS_CONFLICT;
    if(!result) {
        /* Grants immutable candidate puts only. Mutable keys still require GT's
           separately claimed guards and transaction owner token. */
        GBOIDFormat(opened.state.planID,hex);sprintf(token,"%08lx-%.20s",(unsigned long)opened.state.revision,hex);
        result=GSMacOwnerToken(&x->store,token);
    }
    if(!result)result=MSMakeChoices(&reader,&opened.review,values,count,GXMergeProgress,x,&choices);
    if(!result)result=GFCollect(&x->root,&opened.mapping,&inventory,&x->lastError);
    MWSessionFree(&opened);
    if(!result)result=MWUpdate(&reader,expected,length,limits,sl,s->binding,&choices,inventory.items,inventory.count,
        GWMacNameEqual,NULL,GXMergeProgress,x,&candidate,why);
    if(!result) {
        s->handedLease=1;s->starting=1;s->candidate=&candidate.checkout;s->inventory=&inventory;
        GXCallbacks(x,&r,&b,&c);result=MWUpdateStart(&r,&b,&c,s->binding,GWMacNameEqual,NULL,&candidate);
        if(!result)*installed=1;
    }
    s->candidate=NULL;s->inventory=NULL;s->starting=0;s->handedLease=0;
    if(x->store.leaseHeld && !x->held.haveData && !x->held.haveResource) {
        closed=GSMacLeave(&x->store);if(!result)result=closed;
    }
    GFFree(&inventory);MSChoicesFree(&choices);MWFree(&candidate);return result;
}
static int GXMergeExit(GXCheckout *x,const void *expected,size_t length,const MMLimits *limits,const MSLimits *sl,
    int action,const char *author,const char *committer,const char *seconds,const char *zone,const char *message,
    GQError *why,int *finished,unsigned char oid[20]) {
    MWSession opened;MWPlan candidate;GFInventory inventory;GXState *s;GSRepository reader,r;
    GCBackend b;GTControl c;char hex[41],token[32];int result,closed;
    if(!finished)return GB_BAD;
    *finished=0;
    if(!x || !x->state || !expected || !length || !limits || !sl || x->store.leaseHeld ||
        x->held.haveData || x->held.haveResource || (action!=1 && action!=2))return GB_BAD;
    if(why)memset(why,0,sizeof(*why));
    s=x->state;GXClearPlan(s);MWSessionInit(&opened);MWInit(&candidate);GFInit(&inventory);
    reader=x->raw;reader.read=GXMergeRead;result=GSMacEnter(&x->store,1);
    if(!result)result=GXStorage(x,0);
    if(!result)result=MWOpen(&reader,limits,sl,s->binding,GWMacNameEqual,NULL,GXMergeProgress,x,&opened);
    if(!result && (length!=opened.state.originalLength || memcmp(expected,opened.state.original,length)))result=GS_CONFLICT;
    if(!result && action==1 && opened.drafts.index.unresolved)result=GI_UNMERGED;
    if(!result)result=GFCollect(&x->root,&opened.mapping,&inventory,&x->lastError);
    if(!result) {
        GBOIDFormat(opened.state.planID,hex);sprintf(token,"%08lx-%.20s",(unsigned long)opened.state.revision,hex);
        result=GSMacOwnerToken(&x->store,token);
    }
    MWSessionFree(&opened);
    if(!result && action==1)result=MWContinue(&reader,expected,length,limits,sl,s->binding,inventory.items,inventory.count,
        GWMacNameEqual,NULL,author,committer,seconds,zone,message,GXMergeProgress,x,&candidate,why);
    if(!result && action==2)result=MWAbort(&reader,expected,length,limits,sl,s->binding,inventory.items,inventory.count,
        GWMacNameEqual,NULL,GXMergeProgress,x,&candidate,why);
    if(!result) {
        s->handedLease=1;s->starting=1;s->candidate=&candidate.checkout;s->inventory=&inventory;GXCallbacks(x,&r,&b,&c);
        result=action==1?MWContinueStart(&r,&b,&c,s->binding,GWMacNameEqual,NULL,&candidate):
            MWAbortStart(&r,&b,&c,s->binding,GWMacNameEqual,NULL,&candidate);
        if(!result){*finished=1;if(oid)memcpy(oid,candidate.commit,20);}
    }
    s->candidate=NULL;s->inventory=NULL;s->starting=0;s->handedLease=0;
    if(x->store.leaseHeld && !x->held.haveData && !x->held.haveResource) {
        closed=GSMacLeave(&x->store);if(!result)result=closed;
    }
    GFFree(&inventory);MWFree(&candidate);return result;
}
int GXMergeContinue(GXCheckout *x,const void *expected,size_t length,const MMLimits *limits,const MSLimits *sl,
    const char *author,const char *committer,const char *seconds,const char *zone,const char *message,GQError *why,int *finished,unsigned char oid[20]) {
    return GXMergeExit(x,expected,length,limits,sl,1,author,committer,seconds,zone,message,why,finished,oid);
}
int GXMergeAbort(GXCheckout *x,const void *expected,size_t length,const MMLimits *limits,const MSLimits *sl,GQError *why,int *finished) {
    return GXMergeExit(x,expected,length,limits,sl,2,NULL,NULL,NULL,NULL,NULL,why,finished,NULL);
}
int GXRecover(GXCheckout *x, int rollback) {
    GXState *s;
    GSRepository r;
    GCBackend b;
    GTControl c;
    int result, closed;
    if (!x || !x->state || x->store.leaseHeld || x->held.haveData || x->held.haveResource)
        return GB_BAD;
    s = x->state;
    GXClearPlan(s);
    s->starting = 0;
    result = GSMacEnter(&x->store, 1);
    if (!result)
        result = GXStorage(x, 0);
    if (result == GS_NOT_FOUND) {
        result = GTWriteAllowed(&x->raw);
        closed = GSMacLeave(&x->store);
        return result ? result : closed;
    }
    if (!result) {
        s->handedLease = 1;
        GXCallbacks(x, &r, &b, &c);
        result = GTResume(&r, &b, &c, s->binding, GWMacNameEqual, NULL, rollback);
    }
    s->handedLease = 0;
    if (x->store.leaseHeld && !x->held.haveData && !x->held.haveResource) {
        closed = GSMacLeave(&x->store);
        if (!result)
            result = closed;
    }
    return result;
}
/* Caller already holds the private runner lease; no modal interaction here. */
static int GXPendingHeld(GXCheckout *x, GXPendingInfo *out) {
    GCTransaction initial, active;
    unsigned char *intent = NULL, *journal = NULL, *canonical = NULL;
    size_t n = 0, jn = 0, cn = 0;
    int result, found;
    GXPendingInfo info;
    if (!x || !x->state || !out || !x->store.leaseHeld || x->held.haveData || x->held.haveResource)
        return GB_BAD;
    memset(out, 0, sizeof(*out));
    memset(&info, 0, sizeof(info));
    GCInit(&initial);
    GCInit(&active);
    result = GTWriteAllowed(&x->raw);
    if (result == GC_RECOVERY) {
        info.pending = 1;
        result = GXStorage(x, 0);
        if (!result)
            result = x->raw.read(x->raw.context, "checkout-intent", &intent, &n);
        if (!result)
            result = GTIntentParse(intent, n, x->state->binding, GWMacNameEqual, NULL, &initial);
        if (!result)
            result = GXLoad(x, initial.token);
        if (!result) {
            /* Also compare the sealed manifest's full canonical transaction. */
            result = GTIntentEncode(x->state->binding, &x->state->plan, GWMacNameEqual, NULL,
                                    &canonical, &cn);
            if (!result && (n != cn || memcmp(intent, canonical, n)))
                result = GS_CONFLICT;
            free(canonical);
            canonical = NULL;
        }
        if (!result) {
            found = x->raw.read(x->raw.context, "checkout-journal", &journal, &jn);
            info.journalPresent = found == 0;
            if (found == GS_NOT_FOUND) {
                /* Published intent, no file transaction yet. GXRecover will
                   validate generation/owned guards before cleanup. */
                info.canFinish = 1;
            } else if (found)
                result = found;
            else if (jn == 32 && !memcmp(journal, "GHCI0001", 8)) {
                unsigned char hash[20];
                GXHash(journal, 12, hash);
                if (memcmp(hash, journal + 12, 20))
                    result = GB_CHECKSUM;
                else
                    info.canFinish = 1;
            } else {
                result = GCParse(journal, jn, GWMacNameEqual, NULL, &active);
                if (!result)
                    result = GTIntentEncode(x->state->binding, &active, GWMacNameEqual, NULL,
                                            &canonical, &cn);
                if (!result && (cn != n || memcmp(canonical, intent, n)))
                    result = GS_CONFLICT;
                if (!result) {
                    info.phase = active.phase;
                    info.canFinish = active.phase <= GC_COMMITTED || active.phase == GC_ROLLED_BACK;
                    info.canRestore =
                        active.phase < GC_COMMITTED ||
                        (active.phase >= GC_ROLLBACK_META && active.phase <= GC_RESTORING);
                }
            }
        }
        if (result == GS_NOT_FOUND)
            result = GC_RECOVERY;
        if (!result) {
            info.generation = initial.generation;
            strcpy(info.token, initial.token);
            info.fileCount = initial.fileCount;
            info.metadataCount = initial.metadataCount;
            memcpy(info.binding, x->state->binding, 32);
            GXHash(intent, n, info.intentID);
            if (info.journalPresent) GXHash(journal, jn, info.journalID);
        }
    }
    if (!result)
        *out = info;
    free(intent);
    free(journal);
    free(canonical);
    GCFree(&initial);
    GCFree(&active);
    return result;
}
int GXPending(GXCheckout *x, GXPendingInfo *out) {
    GXPendingInfo info;
    int result, closed;
    if (!x || !x->state || !out || x->store.leaseHeld || x->held.haveData || x->held.haveResource)
        return GB_BAD;
    memset(out, 0, sizeof(*out));
    result = GSMacEnter(&x->store, 1);
    if (!result) result = GXPendingHeld(x, &info);
    if (x->store.leaseHeld) {
        closed = GSMacLeave(&x->store);
        if (!result) result = closed;
    }
    if (!result) *out = info;
    return result;
}
static int GXPendingEqual(const GXPendingInfo *a, const GXPendingInfo *b) {
    return a->pending && b->pending && a->canFinish == b->canFinish && a->canRestore == b->canRestore &&
        a->phase == b->phase && a->generation == b->generation && !memcmp(a->token,b->token,30) &&
        a->fileCount == b->fileCount && a->metadataCount == b->metadataCount &&
        a->journalPresent == b->journalPresent && !memcmp(a->binding,b->binding,32) &&
        !memcmp(a->intentID,b->intentID,20) && !memcmp(a->journalID,b->journalID,20);
}
int GXRecoverExpected(GXCheckout *x, const GXPendingInfo *expected, int rollback) {
    GXPendingInfo current;
    GXState *s;
    GSRepository r;
    GCBackend b;
    GTControl c;
    int result, closed;
    if (!x || !x->state || !expected || !expected->pending || (rollback != 0 && rollback != 1) ||
        x->store.leaseHeld || x->held.haveData || x->held.haveResource) return GB_BAD;
    s = x->state;GXClearPlan(s);s->starting = 0;
    result = GSMacEnter(&x->store, 1);
    if (!result) result = GXPendingHeld(x, &current);
    if (!result && (!GXPendingEqual(expected,&current) || !(rollback?current.canRestore:current.canFinish)))
        result = GX_RECOVERY_CHANGED;
    if (!result) {
        s->handedLease = 1;GXCallbacks(x,&r,&b,&c);
        result = GTResume(&r,&b,&c,s->binding,GWMacNameEqual,NULL,rollback);
    }
    s->handedLease = 0;
    if (x->store.leaseHeld && !x->held.haveData && !x->held.haveResource) {
        closed = GSMacLeave(&x->store);if (!result) result = closed;
    }
    return result;
}
#include "GitRebaseMac.c"
