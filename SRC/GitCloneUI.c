/* Clone selection is a review, not a change to the currently open repository.
   Folder creation is deferred until Clone; Standard File owns navigation. */
typedef struct {
    char repository[256];
    FSSpec location;
    int haveLocation, newFolder, shownMode, ready;
} GHCloneChoice;
static GHCloneChoice *gCloneChoice;
static UserItemUPP gCloneArt;

static pascal void CloneSectionDraw(DialogPtr d,short item) {
    GrafPtr saved;RGBColor foreground;PenState pen;short font,size;Style face;
    GetPort(&saved);SetPort((GrafPtr)d);GetForeColor(&foreground);GetPenState(&pen);
    font=((GrafPtr)d)->txFont;size=((GrafPtr)d)->txSize;face=((GrafPtr)d)->txFace;PenNormal();
    Text(24,item==14?82:176,item==14?"GITHUB REPOSITORY":"LOCAL DESTINATION",gGeneva,9,80,40,104);
    RGBForeColor(&foreground);SetPenState(&pen);TextFont(font);TextSize(size);TextFace(face);SetPort(saved);
}
static void CloneSuggestedName(DialogPtr d,const char *repository) {
    const char *name=strrchr(repository,'/');char folder[32];size_t i,n;
    name=name?name+1:repository;n=strlen(name);if(n>31)n=31;
    for(i=0;i<n;++i)folder[i]=(unsigned char)name[i]<32 || name[i]==':'?'_':name[i];
    folder[n]=0;DialogText(d,6,folder);
}
static void CloneSync(DialogPtr d) {
    Handle item;short kind;Rect r;Str255 name;
    GetDialogItem(d,6,&kind,&item,&r);GetDialogItemText(item,name);
    gCloneChoice->ready=GHValidRepository(gCloneChoice->repository) && strlen(gCloneChoice->repository)<=254 &&
        gCloneChoice->haveLocation && (!gCloneChoice->newFolder || FolderNameValid(name));
    ChoiceEnable(d,1,gCloneChoice->ready);
    if(gCloneChoice->shownMode!=gCloneChoice->newFolder) {
        GetDialogItem(d,5,&kind,&item,&r);SetControlValue((ControlHandle)item,gCloneChoice->newFolder);
        GetDialogItem(d,7,&kind,&item,&r);SetControlValue((ControlHandle)item,!gCloneChoice->newFolder);
        if(gCloneChoice->newFolder){ShowDialogItem(d,6);ShowDialogItem(d,11);}
        else {HideDialogItem(d,6);HideDialogItem(d,11);}
        DialogText(d,10,gCloneChoice->newFolder?
            "A new folder will be created when you choose Clone.":
            "Existing files are kept. Interrupted clones can resume here.");
        gCloneChoice->shownMode=gCloneChoice->newFolder;
    }
}
static pascal Boolean CloneFilter(DialogPtr d,EventRecord *event,short *hit) {
    CloneSync(d);
    if((event->what==keyDown || event->what==autoKey) &&
       !(event->modifiers&cmdKey) &&
       ((event->message&charCodeMask)==13 || (event->message&charCodeMask)==3) &&
       !gCloneChoice->ready){*hit=0;SysBeep(1);return true;}
    return NativeDialogFilter(d,event,hit);
}
/* Choosing does not call SelectRemote/LocalClose or replace the commit draft. */
static int CloneChooseRepository(char repository[256]) {
    unsigned char *body;size_t length;char path[256],name[256];int page=1,count,error,selected;
    if(!gUser[0]){SignIn();if(!gUser[0])return 0;}
    for(;;) {
        snprintf(path,sizeof(path),"/user/repos?sort=updated&direction=desc&per_page=%d&page=%d",GH_REPOSITORY_PAGE,page);
        if(RemoteRequest(path,&body,&length))return 0;
        error=GHReadRepositories((char*)body,length,gRepos,GH_REPOSITORY_PAGE,&count);free(body);
        if(error){RCForget(&gRemoteCache,path);Message("Choose Repository","The repository list could not be read. Try again.");return 0;}
        selected=RepositoryListChoose(page,count,1);
        if(selected==-5){RCClear(&gRemoteCache);continue;}
        if(selected==-2 && page>1){--page;continue;}
        if(selected==-3 && count==GH_REPOSITORY_PAGE){++page;continue;}
        if(selected==-4) {
            strcpy(name,repository);
            if(!AskAction("Repository to Clone","Choose a repository to download. You will choose its destination folder next.","Select",ASK_REPOSITORY,name))return 0;
            if(!GHValidRepository(name) || strlen(name)>254){Message("Repository to Clone","Enter a repository as owner/name.");continue;}
            strcpy(repository,name);return 1;
        }
        if(selected>=0 && selected<count){strcpy(repository,gRepos[selected].fullName);return 1;}
        return 0;
    }
}
static int CloneCreateFolder(DialogPtr d,const FSSpec *parent,FSSpec *folder) {
    Handle item;short kind;Rect r;Str255 name;CInfoPBRec pb;FSSpec child;long id;OSErr error;char text[256];
    GetDialogItem(d,6,&kind,&item,&r);GetDialogItemText(item,name);
    if(!FolderNameValid(name))return 0;
    memset(&pb,0,sizeof(pb));pb.dirInfo.ioVRefNum=parent->vRefNum;
    pb.dirInfo.ioDrDirID=parent->parID;pb.dirInfo.ioNamePtr=(StringPtr)parent->name;
    error=PBGetCatInfoSync(&pb);
    if(!error && !(pb.dirInfo.ioFlAttrib&16))error=dirNFErr;
    if(!error) {
        id=pb.dirInfo.ioDrDirID;error=FSMakeFSSpec(parent->vRefNum,id,name,&child);
        if(error==noErr){Message("Choose Another Folder Name","A file or folder with this name already exists. Use a different name, or select Use this folder to resume a clone.");return 0;}
        if(error==fnfErr)error=DirCreate(parent->vRefNum,id,name,&id);
    }
    if(error){snprintf(text,sizeof(text),"The destination folder could not be created (error %d). Choose another name or location.",error);Message("Clone Repository",text);return 0;}
    *folder=child;return 1;
}
static int CloneChooseDestination(char repository[256],FSSpec *folder) {
    GHCloneChoice choice;DialogPtr d;ModalFilterUPP filter;short hit=0,kind,i;Handle item;Rect r;
    FSSpec selected;char name[64],label[128],pending[300],complete[300];int accepted=0,changed,result,empty,finished;
    size_t pn,cn;
    memset(&choice,0,sizeof(choice));choice.newFolder=1;choice.shownMode=-1;
    if(GHValidRepository(gRemote))strcpy(choice.repository,gRemote);
    d=GetNewDialog(154,NULL,(WindowPtr)-1);if(!d)return 0;
    filter=NewModalFilterProc(CloneFilter);if(!gCloneArt)gCloneArt=NewUserItemProc(CloneSectionDraw);
    if(!filter || !gCloneArt){if(filter)DisposeRoutineDescriptor((UniversalProcPtr)filter);DisposeDialog(d);SetPort(gWindow);return 0;}
    gCloneChoice=&choice;PrepareDialogChrome(d,12,13);
    for(i=14;i<=15;++i){GetDialogItem(d,i,&kind,&item,&r);SetDialogItem(d,i,kind,(Handle)gCloneArt,&r);}
    if(choice.repository[0]){DialogText(d,8,choice.repository);CloneSuggestedName(d,choice.repository);}
    CloneSync(d);PrepareDialog(d,1,2);
    while(!gDone) {
        hit=0;RunModalDialog(filter,&hit);
        if(hit==2)break;
        if(hit==3) {
            HideWindow((WindowPtr)d);changed=CloneChooseRepository(choice.repository);
            ShowWindow((WindowPtr)d);SelectWindow((WindowPtr)d);SetPort((GrafPtr)d);
            if(changed){DialogText(d,8,choice.repository);CloneSuggestedName(d,choice.repository);}
            DrawDialog(d);
        } else if(hit==4) {
            changed=ChooseFolderFor(0,choice.newFolder?"Choose where to create the cloned repository:":
                "Choose an empty folder or an interrupted clone:",choice.newFolder?"Save in":"Use",&selected);
            SetPort((GrafPtr)d);
            if(changed) {
                choice.location=selected;choice.haveLocation=1;
                memcpy(name,selected.name+1,selected.name[0]);name[selected.name[0]]=0;
                snprintf(label,sizeof(label),"%s",name);DialogText(d,9,label);
            }
            DrawDialog(d);
        } else if(hit==5 || hit==7)choice.newFolder=hit==5;
        else if(hit==1) {
            CloneSync(d);if(!choice.ready)continue;
            if(choice.newFolder){if(!CloneCreateFolder(d,&choice.location,folder))continue;}
            else {
                pn=(size_t)snprintf(pending,sizeof(pending),"GHClone1\n%s\n",choice.repository);
                cn=(size_t)snprintf(complete,sizeof(complete),"GHCloneDone1\n%s\n",choice.repository);
                result=NetCloneDestination(&choice.location,pending,pn,complete,cn,&empty,&finished);
                if(result){Message("Choose Another Destination","Choose an empty folder, or the folder of an interrupted clone of this repository. Existing files have been kept.");SetPort((GrafPtr)d);continue;}
                *folder=choice.location;
            }
            strcpy(repository,choice.repository);accepted=1;break;
        }
        CloneSync(d);
    }
    gCloneChoice=NULL;DisposeRoutineDescriptor((UniversalProcPtr)filter);DisposeDialog(d);SetPort(gWindow);
    if(!accepted && !gDone)SetStatus("Clone cancelled. Your current repository and draft are kept.");
    InvalRect(&gWindow->portRect);return accepted;
}
