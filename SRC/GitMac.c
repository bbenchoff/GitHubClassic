/* Classic File Manager backend. All store filenames are ASCII and <=31 bytes.
   No event pumping occurs inside the lock/compare/replace critical section. */
#include "GitMac.h"
#include "GitCheckout.h"
#include <Errors.h>
#include <Script.h>
#include <stdlib.h>
#include <string.h>
#include <stdio.h>

static int GMError(GSMacStore *s, OSErr error) {
    s->lastError = error;
    return error == fnfErr || error == dirNFErr ? GS_NOT_FOUND : GS_IO;
}
static OSErr GMDirectory(short volume, long parent, ConstStr255Param name, long *directory) {
    CInfoPBRec pb;
    OSErr error;
    memset(&pb, 0, sizeof(pb));
    pb.dirInfo.ioNamePtr = (StringPtr)name;
    pb.dirInfo.ioVRefNum = volume;
    pb.dirInfo.ioDrDirID = parent;
    pb.dirInfo.ioFDirIndex = 0;
    error = PBGetCatInfoSync(&pb);
    if (!error) {
        if (!(pb.dirInfo.ioFlAttrib & 16))
            return dirNFErr;
        *directory = pb.dirInfo.ioDrDirID;
    }
    return error;
}
static int GMPath(GSMacStore *s, const char *path, int create, FSSpec *spec) {
    const char *p = path, *start = path;
    Str31 name;
    size_t n;
    long parent = s->directory, next;
    OSErr error;
    if (!path || !*path)
        return GB_BAD;
    for (;; ++p) {
        if (*p && *p != '/') {
            if ((unsigned char)*p < 32 || *p == ':' || (unsigned char)*p >= 127)
                return GB_BAD;
            continue;
        }
        n = (size_t)(p - start);
        if (!n || n > 31 || (n == 1 && *start == '.') || (n == 2 && !memcmp(start, "..", 2)))
            return GB_BAD;
        name[0] = (unsigned char)n;
        memcpy(name + 1, start, n);
        if (!*p) {
            error = FSMakeFSSpec(s->volume, parent, name, spec);
            return !error || error == fnfErr ? 0 : GMError(s, error);
        }
        error = GMDirectory(s->volume, parent, name, &next);
        if (error == fnfErr && create)
            error = DirCreate(s->volume, parent, name, &next);
        if (error)
            return GMError(s, error);
        parent = next;
        start = p + 1;
    }
}
int GSMacReadLimit(GSMacStore *s, const char *path, unsigned char **bytes, size_t *length,
                    size_t maximum) {
    FSSpec spec;
    short file;
    long n, count, done = 0;
    unsigned char *data;
    OSErr error, closed;
    int result;
    if (!s || !path || !bytes || !length) return GB_BAD;
    *bytes = NULL;
    *length = 0;
    result = GMPath(s, path, 0, &spec);
    if (result)
        return result;
    error = FSpOpenDF(&spec, fsRdPerm, &file);
    if (error)
        return GMError(s, error);
    error = GetEOF(file, &n);
    if (error || n < 0) {
        FSClose(file);
        return GMError(s, error ? error : paramErr);
    }
    if ((size_t)n > maximum) {
        error = FSClose(file);
        return error ? GMError(s, error) : GB_SPACE;
    }
    data = (unsigned char *)malloc(n ? (size_t)n : 1);
    if (!data) {
        FSClose(file);
        return GB_MEMORY;
    }
    while (!error && done < n) {
        count = n - done;
        if (count > 32768)
            count = 32768;
        error = FSRead(file, &count, data + done);
        done += count;
        if (!error && !count)
            error = eofErr;
    }
    closed = FSClose(file);
    if (!error)
        error = closed;
    if (error) {
        free(data);
        return GMError(s, error);
    }
    *bytes = data;
    *length = (size_t)n;
    return 0;
}
static int GMRead(void *context, const char *path, unsigned char **bytes, size_t *length) {
    return GSMacReadLimit((GSMacStore *)context, path, bytes, length, (size_t)-1);
}
static int GMTokenValid(const char *token) {
    size_t i;
    if (!token || strlen(token) != 29 || token[8] != '-')
        return 0;
    for (i = 0; i < 29; ++i)
        if (i != 8 &&
            !((token[i] >= '0' && token[i] <= '9') || (token[i] >= 'a' && token[i] <= 'f')))
            return 0;
    return 1;
}
static int GMProtected(const char *path) {
    return !strcmp(path, "HEAD") || !strcmp(path, "index") || !strcmp(path, "ghclient-map") || !strcmp(path, "ghclient-merge") || !strcmp(path,"ghclient-rebase") ||
           !strncmp(path, "refs/", 5) || !strcmp(path,"ghclient-origin") || !strcmp(path,"ghclient-push") ||
           !strncmp(path,"ghclient-upstreams/",18) || !strncmp(path,"ghclient-branch-log/",19) || !strcmp(path,"ghclient-saved-work") || !strcmp(path,"ghclient-stash-log");
}
static OSErr GMCatalog(const FSSpec *spec, CInfoPBRec *pb) {
    memset(pb, 0, sizeof(*pb));
    pb->hFileInfo.ioNamePtr = (StringPtr)spec->name;
    pb->hFileInfo.ioVRefNum = spec->vRefNum;
    pb->hFileInfo.ioDirID = spec->parID;
    return PBGetCatInfoSync(pb);
}
static int GMWriteReady(GSMacStore *s) {
    GSRepository r;
    r.context = s;
    r.read = GMRead;
    r.replace = NULL;
    return GTNormalWriteAllowed(&r);
}
int GSMacLeave(GSMacStore *s) {
    OSErr error;
    if (!s || !s->leaseHeld)
        return GB_BAD;
    error = FSClose(s->leaseRef);
    if (error)
        return GMError(s, error);
    s->leaseHeld = 0;
    s->recoveryOwner = 0;
    s->leaseRef = 0;
    s->ownerToken[0] = 0;
    return 0;
}
int GSMacEnter(GSMacStore *s, int recoveryOwner) {
    FSSpec spec;
    CInfoPBRec pb;
    Str31 name;
    OSErr error;
    int result;
    if (!s || s->leaseHeld || (recoveryOwner != 0 && recoveryOwner != 1))
        return GB_BAD;
    s->lastError = noErr;
    name[0] = 15;
    memcpy(name + 1, "ghclient-runner", 15);
    error = FSMakeFSSpec(s->volume, s->directory, name, &spec);
    if (error == fnfErr) {
        error = FSpCreate(&spec, 'GHCl', 'GHRn', smSystemScript);
        if (error == dupFNErr)
            error = noErr;
    }
    if (error)
        return GMError(s, error);
    /* fsRdWrPerm can fall back to browsing on AFP. fsWrPerm must grant an
       exclusive writer; classic File Manager also permits reads on that open. */
    error = FSpOpenDF(&spec, fsWrPerm, &s->leaseRef);
    if (error) {
        s->lastError = error;
        return error == opWrErr || error == permErr || error == -5006 ? GS_CONFLICT : GS_IO;
    }
    s->leaseHeld = 1;
    s->recoveryOwner = recoveryOwner;
    s->ownerToken[0] = 0;
    error = GMCatalog(&spec, &pb);
    if (error)
        result = GMError(s, error);
    else
        result = (pb.hFileInfo.ioFlAttrib & 16) || pb.hFileInfo.ioFlFndrInfo.fdCreator != 'GHCl' ||
                         pb.hFileInfo.ioFlFndrInfo.fdType != 'GHRn' || pb.hFileInfo.ioFlLgLen ||
                         pb.hFileInfo.ioFlRLgLen
                     ? GS_FORMAT
                     : 0;
    if (!result && !recoveryOwner)
        result = GMWriteReady(s);
    if (result) {
        GSMacLeave(s);
        return result;
    }
    return 0;
}
int GSMacOwnerToken(GSMacStore *s, const char *token) {
    if (!s || !s->leaseHeld || !s->recoveryOwner || !GMTokenValid(token))
        return GB_BAD;
    memcpy(s->ownerToken, token, 30);
    return 0;
}
/* Publish fully written private temporaries by rename/exchange. Interrupted
   partial temporaries are retained and skipped, never mistaken for live locks
   or deleted based on age. Each name is created exclusively. */
static int GMTemporary(GSMacStore *s, long parent, const void *bytes, size_t length, OSType type,
                       FSSpec *spec) {
    static unsigned long serial = 0;
    unsigned long attempt;
    Str31 name;
    char text[32];
    short file;
    size_t done = 0;
    long count;
    OSErr error, closed;
    if (length > 0x7fffffffUL)
        return GB_SPACE;
    for (attempt = 0; attempt < 4096; ++attempt) {
        sprintf(text, ".gct%08lx", serial++);
        name[0] = (unsigned char)strlen(text);
        memcpy(name + 1, text, name[0]);
        error = FSMakeFSSpec(s->volume, parent, name, spec);
        if (!error)
            continue;
        if (error != fnfErr)
            return GMError(s, error);
        error = FSpCreate(spec, 'GHCl', type, smSystemScript);
        if (error == dupFNErr)
            continue;
        if (error)
            return GMError(s, error);
        error = FSpOpenDF(spec, fsWrPerm, &file);
        if (error)
            return GMError(s, error);
        while (!error && done < length) {
            count = (long)(length - done > 32768 ? 32768 : length - done);
            error = FSWrite(file, &count, (const unsigned char *)bytes + done);
            if (count > 0)
                done += (size_t)count;
            else if (!error)
                error = ioErr;
        }
        if (!error)
            error = SetEOF(file, (long)length);
        closed = FSClose(file);
        if (!error)
            error = closed;
        if (!error)
            error = FlushVol(NULL, s->volume);
        return error ? GMError(s, error) : 0;
    }
    return GB_SPACE;
}
static int GMGuardState(GSMacStore *s, const char *path, FSSpec *spec, int create, int *exists) {
    char key[128], marker[160];
    CInfoPBRec pb;
    unsigned char *bytes = NULL;
    size_t n = 0, length;
    int result;
    if (!s || !s->leaseHeld || !s->recoveryOwner || !GMTokenValid(s->ownerToken) || !path ||
        !GMProtected(path) || strlen(path) > 100)
        return GB_BAD;
    sprintf(key, "%s.lock", path);
    sprintf(marker, "GHGUARD1\n%s\n%s\n", s->ownerToken, path);
    length = strlen(marker);
    result = GMPath(s, key, create, spec);
    if (result == GS_NOT_FOUND) {
        *exists = 0;
        return create ? result : 0;
    }
    if (result)
        return result;
    result = GMRead(s, key, &bytes, &n);
    *exists = !result;
    if (result == GS_NOT_FOUND)
        return 0;
    if (!result && (n != length || memcmp(bytes, marker, n)))
        result = GS_CONFLICT;
    free(bytes);
    if (!result) {
        OSErr error = GMCatalog(spec, &pb);
        if (error)
            result = GMError(s, error);
        else if (pb.hFileInfo.ioFlFndrInfo.fdCreator != 'GHCl' ||
                 pb.hFileInfo.ioFlFndrInfo.fdType != 'GCGd' || pb.hFileInfo.ioFlRLgLen)
            result = GS_CONFLICT;
    }
    return result;
}
int GSMacGuard(GSMacStore *s, const char *path, int claim) {
    FSSpec guard, temp;
    char marker[160];
    int result, exists;
    OSErr error;
    if (claim != 0 && claim != 1)
        return GB_BAD;
    result = GMGuardState(s, path, &guard, claim, &exists);
    if (result)
        return result;
    if (claim && !exists) {
        sprintf(marker, "GHGUARD1\n%s\n%s\n", s->ownerToken, path);
        result = GMTemporary(s, guard.parID, marker, strlen(marker), 'GCGd', &temp);
        if (result)
            return result;
        error = FSpRename(&temp, guard.name);
        if (error)
            return error == dupFNErr ? GS_CONFLICT : GMError(s, error);
    } else if (!claim && exists) {
        error = FSpDelete(&guard);
        if (error)
            return GMError(s, error);
    }
    error = FlushVol(NULL, s->volume);
    return error ? GMError(s, error) : 0;
}
int GSMacGuardCheck(GSMacStore *s, const char *path) {
    FSSpec spec;
    int result, exists = 0;
    result = GMGuardState(s, path, &spec, 0, &exists);
    return result ? result : exists ? 0 : GS_NOT_FOUND;
}
static int GMCheckoutEnter(void *context) { return GSMacEnter((GSMacStore *)context, 1); }
static int GMCheckoutLeave(void *context) { return GSMacLeave((GSMacStore *)context); }
static int GMCheckoutOwner(void *context, const char *token) {
    return GSMacOwnerToken((GSMacStore *)context, token);
}
static int GMCheckoutGuard(void *context, const char *path, int action) {
    if (action == GT_VERIFY)
        return GSMacGuardCheck((GSMacStore *)context, path);
    if (action != GT_RELEASE && action != GT_CLAIM)
        return GB_BAD;
    return GSMacGuard((GSMacStore *)context, path, action);
}
int GSMacCheckoutControl(GSMacStore *s, GTControl *out) {
    if (!s || !out)
        return GB_BAD;
    out->context = s;
    out->enter = GMCheckoutEnter;
    out->leave = GMCheckoutLeave;
    out->owner = GMCheckoutOwner;
    out->guard = GMCheckoutGuard;
    return 0;
}
static int GMOwnerAccess(GSMacStore *s, const char *path) {
    FSSpec spec;
    int result, exists;
    if (!s->leaseHeld || !s->recoveryOwner || !GMTokenValid(s->ownerToken))
        return GB_BAD;
    if (!strcmp(path, "ghclient-runner"))
        return GB_BAD;
    if (!GMProtected(path))
        return 0;
    result = GMGuardState(s, path, &spec, 0, &exists);
    return result ? result : exists ? 0 : GS_CONFLICT;
}
static int GMReplaceOwned(GSMacStore *s, const char *path, const void *expected, size_t en,
                          const void *bytes, size_t length) {
    FSSpec target, temp;
    unsigned char *old = NULL;
    size_t n = 0;
    int result, exists;
    OSErr error;
    result = GMOwnerAccess(s, path);
    if (result)
        return result;
    result = GMPath(s, path, 1, &target);
    if (result)
        return result;
    result = GMRead(s, path, &old, &n);
    exists = !result;
    if (expected) {
        if (result == GS_NOT_FOUND || (!result && (n != en || (n && memcmp(old, expected, n)))))
            result = GS_CONFLICT;
    } else if (!result)
        result = GS_CONFLICT;
    else if (result == GS_NOT_FOUND)
        result = 0;
    free(old);
    if (result)
        return result;
    result = GMTemporary(s, target.parID, bytes, length, 'GCTp', &temp);
    if (result)
        return result;
    error = exists ? FSpExchangeFiles(&temp, &target) : FSpRename(&temp, target.name);
    if (error)
        return error == dupFNErr ? GS_CONFLICT : GMError(s, error);
    if (exists) {
        error = FSpDelete(&temp);
        if (error)
            return GMError(s, error);
    }
    error = FlushVol(NULL, s->volume);
    return error ? GMError(s, error) : 0;
}
int GSMacErase(GSMacStore *s, const char *path, const void *expected, size_t n) {
    FSSpec target;
    unsigned char *old = NULL;
    size_t length = 0;
    int result;
    OSErr error;
    if (!s || !path || (!expected && n))
        return GB_BAD;
    result = GMOwnerAccess(s, path);
    if (result)
        return result;
    result = GMPath(s, path, 0, &target);
    if (result)
        return result;
    result = GMRead(s, path, &old, &length);
    if (!result && (length != n || (n && memcmp(old, expected, n))))
        result = GS_CONFLICT;
    free(old);
    if (result)
        return result;
    error = FSpDelete(&target);
    if (!error)
        error = FlushVol(NULL, s->volume);
    return error ? GMError(s, error) : 0;
}
static int GMReplaceLegacy(void *context, const char *path, const void *expected,
                           size_t expectedLength, const void *bytes, size_t length) {
    GSMacStore *s = (GSMacStore *)context;
    FSSpec target, lock;
    Str31 lockName;
    short file;
    unsigned char *old = NULL;
    size_t oldLength, done = 0;
    long count;
    OSErr error, closed;
    int result, exists;
    if (length > 0x7fffffffUL)
        return GB_SPACE;
    result = GMPath(s, path, 1, &target);
    if (result)
        return result;
    if (target.name[0] > 26)
        return GB_BAD;
    lockName[0] = target.name[0] + 5;
    memcpy(lockName + 1, target.name + 1, target.name[0]);
    memcpy(lockName + 1 + target.name[0], ".lock", 5);
    error = FSMakeFSSpec(target.vRefNum, target.parID, lockName, &lock);
    if (error && error != fnfErr)
        return GMError(s, error);
    error = FSpCreate(&lock, 'GHCl', 'GHLk', smSystemScript);
    if (error == dupFNErr)
        return GS_CONFLICT;
    if (error)
        return GMError(s, error);
    result = GMRead(s, path, &old, &oldLength);
    exists = result == 0;
    if (expected) {
        if (result == GS_NOT_FOUND ||
            (!result && (oldLength != expectedLength || memcmp(old, expected, oldLength))))
            result = GS_CONFLICT;
    } else {
        if (!result)
            result = GS_CONFLICT;
        else if (result == GS_NOT_FOUND)
            result = 0;
    }
    free(old);
    if (result) {
        FSpDelete(&lock);
        return result;
    }
    error = FSpOpenDF(&lock, fsWrPerm, &file);
    if (!error) {
        while (!error && done < length) {
            count = (long)(length - done);
            if (count > 32768)
                count = 32768;
            error = FSWrite(file, &count, (const unsigned char *)bytes + done);
            done += (size_t)count;
            if (!error && !count)
                error = ioErr;
        }
        closed = FSClose(file);
        if (!error)
            error = closed;
    }
    if (!error)
        error = FlushVol(NULL, s->volume);
    if (error) {
        FSpDelete(&lock);
        return GMError(s, error);
    }
    /* Exchange keeps an existing target continuously present; rename creates
       an absent target without overwriting a concurrently created file. */
    error = exists ? FSpExchangeFiles(&lock, &target) : FSpRename(&lock, target.name);
    if (error) {
        FSpDelete(&lock);
        return error == dupFNErr ? GS_CONFLICT : GMError(s, error);
    }
    if (exists) {
        error = FSpDelete(&lock);
        if (error)
            return GMError(s, error);
    }
    error = FlushVol(NULL, s->volume);
    return error ? GMError(s, error) : 0;
}
static int GMReplace(void *context, const char *path, const void *expected, size_t en,
                     const void *bytes, size_t length) {
    GSMacStore *s = (GSMacStore *)context;
    int result, closed, acquired;
    if (!s || !path || !strcmp(path, "ghclient-runner") || (!bytes && length) || (!expected && en))
        return GB_BAD;
    acquired = !s->leaseHeld;
    result = acquired ? GSMacEnter(s, 0) : s->recoveryOwner ? 0 : GMWriteReady(s);
    if (result)
        return result;
    result = s->recoveryOwner ? GMReplaceOwned(s, path, expected, en, bytes, length)
                              : GMReplaceLegacy(context, path, expected, en, bytes, length);
    if (acquired) {
        closed = GSMacLeave(s);
        if (!result)
            result = closed;
    }
    if (!result)
        s->lastError = noErr;
    return result;
}
int GSMacAttach(GSRepository *repository, GSMacStore *store, const FSSpec *folder, int create) {
    OSErr error;
    long directory;
    if (!repository || !store || !folder)
        return GB_BAD;
    memset(store, 0, sizeof(*store));
    error = GMDirectory(folder->vRefNum, folder->parID, folder->name, &directory);
    if (error == fnfErr && create)
        error = FSpDirCreate(folder, smSystemScript, &directory);
    if (error)
        return GMError(store, error);
    store->volume = folder->vRefNum;
    store->directory = directory;
    repository->context = store;
    repository->read = GMRead;
    repository->replace = GMReplace;
    return 0;
}
