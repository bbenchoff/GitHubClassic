/* Real native working-file diagnostic, exclusively on disposable work media.
   Returned checkpoint errors/reopened contexts are not process termination. */
static GXCheckout gCheckoutProbe;
static int GXCheckMoveCount, GXCheckFailMove;
static unsigned char GXCheckInfo[32] = {'B', 'I', 'N', 'A', 'G', 'H', 'C', 'l', 0, 6};
static const char *GXCaseGit =
    "Caf\xc3\xa9:long parent component/Another long folder component/Change";
static int GXCheckPoint(void *unused, const char *point) {
    (void)unused;
    if (!strcmp(point, "file-move") && ++GXCheckMoveCount == GXCheckFailMove)
        return GS_IO;
    return 0;
}
/* Opt-in, one-shot UI fixtures on a newly staged GH Recovery volume only.
   Uses real returned native checkpoint errors; no journal is host-fabricated. */
static int gRecoveryProbeMode,gRecoveryProbeMoves;
static int RecoveryUIProbePoint(void *context,const char *point) {
    GXCheckout *x=(GXCheckout *)context;unsigned char *bytes=NULL;size_t n=0;int result=0;
    if(gRecoveryProbeMode==2 && !strcmp(point,"checkout-journal")) {
        result=x->raw.read(x->raw.context,"checkout-journal",&bytes,&n);
        if(!result)result=n>15 && memcmp(bytes,"GHCI0001",8) && bytes[15]==GC_COMMITTED?GS_IO:0;
        free(bytes);return result;
    }
    if(gRecoveryProbeMode!=2 && !strcmp(point,"file-move") && ++gRecoveryProbeMoves==(gRecoveryProbeMode?1:5))return GS_IO;
    return 0;
}
static int GXCheckStage(GSRepository *r, GIIndex *i, const char *path, const char *data,
                        const char *resource) {
    return GIStageMac(r, i, path, data, strlen(data), GXCheckInfo, resource, strlen(resource));
}
static int GXCheckCommit(GSRepository *r, GIIndex *index, const char *branch) {
    unsigned char tree[20], oid[20];
    int result = GIWriteTree(r, index, tree);
    if (!result)
        result = GSCommit(r, branch, tree, NULL, "Checkout Test <test@example.invalid>",
                          "Checkout Test <test@example.invalid>", "1792018800", "+0000",
                          "Native checkout fixture", oid);
    return result;
}
static int GXCheckSetup(const FSSpec *work) {
    FSSpec db;
    GSMacStore root, store;
    GSRepository unused, r;
    GIIndex index;
    OSErr error;
    int result = GSMacAttach(&unused, &root, work, 0);
    GIInit(&index);
    if (!result) {
        error = FSMakeFSSpec(root.volume, root.directory, "\p.git", &db);
        result = error && error != fnfErr ? GS_IO : GSMacAttach(&r, &store, &db, 1);
    }
    /* Never reset an existing populated fixture or a selected user repository. */
    if (!result)
        result = GSInit(&r, "refs/heads/main");
    if (!result)
        result = GXCheckStage(&r, &index, "Edit", "old data\r\n", "old resource");
    if (!result)
        result = GXCheckStage(&r, &index, "To Folder", "old file", "fork file");
    if (!result)
        result = GXCheckStage(&r, &index, "To File/Child", "old child", "fork child");
    if (!result)
        result = GXCheckStage(&r, &index, "Remove", "remove me", "remove fork");
    if (!result)
        result = GXCheckStage(&r, &index, "Keep", "unchanged", "same fork");
    if (!result)
        result = GXCheckStage(&r, &index, GXCaseGit, "case old", "case old resource");
    if (!result)
        result = GXCheckCommit(&r, &index, "refs/heads/a");
    GIFree(&index);
    GIInit(&index);
    if (!result)
        result = GXCheckStage(&r, &index, "Edit", "new data\n\xff", "new resource");
    if (!result)
        result = GXCheckStage(&r, &index, "To Folder/Child", "new child", "new child fork");
    if (!result)
        result = GXCheckStage(&r, &index, "To File", "new file", "new file fork");
    if (!result)
        result = GXCheckStage(&r, &index, "Added/Nested/Thing", "added data", "added resource");
    if (!result)
        result = GXCheckStage(&r, &index, "Keep", "unchanged", "same fork");
    if (!result)
        result = GXCheckStage(&r, &index, GXCaseGit, "case new", "case new resource");
    if (!result)
        result = GXCheckCommit(&r, &index, "refs/heads/b");
    GIFree(&index);
    return result;
}
/* Simulate a Finder capitalization edit without assuming FSpRename supports a
   direct same-collation rename. Both catalog moves retain the original ID. */
static int GXCheckRename(GXCheckout *x, const char *path, const char *wanted) {
    FSSpec spec, temporary;
    Str31 name;
    long id;
    int kind, result;
    OSErr error;
    result = GFResolve(&x->root, path, &spec, &kind, &id, &x->lastError);
    if (result || !kind)
        return result ? result : GS_NOT_FOUND;
    if (spec.name[0] == strlen(wanted) && !memcmp(spec.name + 1, wanted, spec.name[0]))
        return 0;
    name[0] = 17;
    memcpy(name + 1, "GX case temporary", 17);
    error = FSpRename(&spec, name);
    if (!error)
        error = FSMakeFSSpec(spec.vRefNum, spec.parID, name, &temporary);
    if (!error) {
        name[0] = (unsigned char)strlen(wanted);
        memcpy(name + 1, wanted, name[0]);
        error = FSpRename(&temporary, name);
    }
    if (error) {
        x->lastError = error;
        return GS_IO;
    }
    return FlushVol(NULL, x->store.volume) ? GS_IO : 0;
}
static int GXCheckCaseEdits(GXCheckout *x) {
    int result = GXCheckRename(x, "To File", "TO FILE");
    if (!result)
        result = GXCheckRename(x, "To Folder", "TO FOLDER");
    /* Real RelString/HFS case folding, including MacRoman e-acute -> E-acute. */
    if (!result)
        result = GXCheckRename(x, "Caf\x8e/long parent component", "CAF\x83/LONG PARENT COMPONENT");
    if (!result)
        result = GXCheckRename(x, "CAF\x83/LONG PARENT COMPONENT:Another long folder component",
                               "ANOTHER LONG FOLDER COMPONENT");
    return result;
}
static int GXCheckInventory(GXCheckout *x, const char *disk, const char *label) {
    GFInventory inventory;
    GPMap map;
    GQWork root;
    size_t i;
    FILE *file;
    char path[128];
    int result;
    GFInit(&inventory);
    GPInit(&map);
    result = GPLoad(&x->raw, GWMacNameEqual, NULL, &map);
    if (!result)
        result = GFCollect(&x->root, &map, &inventory, &x->lastError);
    if (!result) {
        sprintf(path, "%s:Checkout %s", disk, label);
        file = fopen(path, "wb");
        if (!file)
            result = GS_IO;
        else {
            memset(&root, 0, sizeof(root));
            root.path = root.native = "";
            root.file.present = 2;
            if (fwrite("GFNAT001", 1, 8, file) != 8 ||
                GFWriteWord(file, (GBWord)inventory.count + 1))
                result = GS_IO;
            if (!result)
                result = GFWriteItem(file, &root, &inventory.root);
            for (i = 0; !result && i < inventory.count; ++i)
                result = GFWriteItem(file, inventory.items + i, inventory.catalog + i);
            if (fclose(file) && !result)
                result = GS_IO;
        }
    }
    GPFree(&map);
    GFFree(&inventory);
    return result;
}
static int TestNativeCheckout(const char *disk) {
    GXCheckout *x = &gCheckoutProbe;
    FSSpec work;
    Str255 p;
    GQError why;
    char path[128];
    int result, resumed = 0, restored = 0, committed = 0, gated = 0;
    FILE *log;
    /* Static context retains any failed close. Refuse reuse until it closes. */
    result = GXClose(x);
    sprintf(path, "%s:Checkout Work", disk);
    Pascal(path, p);
    if (!result)
        result = FSMakeFSSpec(0, 0, p, &work) ? GS_IO : 0;
    if (!result)
        result = GXCheckSetup(&work);
    if (!result)
        result = GXAttach(x, &work);
    if (!result)
        result = GXBranch(x, "refs/heads/a", &why);
    if (!result)
        result = GXCheckCaseEdits(x);
    if (!result)
        result = GXCheckInventory(x, disk, "Before");
    if (!result) {
        GXCheckMoveCount = 0;
        GXCheckFailMove = 5;
        x->checkpoint = GXCheckPoint;
        if (GXBranch(x, "refs/heads/b", &why) != GS_IO)
            result = GS_FORMAT;
    }
    if (!result) {
        gated = GTWriteAllowed(&x->raw) == GC_RECOVERY;
        if (!gated)
            result = GS_FORMAT;
    }
    if (!result)
        result = GXClose(x);
    if (!result)
        result = GXAttach(x, &work);
    if (!result)
        result = GXRecover(x, 0);
    if (!result) {
        resumed = 1;
        result = GXCheckInventory(x, disk, "Resumed");
    }
    if (!result)
        result = GXBranch(x, "refs/heads/a", &why);
    if (!result)
        result = GXCheckCaseEdits(x);
    if (!result)
        result = GXCheckInventory(x, disk, "Rollback Before");
    if (!result) {
        GXCheckMoveCount = 0;
        GXCheckFailMove = 7;
        x->checkpoint = GXCheckPoint;
        if (GXBranch(x, "refs/heads/b", &why) != GS_IO)
            result = GS_FORMAT;
    }
    if (!result)
        result = GXClose(x);
    if (!result)
        result = GXAttach(x, &work);
    if (!result)
        result = GXRecover(x, 1);
    if (!result) {
        restored = 1;
        result = GXCheckInventory(x, disk, "Restored");
    }
    if (!result)
        result = GXBranch(x, "refs/heads/b", &why);
    if (!result) {
        committed = 1;
        result = GXCheckInventory(x, disk, "Final");
    }
    sprintf(path, "%s:Native Checkout.txt", disk);
    log = fopen(path, "wb");
    if (log) {
        fprintf(log,
                "GHClient native checkout "
                "v2\rresult=%d\rfile_manager=%d\rresumed=%d\rrestored=%d\rcommitted=%d\rgated=%d\r",
                result, (int)x->lastError, resumed, restored, committed, gated);
        fclose(log);
    }
    {
        int closed = GXClose(x);
        if (!result)
            result = closed;
    }
    return result;
}

/* Deliberately stop INSIDE a move callback, before either fork or the runner
   access path is closed. Only disposable, precreated work-media folders enter
   this path. Force Quit is performed through the OS, not simulated by return. */
static GXCheckout gInterruptedCheckout;
static const char *GXHoldDisk, *GXHoldSide;
static int GXHoldMoves;
static int GXHoldPoint(void *unused, const char *point) {
    GXCheckout *x = &gInterruptedCheckout;
    char path[128], data[41], resource[41];
    FILE *file;
    EventRecord event;
    int wasBusy;
    (void)unused;
    if (strcmp(point, "file-move") || ++GXHoldMoves != 7)
        return 0;
    sprintf(path, "%s:Kill %s Held.txt", GXHoldDisk, GXHoldSide);
    file = fopen(path, "wb");
    if (!file)
        return GS_IO;
    GBOIDFormat(x->held.identity.dataOID, data);
    GBOIDFormat(x->held.identity.resourceOID, resource);
    fprintf(file,
            "GHClient native held checkout "
            "v1\rvolume=%d\rlease=%d\rdata_open=%d\rresource_open=%d\rfile_id=%ld\rparent=%"
            "ld\rdata=%s\rresource=%s\r",
            x->store.volume, x->store.leaseHeld, x->held.haveData, x->held.haveResource,
            x->held.catalog.id, x->held.file.parID, data, resource);
    if (fclose(file) || FlushVol(NULL, x->store.volume))
        return GS_IO;
    wasBusy = gBusy;
    gBusy = 1;
    SetStatus("Checkout held for OS Force Quit test. Both forks and repository lease remain open. "
              "Escape aborts the hold.");
    for (;;) {
        if (WaitNextEvent(everyEvent, &event, 1, NULL)) {
            if (event.what == updateEvt && (WindowPtr)event.message == gWindow) {
                BeginUpdate(gWindow);
                Draw();
                EndUpdate(gWindow);
            } else if (event.what == keyDown && (event.message & charCodeMask) == 27) {
                gBusy = wasBusy;
                return GS_IO;
            }
        }
    }
}
/* Explicit opt-in fixtures, never a selected user repository. Each starts in
   a precreated empty folder; the control is consumed before any work begins. */
static int TestRecoveryUIControl(void) {
    const char *folders[3]={"Checkout Forward","Checkout Undo","Checkout Cleanup"};
    GXCheckout *x=&gInterruptedCheckout;GXPendingInfo pending;GQError why;
    FILE *file;FSSpec work;Str255 p;char mode[40],path[128],label[64],status[256];
    int i,result=0,stopped=0,closed;
    file=fopen("GH Recovery:Recovery Control","rb");if(!file)return 0;
    memset(mode,0,sizeof(mode));if(!fgets(mode,sizeof(mode),file))mode[0]=0;fclose(file);
    mode[strcspn(mode,"\r\n")]=0;if(!strcmp(mode,"off"))return 0;
    if(strcmp(mode,"prepare-all")){SetStatus("Unknown recovery fixture control; no repository changed.");return 1;}
    file=fopen("GH Recovery:Recovery Control","wb");if(!file)return 1;
    if(fputs("off\r",file)==EOF)result=GS_IO;if(fclose(file))result=GS_IO;
    for(i=0;!result && i<3;++i) {
        result=GXClose(x);sprintf(path,"GH Recovery:%s",folders[i]);Pascal(path,p);
        if(!result && FSMakeFSSpec(0,0,p,&work))result=GS_IO;
        if(!result)result=GXCheckSetup(&work);
        if(!result)result=GXAttach(x,&work);
        if(!result)result=GXBranch(x,"refs/heads/a",&why);
        if(!result)result=GXCheckCaseEdits(x);
        if(!result){sprintf(label,"UI %d Before",i);result=GXCheckInventory(x,"GH Recovery",label);}
        if(!result) {
            gRecoveryProbeMode=i==2?2:0;gRecoveryProbeMoves=0;
            x->checkpoint=RecoveryUIProbePoint;x->checkpointContext=x;
            stopped=GXBranch(x,"refs/heads/b",&why);x->checkpoint=NULL;
            if(stopped!=GS_IO)result=stopped?stopped:GS_CONFLICT;
        }
        if(!result && i==1) {
            gRecoveryProbeMode=1;gRecoveryProbeMoves=0;
            x->checkpoint=RecoveryUIProbePoint;stopped=GXRecover(x,1);x->checkpoint=NULL;
            if(stopped!=GS_IO)result=stopped?stopped:GS_CONFLICT;
        }
        if(!result)result=GXPending(x,&pending);
        if(!result && (!pending.pending || (i==0 && (!pending.canFinish || !pending.canRestore)) ||
            (i==1 && (pending.canFinish || !pending.canRestore)) ||
            (i==2 && (!pending.canFinish || pending.canRestore || pending.phase!=GC_COMMITTED))))result=GS_CONFLICT;
        sprintf(path,"GH Recovery:UI %d Prepared.txt",i);file=fopen(path,"wb");
        if(file){fprintf(file,"result=%d\rcheckpoint_result=%d\rphase=%lu\rfinish=%d\rundo=%d\r",result,stopped,
            (unsigned long)(result?0:pending.phase),result?0:pending.canFinish,result?0:pending.canRestore);fclose(file);}
        closed=GXClose(x);if(!result)result=closed;
    }
    snprintf(status,sizeof(status),"Native recovery UI fixtures: %d. Review the disposable GH Recovery folders.",result);SetStatus(status);return 1;
}
/* One-use, explicitly staged replay fault fixtures. This is a returned native
   I/O checkpoint error after entering the real metadata journal phase, not a process/power kill.
   Never arm this hook on the selected workspace or an arbitrary folder. */
static int ReplayRecoveryFault(void *context,const char *point) {
    GXCheckout *x=(GXCheckout *)context;unsigned char *bytes=NULL;size_t n=0;int result;
    if(strcmp(point,"checkout-journal"))return 0;
    result=x->raw.read(x->raw.context,"checkout-journal",&bytes,&n);
    if(!result && n>15 && memcmp(bytes,"GHCI0001",8) && GXWord(bytes+12)==GC_METADATA)result=GS_IO;
    free(bytes);return result;
}
static int TestRebaseRecoveryControl(void) {
    static const char *names[3]={"RI2 Dirty","RI2 Finish","RI2 Restore"};
    static const char headHex[]="a95d80146ed97a09c45d126bce3db2797cdcf47b";
    static const char ontoHex[]="5430d2ce05606628978dd2235b2592ba09f1eb00";
    GXCheckout *x=&gInterruptedCheckout;GXRebaseReview *review;RLSession *saved;
    RQLimits q;RLLimits l;GXRebaseOutcome outcome;GXPendingInfo pending;
    TMResolution choice;TMOutput output;GRContents owned;const TMNode *node;
    GQError why;FSSpec folder,control;Str255 path;unsigned char head[20],onto[20];
    char mode[64],native[100],hex[41],status[256],*branch=NULL;
    FILE *file;size_t i,j;int result=0,closed,started=0,installed=0,stopped=0;
    file=fopen("GH Replay Faults 2:Recovery Control","rb");if(!file)return 0;
    memset(mode,0,sizeof(mode));if(!fgets(mode,sizeof(mode),file))mode[0]=0;fclose(file);
    mode[strcspn(mode,"\r\n")]=0;
    if(strcmp(mode,"rebase-recovery-20261018-v2")){SetStatus("Replay recovery fixture is unavailable or already consumed. No repository changed.");return 1;}
    if(FSMakeFSSpec(0,0,"\pGH Replay Faults 2:Recovery Control",&control))return 1;
    review=(GXRebaseReview *)calloc(1,sizeof(*review));saved=(RLSession *)calloc(1,sizeof(*saved));
    if(!review || !saved){free(review);free(saved);SetStatus("Not enough memory to prepare replay recovery fixtures.");return 1;}
    GXRebaseReviewInit(review);RLSessionInit(saved);GRContentsInit(&owned);EUIRebaseLimits(&q);ERLimits(&l);
    /* Refuse every folder unless all three are the pinned, unused repository
       snapshot. Normal writer gates reject any existing saved operation. */
    for(i=0;!result && i<3;++i) {
        result=GXClose(x);sprintf(native,"GH Build:%s",names[i]);Pascal(native,path);
        if(!result && FSMakeFSSpec(0,0,path,&folder))result=GS_IO;
        if(!result)result=GXAttach(x,&folder);
        if(!result)result=GTNormalWriteAllowed(&x->raw);
        if(!result)result=GSHead(&x->raw,&branch,head);
        if(!result){GBOIDFormat(head,hex);if(strcmp(branch,"refs/heads/current") || strcmp(hex,headHex))result=GS_CONFLICT;}
        free(branch);branch=NULL;
        if(!result)result=GSReadRef(&x->raw,"refs/heads/incoming",onto);
        if(!result){GBOIDFormat(onto,hex);if(strcmp(hex,ontoHex))result=GS_CONFLICT;}
        closed=GXClose(x);if(!result)result=closed;
    }
    if(!result) {
        file=fopen("GH Replay Faults 2:Recovery Control","wb");if(!file)result=GS_IO;
        else {if(fputs("off\r",file)==EOF)result=GS_IO;if(fclose(file))result=GS_IO;}
        if(!result && FlushVol(NULL,control.vRefNum))result=GS_IO;
    }
    for(i=0;!result && i<3;++i) {
        sprintf(native,"GH Build:%s",names[i]);Pascal(native,path);
        if(FSMakeFSSpec(0,0,path,&folder))result=GS_IO;
        if(!result)result=GXAttach(x,&folder);
        if(!result)result=GSReadRef(&x->raw,"refs/heads/current",head);
        if(!result)result=GSReadRef(&x->raw,"refs/heads/incoming",onto);
        if(!result)result=GXRebasePrepare(x,"refs/heads/current",head,"refs/heads/incoming",onto,'\n',&q,review);
        if(!result)result=GXRebaseBegin(x,review,"Native Recovery <recovery@example.invalid>","1792339200","+0000",&l,&why,&started);
        if(!result && !started)result=GS_CONFLICT;
        if(!result)result=GXRebaseOpen(x,&l,saved);
        if(!result) {
            for(j=0;j<saved->replay.conflict.merge.count && !saved->replay.conflict.merge.files[j].conflicts;++j){}
            if(j==saved->replay.conflict.merge.count)result=GS_FORMAT;
            else {node=saved->replay.conflict.merge.files+j;result=GSMacEnter(&x->store,1);
                if(!result)result=MUIVersion(&x->raw,saved->replay.conflict.merge.snapshots+2,node->source[2],&output,&owned);
                if(x->store.leaseHeld){closed=GSMacLeave(&x->store);if(!result)result=closed;}
                memset(&choice,0,sizeof(choice));choice.node=j;choice.outputs=&output;choice.count=1;}
        }
        if(!result)result=GXRebaseResolve(x,saved->state.original,saved->state.originalLength,&choice,1,&l,&why,&installed);
        GRContentsFree(&owned);if(!result && !installed)result=GS_CONFLICT;
        if(!result)result=GXRebaseOpen(x,&l,saved);
        if(!result && saved->drafts.index.unresolved)result=GI_UNMERGED;
        stopped=0;memset(&pending,0,sizeof(pending));
        if(!result && i) {
            memset(&outcome,0,sizeof(outcome));x->checkpoint=ReplayRecoveryFault;x->checkpointContext=x;
            stopped=GXRebaseContinue(x,saved->state.original,saved->state.originalLength,&l,&why,&outcome);
            x->checkpoint=NULL;if(stopped!=GS_IO)result=stopped?stopped:GS_CONFLICT;
            closed=GXClose(x);if(!result)result=closed;
            if(!result)result=GXAttach(x,&folder);
            if(!result)result=GXPending(x,&pending);
            if(!result && (!pending.pending || !pending.canFinish || !pending.canRestore || pending.phase!=GC_METADATA))result=GS_CONFLICT;
        }
        sprintf(native,"GH Replay Faults 2:%s Prepared.txt",names[i]);file=fopen(native,"wb");
        if(file){fprintf(file,"result=%d\rcheckpoint_result=%d\rphase=%lu\rfinish=%d\rrestore=%d\r",result,stopped,(unsigned long)pending.phase,pending.canFinish,pending.canRestore);if(fclose(file) && !result)result=GS_IO;}
        else if(!result)result=GS_IO;
        closed=GXClose(x);if(!result)result=closed;GXRebaseReviewFree(review);RLSessionFree(saved);
    }
    GRContentsFree(&owned);GXRebaseReviewFree(review);RLSessionFree(saved);free(review);free(saved);
    snprintf(status,sizeof(status),"Native replay recovery fixtures: %d. Returned checkpoint errors only; review the disposable RI2 folders.",result);SetStatus(status);return 1;
}
static int TestCheckoutControl(void) {
    const char *disk = "GH Patch", *side, *folder;
    GXCheckout *x = &gInterruptedCheckout;
    FSSpec work;
    Str255 p;
    FILE *file;
    char mode[40], path[128], label[64], status[256];
    int holding, restoring, result, closed;
    GQError why;
    if(TestRebaseRecoveryControl())return 1;
    if(TestRecoveryUIControl())return 1;
    sprintf(path, "%s:Checkout Control", disk);
    file = fopen(path, "rb");
    if (!file) {
        disk = "GH Fat";
        sprintf(path, "%s:Checkout Control", disk);
        file = fopen(path, "rb");
    }
    if (!file)
        return 0;
    memset(mode, 0, sizeof(mode));
    if (!fgets(mode, sizeof(mode), file))
        mode[0] = 0;
    fclose(file);
    mode[strcspn(mode, "\r\n")] = 0;
    if (!strcmp(mode, "off"))
        return 0;
    holding = !strcmp(mode, "hold-forward") || !strcmp(mode, "hold-restore");
    restoring = !strcmp(mode, "hold-restore") || !strcmp(mode, "restore-original");
    if (!holding && strcmp(mode, "finish-forward") && strcmp(mode, "restore-original")) {
        SetStatus("Unknown developer checkout control; no repository changed.");
        return 1;
    }
    side = restoring ? "Restore" : "Forward";
    folder = restoring ? "Checkout Restore" : "Checkout Forward";
    result = GXClose(x);
    sprintf(path, "%s:%s", disk, folder);
    Pascal(path, p);
    if (!result && FSMakeFSSpec(0, 0, p, &work))
        result = GS_IO;
    if (!result && holding)
        result = GXCheckSetup(&work);
    if (!result)
        result = GXAttach(x, &work);
    if (!result && holding)
        result = GXBranch(x, "refs/heads/a", &why);
    if (!result && holding)
        result = GXCheckCaseEdits(x);
    if (!result && holding) {
        sprintf(label, "Kill %s Before", side);
        result = GXCheckInventory(x, disk, label);
    }
    if (!result && holding) {
        GXHoldDisk = disk;
        GXHoldSide = side;
        GXHoldMoves = 0;
        x->checkpoint = GXHoldPoint;
        result = GXBranch(x, "refs/heads/b", &why);
    } else if (!result) {
        result = GXRecover(x, restoring);
        if (!result) {
            sprintf(label, "Kill %s Final", side);
            result = GXCheckInventory(x, disk, label);
        }
    }
    sprintf(path, "%s:Kill %s Result.txt", disk, side);
    file = fopen(path, "wb");
    if (file) {
        fprintf(file,
                "GHClient native interrupted checkout "
                "v1\rresult=%d\rmode=%s\rvolume=%d\rfile_manager=%d\r",
                result, mode, x->store.volume, (int)x->lastError);
        fclose(file);
    }
    closed = GXClose(x);
    if (!result)
        result = closed;
    snprintf(status, sizeof(status),
             "Native interrupted checkout %s: %d. See the work-media result and snapshots.", mode,
             result);
    SetStatus(status);
    return 1;
}

/* One-shot, disposable GH Build fixture. This is deliberately a fixed inverse
   for one known file/three-directory case, not the completed Restore planner. */
static GXCheckout gSavedCatalogProbe;
static int GXCatalogWrite(const char *name,const void *bytes,size_t length) {
    char path[128];FILE *file;int result=0;
    sprintf(path,"GH Build:%s",name);file=fopen(path,"wb");if(!file)return GS_IO;
    if(length && fwrite(bytes,1,length,file)!=length)result=GS_IO;
    if(fclose(file) && !result)result=GS_IO;
    return result;
}
static int GXCatalogPlan(const char *name,const GCTransaction *t) {
    unsigned char *p=NULL;size_t n=0;int result=GCEncode(t,GWMacNameEqual,NULL,&p,&n);
    if(!result)result=GXCatalogWrite(name,p,n);
    free(p);return result;
}
static int GXCatalogFacts(GXCheckout *x,const WSRecord *record,int inventory,const GFInventory *original) {
    size_t i,j;GFCatalog current;FSSpec spec;int kind,result=0;long id;
    if(!record->completeDirectories || record->discard.directoryCount!=3 || !record->directories)return GS_FORMAT;
    for(i=0;!result && i<record->discard.directoryCount;++i) {
        const WSDirectory *wanted=record->directories+i;
        if(inventory) {
            for(j=0;j<original->count && strcmp(original->items[j].native,record->discard.directories[i]);++j){}
            if(j==original->count || original->items[j].file.present!=2){result=GS_FORMAT;break;}
            current=original->catalog[j];
        } else {
            result=GFResolve(&x->root,record->discard.directories[i],&spec,&kind,&id,&x->lastError);
            if(!result && kind!=2)result=GS_FORMAT;
            if(!result)result=GFCatalogRead(&spec,&current,&x->lastError);
        }
        if(!result && (current.attributes!=wanted->attributes || current.created!=wanted->created ||
            current.modified!=wanted->modified || current.backup!=wanted->backup ||
            memcmp(current.finderInfo,wanted->finderInfo,32)))result=GS_FORMAT;
    }
    return result;
}
static int GXCatalogInverse(GXCheckout *x,const WSRecord *record,const unsigned char oid[20],
    const unsigned char binding[32],GXDiscardReview *review) {
    GPMap map;GCTransaction *t=&review->plan.transaction;GCMetadata *m;GCOperation *op;
    unsigned char *p=NULL;size_t n=0,i,a;int result,closed,flag;char *path;
    GPInit(&map);result=GSMacEnter(&x->store,0);
    if(!result)result=GTNormalWriteAllowed(&x->raw);
    if(!result)result=WSClone(&record->discard,GWMacNameEqual,NULL,t);
    if(!result && (t->fileCount!=1 || t->directoryCount!=3 || t->files[0].oldFile.present ||
        !t->files[0].newFile.present || strcmp(t->files[0].newPath,"To Folder") || t->metadataCount!=4))result=GS_FORMAT;
    if(!result) {
        op=t->files;path=op->oldPath;op->oldPath=op->newPath;op->newPath=path;
        op->oldFile=op->newFile;memset(&op->newFile,0,sizeof(op->newFile));op->mode=0;memset(op->metadataOID,0,20);
        t->createdDirectories=(GCDirectory *)calloc(t->directoryCount,sizeof(*t->createdDirectories));
        if(!t->createdDirectories)result=GB_MEMORY;
    }
    for(i=0;!result && i<t->directoryCount;++i) {
        GCDirectory *d=t->createdDirectories+i;const WSDirectory *old=record->directories+i;
        d->path=WSCopy(t->directories[i],strlen(t->directories[i])+1);if(!d->path){result=GB_MEMORY;break;}
        ++t->createdDirectoryCount;d->attributes=old->attributes;d->created=old->created;d->modified=old->modified;d->backup=old->backup;
        memcpy(d->finderInfo,old->finderInfo,32);
    }
    if(!result) {
        for(i=0;i<t->directoryCount;++i)free(t->directories[i]);
        free(t->directories);t->directories=NULL;t->directoryCount=0;
        for(i=0;i<t->metadataCount;++i) {
            m=t->metadata+i;p=m->before;m->before=m->after;m->after=p;
            a=m->beforeLength;m->beforeLength=m->afterLength;m->afterLength=a;
            flag=m->beforePresent;m->beforePresent=m->afterPresent;m->afterPresent=flag;
        }
        p=NULL;result=x->raw.read(x->raw.context,WS_LIST_KEY,&p,&n);
    }
    if(!result && (n!=52 || memcmp(p,"GHSL0001",8) || p[11]!=1 || memcmp(p+12,oid,20)))result=GS_FORMAT;
    if(!result) {
        m=(GCMetadata *)realloc(t->metadata,5*sizeof(*m));
        if(!m)result=GB_MEMORY;
        else {
            t->metadata=m;m+=t->metadataCount++;memset(m,0,sizeof(*m));
            m->path=WSCopy(WS_LIST_KEY,sizeof(WS_LIST_KEY));m->before=p;p=NULL;
            m->beforeLength=m->afterLength=n;m->beforePresent=m->afterPresent=1;m->after=WSCopy(m->before,n);
            if(!m->path || !m->after)result=GB_MEMORY;
        }
    }
    if(!result)result=GPLoad(&x->raw,GWMacNameEqual,NULL,&map);
    if(!result)result=GFCollect(&x->root,&map,&review->inventory,&x->lastError);
    if(!result)result=GTNextGeneration(&x->raw,&t->generation);
    if(!result)memcpy(review->backendBinding,binding,32);
    free(p);GPFree(&map);
    if(x->store.leaseHeld){closed=GSMacLeave(&x->store);if(!result)result=closed;}
    return result;
}
static int TestSavedCatalogControl(void) {
    const char *control="GH Build:Saved Catalog Control";
    static const char *names[]={"To Folder","To Folder:Empty","To Folder:Empty:Deep"};
    static const char *paths[]={"To Folder","To Folder/Empty","To Folder/Empty/Deep"};
    GXCheckout *x=&gSavedCatalogProbe;GXDiscardReview review,inverse;WSRecord record;WSLimits limits;GQProtection selection;GQError why;
    FSSpec work,spec;GFCatalog cat,desired;long ids[3],id;int result=0,closed,kind,captured=0,recreated=0;size_t i,n;
    unsigned char tip[20],*p=NULL;char mode[64],hex[41],status[256];FILE *file;
    file=fopen(control,"rb");if(!file)return 0;
    memset(mode,0,sizeof(mode));if(!fgets(mode,sizeof(mode),file))mode[0]=0;fclose(file);
    if(strcmp(mode,"capture-directory-catalogs-once\r")) {
        SetStatus("Saved-catalog fixture was already consumed or is invalid. Retained; use fresh fixture media.");return 1;
    }
    file=fopen(control,"wb");if(!file){SetStatus("Could not claim the saved-catalog fixture.");return 1;}
    if(fputs("started\r",file)<0)result=GS_IO;
    if(fclose(file) && !result)result=GS_IO;
    GXDiscardInit(&review);GXDiscardInit(&inverse);WSInit(&record);memset(&limits,0,sizeof(limits));
    limits.stateBytes=2UL*1024*1024;limits.files=8192;limits.paths=8192;limits.pathBytes=16384;
    limits.forkBytes=2UL*1024*1024;limits.workBytes=32UL*1024*1024;limits.entries=128;
    if(!result)result=GXClose(x);
    if(!result && FSMakeFSSpec(0,0,"\pGH Build:Saved Catalog Work",&work))result=GS_IO;
    if(!result) {
        GSRepository unused;GSMacStore root;
        result=GSMacAttach(&unused,&root,&work,0);
        if(!result && FSMakeFSSpec(root.volume,root.directory,"\p.git",&spec)!=fnfErr)result=GS_CONFLICT;
    }
    if(!result)result=GXCheckSetup(&work);
    if(!result)result=GXAttach(x,&work);
    if(!result)result=GXBranch(x,"refs/heads/a",&why);
    if(!result)result=GSReadRef(&x->raw,"refs/heads/a",tip);
    if(!result)result=GFResolve(&x->root,"To Folder",&spec,&kind,&id,&x->lastError);
    if(!result && kind!=1)result=GS_FORMAT;
    if(!result && FSpDelete(&spec))result=GS_IO;
    for(i=0;!result && i<3;++i) {
        result=GXCreateDir(x,i?ids[i-1]:x->root.directory,i?(i==1?"Empty":"Deep"):"To Folder",&cat);
        if(!result)ids[i]=cat.id;
    }
    for(i=0;!result && i<3;++i) {
        result=GFDirectoryAt(x->store.volume,ids[i],&cat,&x->lastError);
        if(!result) {
            desired=cat;desired.created=3820000100UL+i;desired.modified=3820000200UL+i;desired.backup=3820000300UL+i;
            memset(desired.finderInfo,0,32);desired.finderInfo[20]=(unsigned char)(50+i);
            result=GFDirectoryRestore(&desired,&cat,&x->lastError);
        }
    }
    if(!result)result=GXCheckInventory(x,"GH Build","Saved Original");
    selection.paths=paths;selection.count=3;selection.changed=0;
    if(!result)result=GXDiscardPrepare(x,"refs/heads/a",tip,&selection,&review,&why);
    if(!result)result=WSOpen(&x->raw,review.snapshotOID,&limits,GWMacNameEqual,NULL,&record);
    if(!result)result=GXCatalogFacts(x,&record,1,&review.inventory);
    if(!result)captured=1;
    if(!result)result=GXCatalogWrite("Saved Record.bin",record.original,record.originalLength);
    if(!result)result=GXCatalogPlan("Saved Discard.bin",&review.plan.transaction);
    if(!result)result=GXDiscardApply(x,&review);
    if(!result)result=GXCheckInventory(x,"GH Build","Saved Discarded");
    if(!result)result=GXClose(x);
    if(!result)result=GXAttach(x,&work);
    if(!result)result=WSOpen(&x->raw,review.snapshotOID,&limits,GWMacNameEqual,NULL,&record);
    if(!result)result=GXCatalogInverse(x,&record,review.snapshotOID,review.backendBinding,&inverse);
    if(!result)result=GXCatalogPlan("Saved Inverse.bin",&inverse.plan.transaction);
    if(!result)result=GXDiscardApply(x,&inverse);
    if(!result)result=GXClose(x);
    if(!result)result=GXAttach(x,&work);
    if(!result)result=GXCatalogFacts(x,&record,0,NULL);
    for(i=0;!result && i<3;++i) {
        result=GFResolve(&x->root,names[i],&spec,&kind,&id,&x->lastError);
        if(!result && (kind!=2 || id==ids[i]))result=GS_FORMAT;
    }
    for(i=0;!result && i<record.discard.metadataCount;++i) {
        const GCMetadata *m=record.discard.metadata+i;
        int found=x->raw.read(x->raw.context,m->path,&p,&n);
        if(found!=0 && found!=GS_NOT_FOUND)result=found;
        if(!result && ((!found)!=m->beforePresent || (!found && (n!=m->beforeLength || (n && memcmp(p,m->before,n))))))result=GS_FORMAT;
        free(p);p=NULL;
    }
    if(!result)result=x->raw.read(x->raw.context,WS_LIST_KEY,&p,&n);
    if(!result && (n!=52 || memcmp(p+12,review.snapshotOID,20)))result=GS_FORMAT;
    free(p);p=NULL;
    if(!result)result=GXCheckInventory(x,"GH Build","Saved Recreated");
    if(!result)recreated=1;
    closed=GXClose(x);if(!result)result=closed;
    GBOIDFormat(review.snapshotOID,hex);file=fopen("GH Build:Saved Catalog Result.txt","wb");
    if(file) {
        fprintf(file,"GitHub Classic native saved catalogs v1\rresult=%d\rfile_manager=%d\rcaptured=%d\rrecreated=%d\rrecord=%s\rdirectories=3\rforward_generation=%lu\rinverse_generation=%lu\r",
            result,(int)x->lastError,captured,recreated,hex,(unsigned long)review.plan.transaction.generation,(unsigned long)inverse.plan.transaction.generation);
        if(fclose(file) && !result)result=GS_IO;
    } else if(!result)result=GS_IO;
    snprintf(status,sizeof(status),"Saved directory catalog fixture: %d; capture %d, recreate %d. See GH Build results. General Restore remains unfinished.",result,captured,recreated);
    SetStatus(status);GXDiscardFree(&review);GXDiscardFree(&inverse);WSFree(&record);return 1;
}
