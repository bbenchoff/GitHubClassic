/* Native Git smart HTTPS fetch. Included after checkout and dialog helpers. */
static const char netOriginMagic[] = "GHOrigin1\n";

static int NetRead(void *context, const char *key, unsigned char **p, size_t *n) {
    size_t limit = !strncmp(key, "objects/", 8) ? 3UL * 1024 * 1024 : 2048;
    if (!strcmp(key, "ghclient-push") || !strncmp(key, "ghclient-upstreams/", sizeof("ghclient-upstreams/") - 1)) limit = 3072;
    return GSMacReadLimit((GSMacStore *)context, key, p, n, limit);
}
static int NetNoWrite(void *context, const char *key, const void *old, size_t en,
                       const void *next, size_t n) {
    (void)context; (void)key; (void)old; (void)en; (void)next; (void)n;
    return GB_BAD;
}
static void NetReader(GSRepository *r, GSMacStore *store) {
    r->context = store; r->read = NetRead; r->replace = NetNoWrite;
}
static int NetOriginRead(GSMacStore *store, char name[256], char branch[1025],
                         unsigned char **original, size_t *length) {
    const unsigned char *a, *b;
    size_t prefix = sizeof(netOriginMagic) - 1, first, second;
    int result;
    name[0] = branch[0] = 0;
    result = GSMacReadLimit(store, "ghclient-origin", original, length, 2048);
    if (result) return result;
    if (*length < prefix + 3 || memcmp(*original, netOriginMagic, prefix) ||
        memchr(*original, 0, *length)) return GS_FORMAT;
    a = (const unsigned char *)memchr(*original + prefix, '\n', *length - prefix);
    if (!a) return GS_FORMAT;
    first = (size_t)(a - *original) - prefix;
    b = (const unsigned char *)memchr(a + 1, '\n', *length - (size_t)(a + 1 - *original));
    if (!b || b != *original + *length - 1) return GS_FORMAT;
    second = (size_t)(b - a) - 1;
    if (!first || first > 254 || !second || second > 1024) return GS_FORMAT;
    memcpy(name, *original + prefix, first); name[first] = 0;
    memcpy(branch, a + 1, second); branch[second] = 0;
    return GHValidRepository(name) && GSValidRef(branch) ? 0 : GS_FORMAT;
}
static void NetworkHeader(void) {
    unsigned char *bytes = NULL;
    size_t n;GSRepository reader;GUUpstream upstream;int result,source;
    gOriginName[0] = gOriginBranch[0] = 0;
    strcpy(gUpstreamText,"No origin configured.");
    result=gLocal?NetOriginRead(&gWork.database,gOriginName,gOriginBranch,&bytes,&n):GS_NOT_FOUND;
    if(!result) {
        NetReader(&reader,&gWork.database);
        result=GUUpstreamResolve(&reader,gOriginName,gWork.branch,gOriginBranch,&upstream,&source);
        if(result){gOriginBranch[0]=0;strcpy(gUpstreamText,"Upstream needs attention.");}
        else if(upstream.tracked){strcpy(gOriginBranch,upstream.remoteBranch);LocalDisplayPath(upstream.remoteBranch+11,gUpstreamText);}
        else {gOriginBranch[0]=0;strcpy(gUpstreamText,source==GU_UPSTREAM_EXPLICIT?"Not tracking a remote branch.":"Choose an upstream for this branch.");}
    } else {gOriginName[0]=gOriginBranch[0]=0;if(result!=GS_NOT_FOUND)strcpy(gUpstreamText,"Origin settings need attention.");}
    free(bytes);
}
/* Capture exact configuration bytes, including absence, while holding the
   writer lease. A modal/network interval never owns that lease. Recheck these
   bytes and the database catalog identity before any later publication. */
typedef struct {
    GUUpstream route;
    char repository[255],legacy[1025];
    unsigned char *origin,*upstream;
    size_t originLength,upstreamLength;
    short volume;long directory;
    int source;
} NetBinding;
static void NetBindingInit(NetBinding *b) {memset(b,0,sizeof(*b));}
static void NetBindingFree(NetBinding *b) {free(b->origin);free(b->upstream);NetBindingInit(b);}
static int NetBindingCapture(GSMacStore *store,const char *local,const char *newOwner,NetBinding *b) {
    GSRepository reader;char owner[256],key[80];unsigned char *encoded=NULL;size_t n=0;int result;
    if(!store || !local || strlen(local)>1024 || !GSValidRef(local))return GB_BAD;
    if(!store->leaseHeld)return GS_CONFLICT;
    result=NetOriginRead(store,owner,b->legacy,&b->origin,&b->originLength);
    if(result==GS_NOT_FOUND && newOwner && GHValidRepository(newOwner)) {
        strcpy(owner,newOwner);strcpy(b->legacy,local);result=0;
    }
    if(result)return result;
    if(newOwner && strcmp(owner,newOwner))return GS_CONFLICT;
    strcpy(b->repository,owner);NetReader(&reader,store);
    result=GUUpstreamResolve(&reader,owner,local,b->legacy,&b->route,&b->source);
    if(!result)result=GUUpstreamKey(local,key);
    if(!result) {
        result=NetRead(store,key,&b->upstream,&b->upstreamLength);
        if(result==GS_NOT_FOUND && b->source!=GU_UPSTREAM_EXPLICIT)result=0;
        else if(!result && b->source!=GU_UPSTREAM_EXPLICIT)result=GS_CONFLICT;
    }
    if(!result && b->source==GU_UPSTREAM_EXPLICIT) {
        result=GUUpstreamEncode(&b->route,&encoded,&n);
        if(!result && (n!=b->upstreamLength || memcmp(encoded,b->upstream,n)))result=GS_CONFLICT;
    }
    free(encoded);
    if(!result){b->volume=store->volume;b->directory=store->directory;}
    return result;
}
static int NetExact(GSMacStore *store,const char *key,const unsigned char *expected,size_t en) {
    unsigned char *bytes=NULL;size_t n=0;int result=NetRead(store,key,&bytes,&n);
    if(result==GS_NOT_FOUND)result=expected?GS_CONFLICT:0;
    else if(!result && (!expected || n!=en || memcmp(bytes,expected,n)))result=GS_CONFLICT;
    free(bytes);return result;
}
static int NetBindingCheck(GSMacStore *store,const NetBinding *b) {
    char key[80];int result;
    if(!store->leaseHeld || store->volume!=b->volume || store->directory!=b->directory)return GS_CONFLICT;
    result=NetExact(store,"ghclient-origin",b->origin,b->originLength);
    if(!result)result=GUUpstreamKey(b->route.localBranch,key);
    if(!result)result=NetExact(store,key,b->upstream,b->upstreamLength);
    return result;
}
static int NetHeadCheck(GSRepository *r,const char *expected,const unsigned char tip[20],int haveHead) {
    char *branch=NULL;unsigned char current[20];int result=GSHead(r,&branch,current);
    if(result==GS_NOT_FOUND && !haveHead && branch)result=0;
    else if(!result && !haveHead)result=GS_CONFLICT;
    if(!result && (!branch || strcmp(branch,expected) || (haveHead && memcmp(current,tip,20))))result=GS_CONFLICT;
    free(branch);return result;
}
/* Learn only from the same verified advertisement used by this Fetch/Clone.
   This identity is independent of whichever upstream branch was selected.
   The caller holds the normal writer lease and has rechecked exact origin. */
static int NetObserveDefault(GSRepository *r,const char *repository,const GNAdvertisement *advertisement) {
    GUDefault *values;unsigned char *raw=NULL;size_t n=0;int result,exists=0;
    values=(GUDefault *)calloc(2,sizeof(*values));if(!values)return GB_MEMORY;
    if(strlen(repository)>254 || !GHValidRepository(repository)){free(values);return GB_BAD;}
    strcpy(values[1].repository,repository);
    if(advertisement->head && GSValidRef(advertisement->head) && GNFind(advertisement,advertisement->head)) {
        values[1].known=1;strcpy(values[1].branch,advertisement->head);
    }
    result=r->read(r->context,"ghclient-default",&raw,&n);
    if(result==GS_NOT_FOUND)result=0;
    else if(!result){result=GUDefaultParse(raw,n,values);if(!result)exists=1;}
    free(raw);
    if(!result)result=GUDefaultSet(r,exists?values:NULL,values+1);
    free(values);return result;
}
/* Empty Clone publishes only owned metadata. A durable plan distinguishes an
   approved partial empty clone from an earlier ordinary fetch/checkout attempt.
   These individually guarded writes are retryable, not a single transaction. */
#define NET_EMPTY_KEYS 7
typedef struct {
    unsigned char *bytes[NET_EMPTY_KEYS];size_t lengths[NET_EMPTY_KEYS];char upstream[80];
    short volume;long root,database;GBWord rootCreated,databaseCreated,volumeCreated,signature;
} NetEmptyState;
static void NetEmptyFree(NetEmptyState *state) {
    int i;for(i=0;i<NET_EMPTY_KEYS;++i)free(state->bytes[i]);memset(state,0,sizeof(*state));
}
static const char *NetEmptyKey(int at,const char *upstream) {
    static const char *keys[NET_EMPTY_KEYS]={"HEAD","ghclient-clone","ghclient-origin",NULL,
        "ghclient-empty-clone","index","ghclient-map"};return at==3?upstream:keys[at];
}
static int NetEmptyExpected(const unsigned char *bytes,size_t n,const void *expected,size_t en,int optional) {
    return !bytes?optional?0:GS_CONFLICT:n==en && !memcmp(bytes,expected,n)?0:GS_CONFLICT;
}
/* This bounded identity/byte snapshot can precede discovery even for a pending
   ordinary clone. Empty-specific refusal is applied only after parsed count0. */
static int NetEmptySnapshot(const char *branch,NetEmptyState *out) {
    NetEmptyState next;GFCatalog root,database;HParamBlockRec volume;OSErr error;int result,i;
    memset(&next,0,sizeof(next));if(!gUICheckout.store.leaseHeld)return GS_CONFLICT;
    result=GFDirectoryAt(gUICheckout.root.volume,gUICheckout.root.directory,&root,&error);
    if(!result)result=GFDirectoryAt(gUICheckout.store.volume,gUICheckout.store.directory,&database,&error);
    if(!result && (root.spec.vRefNum!=database.spec.vRefNum || database.spec.parID!=root.id))result=GS_CONFLICT;
    if(!result) {
        next.volume=root.spec.vRefNum;next.root=root.id;next.rootCreated=root.created;
        next.database=database.id;next.databaseCreated=database.created;
        memset(&volume,0,sizeof(volume));volume.volumeParam.ioVRefNum=next.volume;
        if(PBHGetVInfoSync(&volume))result=GS_IO;
        else{next.volumeCreated=(GBWord)volume.volumeParam.ioVCrDate;next.signature=(unsigned short)volume.volumeParam.ioVSigWord;}
    }
    if(!result)result=GUUpstreamKey(branch,next.upstream);
    for(i=0;!result && i<NET_EMPTY_KEYS;++i) {
        result=NetRead(&gUICheckout.store,NetEmptyKey(i,next.upstream),next.bytes+i,next.lengths+i);
        if(result==GS_NOT_FOUND)result=0;
    }
    if(!result){*out=next;memset(&next,0,sizeof(next));}NetEmptyFree(&next);return result;
}
typedef struct {
    NetEmptyState next;GIIndex index;GPMap map;GUUpstream route;
    char pending[300],complete[300],plan[1400],origin[1400],head[1040];
} NetEmptyCaptureWork;
static int NetEmptyCapture(const char *owner,const char *branch,NetEmptyState *out) {
    NetEmptyCaptureWork *w;GSRepository reader;CInfoPBRec pb;Str31 name;
    unsigned char *encoded=NULL;size_t en=0;int result,i,kind;FSSpec spec;long id;OSErr error;
    if(!gUICheckout.store.leaseHeld)return GS_CONFLICT;
    w=(NetEmptyCaptureWork *)calloc(1,sizeof(*w));if(!w)return GB_MEMORY;
    GIInit(&w->index);GPInit(&w->map);GUUpstreamInit(&w->route);reader=gUICheckout.raw;reader.read=NetRead;
    result=GTNormalWriteAllowed(&reader);if(!result)result=GSOpen(&reader);
    if(!result)result=NetEmptySnapshot(branch,&w->next);
    if(!result) {
        /* Include ignored/pruned entries: an empty work list is insufficient. */
        memset(&pb,0,sizeof(pb));pb.dirInfo.ioVRefNum=w->next.volume;pb.dirInfo.ioDrDirID=w->next.root;
        pb.dirInfo.ioNamePtr=name;pb.dirInfo.ioFDirIndex=1;error=PBGetCatInfoSync(&pb);
        if(error || name[0]!=4 || memcmp(name+1,".git",4) || !(pb.dirInfo.ioFlAttrib&16) || pb.dirInfo.ioDrDirID!=w->next.database)result=GS_CONFLICT;
        if(!result){pb.dirInfo.ioDrDirID=w->next.root;pb.dirInfo.ioFDirIndex=2;error=PBGetCatInfoSync(&pb);if(error!=fnfErr)result=error?GS_IO:GS_CONFLICT;}
    }
    /* No objects/refs from an earlier nonempty attempt may be reclassified. */
    for(i=0;!result && i<2;++i) {
        result=GFResolve(&gUICheckout.store,i?"objects":"refs",&spec,&kind,&id,&error);
        if(!result && kind)result=GS_CONFLICT;
    }
    if(!result)result=NetExact(&gUICheckout.store,"ghclient-push",NULL,0);
    if(!result)result=NetExact(&gUICheckout.store,"ghclient-default",NULL,0);
    if(!result)result=GILoad(&reader,&w->index);
    if(!result)result=GPLoad(&reader,GWMacNameEqual,NULL,&w->map);
    if(!result && (w->index.count || w->map.count))result=GS_CONFLICT;
    if(!result)for(i=0;i<20;++i)if(w->map.tree[i]){result=GS_CONFLICT;break;}
    snprintf(w->pending,sizeof(w->pending),"GHClone1\n%s\n",owner);snprintf(w->complete,sizeof(w->complete),"GHCloneDone1\n%s\n",owner);
    snprintf(w->plan,sizeof(w->plan),"GHCloneEmpty1\n%s\n%s\n",owner,branch);snprintf(w->origin,sizeof(w->origin),"%s%s\n%s\n",netOriginMagic,owner,branch);
    snprintf(w->head,sizeof(w->head),"ref: %s\n",branch);
    if(!result && NetEmptyExpected(w->next.bytes[1],w->next.lengths[1],w->pending,strlen(w->pending),0) &&
       NetEmptyExpected(w->next.bytes[1],w->next.lengths[1],w->complete,strlen(w->complete),0))result=GS_CONFLICT;
    if(!result)result=NetEmptyExpected(w->next.bytes[4],w->next.lengths[4],w->plan,strlen(w->plan),1);
    if(!result && NetEmptyExpected(w->next.bytes[0],w->next.lengths[0],w->head,strlen(w->head),0) &&
       NetEmptyExpected(w->next.bytes[0],w->next.lengths[0],"ref: refs/heads/main\n",21,0))result=GS_CONFLICT;
    if(!result)result=NetEmptyExpected(w->next.bytes[2],w->next.lengths[2],w->origin,strlen(w->origin),1);
    strcpy(w->route.repository,owner);strcpy(w->route.localBranch,branch);strcpy(w->route.remoteBranch,branch);w->route.tracked=1;
    if(!result)result=GUUpstreamEncode(&w->route,&encoded,&en);
    if(!result)result=NetEmptyExpected(w->next.bytes[3],w->next.lengths[3],encoded,en,1);
    /* Our plan is published BEFORE any origin/upstream/HEAD/completion change. */
    if(!result && !w->next.bytes[4] && (w->next.bytes[2] || w->next.bytes[3] ||
       !NetEmptyExpected(w->next.bytes[1],w->next.lengths[1],w->complete,strlen(w->complete),0) ||
       NetEmptyExpected(w->next.bytes[0],w->next.lengths[0],"ref: refs/heads/main\n",21,0)))result=GS_CONFLICT;
    if(!result){*out=w->next;memset(&w->next,0,sizeof(w->next));}
    free(encoded);GIFree(&w->index);GPFree(&w->map);NetEmptyFree(&w->next);free(w);return result;
}
static int NetEmptySame(const NetEmptyState *a,const NetEmptyState *b) {
    int i;if(a->volume!=b->volume || a->root!=b->root || a->database!=b->database ||
        a->rootCreated!=b->rootCreated || a->databaseCreated!=b->databaseCreated ||
        a->volumeCreated!=b->volumeCreated || a->signature!=b->signature)return 0;
    for(i=0;i<NET_EMPTY_KEYS;++i) {
        /* A newly advertised unborn symref can change the route key only while
           BOTH records are absent. It cannot adopt an existing foreign route. */
        if(i==3 && strcmp(a->upstream,b->upstream)){if(a->bytes[i] || b->bytes[i])return 0;continue;}
        if((!a->bytes[i])!=(!b->bytes[i]) || a->lengths[i]!=b->lengths[i] ||
           (a->bytes[i] && memcmp(a->bytes[i],b->bytes[i],a->lengths[i])))return 0;
    }
    return 1;
}
static int NetEmptyPut(GSRepository *r,const char *key,const unsigned char *before,size_t bn,const void *after,size_t an) {
    if(before && bn==an && !memcmp(before,after,an))return 0;
    return r->replace(r->context,key,before,bn,after,an);
}
typedef struct {
    NetEmptyState before,now;OperationPrompt prompt;GUUpstream route;
    char branch[1025],plan[1400],origin[1400],head[1040],complete[300],key[80],state[1400];
} NetEmptyReview;
static int NetEmptyClone(const FSSpec *folder,const char *owner,const GNAdvertisement *advertisement,
                         const NetEmptyState *networkBefore,char outBranch[1025],int *completed) {
    NetEmptyReview *w;GSRepository writer;unsigned char *upstream=NULL;size_t un=0;int result,closed,answer,advertised;
    *completed=0;if(!owner || !GHValidRepository(owner) || strlen(owner)>254 || advertisement->count || !networkBefore)return GB_BAD;
    w=(NetEmptyReview *)calloc(1,sizeof(*w));if(!w)return GB_MEMORY;
    advertised=advertisement->head && strlen(advertisement->head)<=1024 && GSValidRef(advertisement->head);
    strcpy(w->branch,advertised?advertisement->head:"refs/heads/main");
    result=CheckoutAttach(folder);if(!result)result=GSMacEnter(&gUICheckout.store,0);
    if(!result)result=NetEmptyCapture(owner,w->branch,&w->before);
    if(!result && strcmp(networkBefore->upstream,w->before.upstream))result=NetExact(&gUICheckout.store,networkBefore->upstream,networkBefore->bytes[3],networkBefore->lengths[3]);
    if(!result && !NetEmptySame(networkBefore,&w->before))result=GS_CONFLICT;
    closed=CheckoutRelease();if(!result)result=closed;if(result || gDone)goto done;
    w->prompt.title="Clone Empty Repository";w->prompt.repository=owner;
    snprintf(w->state,sizeof(w->state),"GitHub advertises no commits.\r%s: %.1024s",advertised?"Advertised unborn branch":"Local starting branch (GitHub did not advertise a default)",w->branch+11);
    w->prompt.state=w->state;w->prompt.primary="Create Empty Clone";w->prompt.canPrimary=1;
    w->prompt.primaryText="Keep a local repository with no commits. Save its GitHub origin and future Push target. No objects are downloaded and no commit is invented.";
    w->prompt.footer="Cancel keeps the initialized folder. You can add files and make the first commit after completing this empty clone.";
    w->prompt.labels[0]="GitHub repository";w->prompt.values[0]=owner;w->prompt.labels[1]="Local and future remote branch";w->prompt.values[1]=w->branch;
    answer=OperationConfirm(&w->prompt);if(answer!=1 || gDone)goto done;
    result=CheckoutAttach(folder);if(!result)result=GSMacEnter(&gUICheckout.store,0);
    if(!result)result=NetEmptyCapture(owner,w->branch,&w->now);
    if(!result && !NetEmptySame(&w->before,&w->now))result=GS_CONFLICT;
    if(!result && strcmp(networkBefore->upstream,w->now.upstream))result=NetExact(&gUICheckout.store,networkBefore->upstream,networkBefore->bytes[3],networkBefore->lengths[3]);
    if(result)goto done;
    GUUpstreamInit(&w->route);strcpy(w->route.repository,owner);strcpy(w->route.localBranch,w->branch);strcpy(w->route.remoteBranch,w->branch);w->route.tracked=1;
    result=GUUpstreamKey(w->branch,w->key);if(!result)result=GUUpstreamEncode(&w->route,&upstream,&un);
    snprintf(w->plan,sizeof(w->plan),"GHCloneEmpty1\n%s\n%s\n",owner,w->branch);snprintf(w->origin,sizeof(w->origin),"%s%s\n%s\n",netOriginMagic,owner,w->branch);
    snprintf(w->head,sizeof(w->head),"ref: %s\n",w->branch);snprintf(w->complete,sizeof(w->complete),"GHCloneDone1\n%s\n",owner);
    writer=gUICheckout.raw;writer.read=NetRead;
    if(!result)result=NetEmptyPut(&writer,"ghclient-empty-clone",w->now.bytes[4],w->now.lengths[4],w->plan,strlen(w->plan));
    if(!result)result=NetEmptyPut(&writer,"HEAD",w->now.bytes[0],w->now.lengths[0],w->head,strlen(w->head));
    if(!result)result=NetEmptyPut(&writer,"ghclient-origin",w->now.bytes[2],w->now.lengths[2],w->origin,strlen(w->origin));
    if(!result)result=NetEmptyPut(&writer,w->key,w->now.bytes[3],w->now.lengths[3],upstream,un);
    if(!result)result=NetEmptyPut(&writer,"ghclient-clone",w->now.bytes[1],w->now.lengths[1],w->complete,strlen(w->complete));
    if(!result){strcpy(outBranch,w->branch);*completed=1;}
done:
    closed=CheckoutRelease();if(!result)result=closed;if(result)*completed=0;
    free(upstream);NetEmptyFree(&w->before);NetEmptyFree(&w->now);free(w);return result;
}

static int NetServiceHTTPSource(int push, const char *repository, const void *payload, size_t payloadLength,
                    int (*sourceRead)(void *, size_t, void *, size_t), void *source,
                    unsigned char **body, size_t *bodyLength) {
    InetHostInfo host;
    InetAddress address;
    OSStatus osError;
    unsigned char *data = NULL, *grown, *basic = NULL;
    char *headers = NULL, *credential = NULL, path[384];
    int post = payload != NULL || sourceRead != NULL;
    const char *expected = push ? (post ? "application/x-git-receive-pack-result"
                                          : "application/x-git-receive-pack-advertisement")
                                : (post ? "application/x-git-upload-pack-result"
                                           : "application/x-git-upload-pack-advertisement");
    const char *token = gToken[0] ? gToken : NULL;
    size_t capacity = 16384, maximum = GH_HTTP_BODY_LIMIT + 256UL * 1024, used = 0, n = 0, encoded = 0, sent, amount;
    unsigned char *upload = NULL;
    size_t credentialLength = token ? strlen(token) : 0, reported = 0;
    char transferStatus[128];
    unsigned long started;
    int error = 0, got, status = 0, framing = 1, wasBusy = gBusy;
    int reused=0,retried=0,reusable=0,keep=0;
    *body = NULL; *bodyLength = 0;
    if (!GHValidRepository(repository) || (payload && sourceRead) || (payloadLength && !post)) return GB_BAD;
    if (push && (!token || !gCredentials.bound)) return OA_PERMISSION;
    if (credentialLength > 8191 || (token && strpbrk(token, " \t\r\n"))) return GB_BAD;
    snprintf(path, sizeof(path), "/%s.git/%s", repository,
             push ? (post ? "git-receive-pack" : "info/refs?service=git-receive-pack")
                  : (post ? "git-upload-pack" : "info/refs?service=git-upload-pack"));
    ++gGitHTTPAttempts;gBusy = 1; gCancel = 0;
    data = (unsigned char *)malloc(capacity + 1); headers = (char *)malloc(16384);
    if (!data || !headers) { error = GB_MEMORY; goto done; }
    if (token) {
        credential = (char *)malloc(credentialLength + 15);
        basic = (unsigned char *)malloc(12288);
        if (!credential || !basic) { error = GB_MEMORY; goto done; }
        /* GitHub App user/installation tokens belong in the password field.
           This form also accepts OAuth and personal access tokens. */
        memcpy(credential, "x-access-token:", 15);
        memcpy(credential + 15, token, credentialLength);
        error = mbedtls_base64_encode(basic, 12288, &encoded,
                                      (unsigned char *)credential, credentialLength + 15);
        mbedtls_platform_zeroize(credential, credentialLength + 15);
        if (error) goto done;
        basic[encoded] = 0;
    }
    SetStatus(push ? (post ? "Pushing to github.com... An interrupted reply stays pending."
                             : "Checking the remote before Push... Escape cancels.")
                   : (post ? "Fetching Git objects from github.com... Escape cancels."
                              : "Reading branches from github.com... Escape cancels."));
    Pump(NULL);
    if(gCancel || gDone){error=SSL_CANCELLED;goto done;}
    if (!gOT) { osError = InitOpenTransport(); if (osError) { error = osError; goto done; } gOT = 1; }
    if (gInternet == kOTInvalidProviderRef) {
        gInternet = OTOpenInternetServices(kDefaultInternetServicesPath, 0, &osError);
        if (osError) { error = osError; goto done; }
    }
    error = InitializeTLS(); if (error) goto done;
    reused=gHTTPWarmSerial && gHTTPWarmSerial==gTLS.connectionSerial &&
        (unsigned long)(TickCount()-gHTTPWarmTick)<=30UL*60UL && SSL_CanReuse(&gTLS,"github.com");
    gHTTPWarmSerial=0;
again:
    if(reused)++gGitReuseAttempts;
    else {
        SSL_Disconnect(&gTLS);
        osError = OTInetStringToAddress(gInternet, "github.com", &host);
        if (osError) { error = osError; goto done; }
        OTInitInetAddress(&address, 443, host.addrs[0]);
        error = SSL_Connect(&gTLS, "github.com", &address); if (error) goto done;
        ++gGitHandshakes;
    }
    SSL_BeginIO(&gTLS);
    got = snprintf(headers, 16384,
                   "%s %s HTTP/1.1\r\nHost: github.com\r\nUser-Agent: GitHubClassic-ClassicMac/0.1\r\n"
                   "Accept: %s\r\nAccept-Encoding: identity\r\nCache-Control: no-cache\r\nConnection: keep-alive\r\n"
                   "%s%s%s%s",
                   post ? "POST" : "GET", path, expected,
                   token ? "Authorization: Basic " : "", token ? (char *)basic : "",
                   token ? "\r\n" : "", post ? (push ? "Content-Type: application/x-git-receive-pack-request\r\n"
                                                                      : "Content-Type: application/x-git-upload-pack-request\r\n") : "");
    if (got < 0 || got >= 16000) { error = GB_BAD; goto done; }
    n = (size_t)got;
    got = snprintf(headers + n, 16384 - n, "Content-Length: %lu\r\n\r\n", (unsigned long)payloadLength);
    if (got < 0 || (size_t)got >= 16384 - n) { error = GB_BAD; goto done; }
    n += got;
    error = SSL_Send(&gTLS, headers, n);
    mbedtls_platform_zeroize(headers, 16384);
    if (error) goto transportFailure;
    if (payload) { error = SSL_Send(&gTLS, payload, payloadLength); if (error) goto done; }
    if (sourceRead) {
        upload = (unsigned char *)malloc(16384);
        if (!upload) { error = GB_MEMORY; goto done; }
        for (sent = 0; sent < payloadLength; sent += amount) {
            amount = payloadLength - sent; if (amount > 16384) amount = 16384;
            error = sourceRead(source, sent, upload, amount);
            if (!error) error = SSL_Send(&gTLS, upload, amount);
            if (error) goto done;
        }
        free(upload); upload = NULL;
    }
    started = TickCount();
    while (framing == 1) {
        if (used == capacity) {
            if (capacity == maximum) { error = GB_SPACE; goto done; }
            capacity *= 2; if (capacity > maximum) capacity = maximum;
            grown = (unsigned char *)realloc(data, capacity + 1);
            if (!grown) { error = GB_MEMORY; goto done; } data = grown;
        }
        got = SSL_Receive(&gTLS, data + used, capacity - used);
        if (got < 0) { error = got; goto transportFailure; }
        if(!got && !used){error=GB_BAD;goto transportFailure;}
        used += got;reusable=got>0 && GHHTTPReusable(data,used);
        if(!push && post && used-reported>=256UL*1024) {
            snprintf(transferStatus,sizeof(transferStatus),
                     "Fetching Git objects... %lu KiB received. Escape cancels.",
                     (unsigned long)(used/1024));
            SetStatus(transferStatus);reported=used;
        }
        /* Check MIME before DecodeHTTP moves the binary body over its headers.
           Error responses retain their HTTP status instead of a MIME error. */
        if (used >= 12 && !memcmp(data + 9, "200", 3) && GHHTTPContentType(data, used, expected) < 0) {
            error = GN_UNSUPPORTED; goto done;
        }
        framing = DecodeHTTP(data, used, got == 0, &n, &status);
        if (framing < 0 || (!got && framing)) { error = GB_BAD; goto done; }
        if ((unsigned long)(TickCount() - started) > (!push && post ? 60UL*600UL : 7200UL)) { error = SSL_TIMEOUT; goto done; }
    }
    if (status != 200) { error = status; goto done; }
    keep=reusable && !gCancel && !gDone && SSL_CanReuse(&gTLS,"github.com");
    data[n] = 0; *body = data; *bodyLength = n; data = NULL;
    goto done;
transportFailure:
    /* Advertisements are safe reads. POSTs, including upload-pack negotiation,
       are never replayed here; an uncertain Push retains its pending intent. */
    if(reused && !post && !retried && !used && error!=SSL_CANCELLED && !gCancel && !gDone) {
        SSL_Disconnect(&gTLS);reused=0;retried=1;error=0;
        ++gGitReconnectRetries;++gGitHTTPAttempts;goto again;
    }
done:
    if(!error && keep){gHTTPWarmSerial=gTLS.connectionSerial;gHTTPWarmTick=TickCount();}
    else {gHTTPWarmSerial=0;SSL_Disconnect(&gTLS);}
    if (headers) { mbedtls_platform_zeroize(headers, 16384); free(headers); }
    if (credential) { mbedtls_platform_zeroize(credential, credentialLength + 15); free(credential); }
    if (basic) { mbedtls_platform_zeroize(basic, 12288); free(basic); }
    free(upload); free(data); gBusy = wasBusy;
    if (error == 401 && token) ClearSession();
    return error;
}
static int NetServiceHTTP(int push, const char *repository, const void *payload, size_t payloadLength,
                           unsigned char **body, size_t *bodyLength) {
    return NetServiceHTTPSource(push, repository, payload, payloadLength, NULL, NULL, body, bodyLength);
}
static int NetHTTP(const char *repository, const void *payload, size_t payloadLength,
                      unsigned char **body, size_t *bodyLength) {
    return NetServiceHTTP(0, repository, payload, payloadLength, body, bodyLength);
}
typedef struct {const GNAdvertisement *advertisement;size_t *rows,count;int settings,cloning;const char *local,*current;} NetBranchList;
static int NetBranchRow(void *context,size_t at,char label[256],char name[256],char info[256]) {
    NetBranchList *list=(NetBranchList *)context;const GNRef *ref;size_t extra=list->settings?3:0;
    if(list->settings && at<3) {
        strcpy(name,at==0?"Do not track a remote branch":at==1?"Publish with this local branch's name":"New remote branch...");strcpy(label,name);
        strcpy(info,at==0?"Fetch and Pull will need an upstream again.":at==1?"Save the target name; Push publishes it later.":"Enter a new ASCII branch name; no upload yet.");return 1;
    }
    if(at<extra || at-extra>=list->count)return 0;
    ref=list->advertisement->refs+list->rows[at-extra];LocalDisplayPath(ref->name+11,name);
    snprintf(label,256,"%s%.235s",list->advertisement->head && !strcmp(list->advertisement->head,ref->name)?"Default: ":"",name);
    strcpy(info,list->current && !strcmp(list->current,ref->name)?
        list->cloning?"Default branch. Clone downloads and checks out its files.":"Current upstream target.":"Advertised GitHub branch.");return 1;
}
static char *NetBranchDetails(void *context,size_t at) {
    NetBranchList *list=(NetBranchList *)context;const GNRef *ref;size_t extra=list->settings?3:0;char heading[300],hex[41];
    if(list->settings && at<3)return ChoiceIdentityDetails(at==0?"Stop tracking. Existing branches and files are kept.":
        at==1?"Publish this local name on the next Push. Saving this choice sends no upload.":"Enter a new remote branch name. Saving the target does not publish a commit.",list->local);
    if(at<extra || at-extra>=list->count)return NULL;
    ref=list->advertisement->refs+list->rows[at-extra];GBOIDFormat(ref->oid,hex);
    snprintf(heading,sizeof(heading),"Remote branch\rAdvertised commit: %s\rSelection does not change local files.",hex);
    return ChoiceIdentityDetails(heading,ref->name);
}
/*1 selected,0 cancelled,negative error. Every returned name is complete. */
static int NetPickRemote(const GNAdvertisement *a,const char *local,const char *current,int settings,const char *cloningRepository,char remote[1025],int *tracked) {
    NetBranchList list;NativeChoices choices;size_t i,selected,extra=settings?3:0;char typed[256],description[256],display[256];int result=0;
    if(!a || !local || !remote || !tracked || strlen(local)>1024 || !GSValidRef(local))return GB_BAD;
    remote[0]=0;*tracked=0;
    memset(&list,0,sizeof(list));list.advertisement=a;list.settings=settings;list.local=local;list.current=current;
    list.cloning=cloningRepository!=NULL;
    if(a->count>CHOICE_MAX)return GB_SPACE;
    list.rows=(size_t *)malloc((a->count?a->count:1)*sizeof(size_t));if(!list.rows)return GB_MEMORY;
    for(i=0;i<a->count;++i)if(GSValidRef(a->refs[i].name)) {
        if(strlen(a->refs[i].name)>1024 || list.count+extra>=CHOICE_MAX){result=GB_SPACE;goto done;}
        list.rows[list.count++]=i;
    }
    if(!list.count && !settings){result=GS_NOT_FOUND;goto done;}
    choices.context=&list;choices.count=list.count+extra;choices.initial=0;choices.row=NetBranchRow;choices.details=NetBranchDetails;
    choices.title=settings?"Choose Upstream Branch":"Choose Remote Branch";choices.action=settings?"Choose Target":"Fetch Branch";choices.noun="Branches";
    LocalDisplayPath(local+11,display);snprintf(description,sizeof(description),"Local: %.180s\rChoose a target; local branches and files stay in place.",display);choices.description=description;
    if(cloningRepository) {
        choices.title="Choose Branch to Clone";choices.action="Clone Branch";
        snprintf(description,sizeof(description),"%.180s\rDownload this branch into your chosen folder.",cloningRepository);
    }
    if(settings && current && !strcmp(current,local))choices.initial=1;
    for(i=0;i<list.count;++i)if(current && !strcmp(a->refs[list.rows[i]].name,current))choices.initial=i+extra;
    for(;;) {
        selected=PickNativeChoice(&choices);if(gDone || selected==(size_t)-1)break;
        if(selected>=choices.count){result=GS_CONFLICT;break;}
        choices.initial=selected;*tracked=selected!=0 || !settings;remote[0]=0;
        if(settings && selected==1)strcpy(remote,local);
        else if(settings && selected==2) {
            typed[0]=0;if(!AskAction("New Remote Branch","Choose the remote branch name to save as this local branch's upstream. This does not upload a commit.","Use Branch",ASK_BRANCH,typed))continue;
            for(i=0;typed[i] && (unsigned char)typed[i]<128;++i){}
            snprintf(remote,1025,"refs/heads/%s",typed);
            if(typed[i] || !GSValidRef(remote)){Message("Remote Branch","Enter a valid ASCII Git branch name. No setting has changed.");continue;}
        } else if(!settings || selected>=extra)strcpy(remote,a->refs[list.rows[selected-extra]].name);
        result=1;break;
    }
done:
    free(list.rows);return result;
}
static const GNRef *NetPickBranch(const GNAdvertisement *a,const char *repository) {
    char name[1025];int tracked,result=NetPickRemote(a,"refs/heads/main",a->head,0,repository,name,&tracked);
    if(result<0 && !gDone)Message("Fetch Origin",result==GS_NOT_FOUND?"The remote has no advertised branches yet.":"The complete remote branch list could not be opened. Nothing was selected.");
    return result==1?GNFind(a,name):NULL;
}
static int NetUpstreamConfirm(const NetBinding *b,const GUUpstream *next) {
    OperationPrompt prompt;char local[256],target[256],state[620];
    memset(&prompt,0,sizeof(prompt));LocalDisplayPath(next->localBranch+11,local);
    if(next->tracked)LocalDisplayPath(next->remoteBranch+11,target);else strcpy(target,"Not tracking");
    snprintf(state,sizeof(state),"Local: %s\rTarget: %s",local,target);
    prompt.title=next->tracked?"Save Upstream Branch":"Stop Tracking Branch";prompt.repository=b->repository;prompt.state=state;
    prompt.primary=next->tracked?"Save Upstream":"Stop Tracking";prompt.canPrimary=1;
    prompt.primaryText=next->tracked?"Fetch and Pull will use this remote branch. Push will publish the current local branch to this target, with normal history guards.":
        "Remove this local branch's tracking target. Existing remote and local branches are kept; choose a new upstream before Fetch or Pull.";
    prompt.secondaryText="Keep the previous upstream. No repository settings are saved.";
    prompt.footer="Saving changes configuration only. Your commits, working files and both Macintosh forks stay in place; no upload is sent.";
    prompt.labels[0]="Local branch";prompt.values[0]=next->localBranch;
    prompt.labels[1]="New remote target";prompt.values[1]=next->tracked?next->remoteBranch:"(untracked)";
    prompt.labels[2]="Previous remote target";prompt.values[2]=b->route.tracked?b->route.remoteBranch:"(untracked)";
    prompt.labels[3]="Origin repository";prompt.values[3]=b->repository;
    return OperationConfirm(&prompt)==1;
}
static int NetworkUpstream(void) {
    NetBinding *binding;GUUpstream next;GNAdvertisement advertisement;GSRepository reader;
    FSSpec folder;unsigned char tip[20],*wire=NULL;size_t n=0;char local[1025],owner[256],config[1400],message[512];
    int result=0,closed,attempt,selected=0,haveHead,saved=0,needOrigin;
    if(!gLocal || gBusy || gLocalBlocked || !gWork.branch || strlen(gWork.branch)>1024)return 0;
    binding=(NetBinding *)malloc(sizeof(*binding));if(!binding){LocalError("Upstream",GB_MEMORY);return GB_MEMORY;}
    NetBindingInit(binding);GNInit(&advertisement);GUUpstreamInit(&next);owner[0]=0;
    folder=gWork.folder;strcpy(local,gWork.branch);haveHead=gWork.haveHead;memcpy(tip,gWork.tip,20);
    for(attempt=0;attempt<2;++attempt) {
        gBusy=1;needOrigin=0;NetBindingFree(binding);result=CheckoutAttach(&folder);
        if(!result)result=GSMacEnter(&gUICheckout.store,0);
        if(!result){NetReader(&reader,&gUICheckout.store);result=NetHeadCheck(&reader,local,tip,haveHead);}
        if(!result){result=NetBindingCapture(&gUICheckout.store,local,owner[0]?owner:NULL,binding);needOrigin=result==GS_NOT_FOUND && !binding->origin;}
        closed=CheckoutRelease();if(!result)result=closed;gBusy=0;
        if(!needOrigin || attempt || gDone)break;
        if(!AskAction("Set Up Origin","Next choose this local branch's upstream. Nothing is uploaded.","Continue",ASK_REPOSITORY,owner)){result=0;goto done;}
        if(!GHValidRepository(owner)){result=GB_BAD;goto done;}
    }
    if(result || gDone)goto done;
    if(OARefreshNeeded(&gCredentials,AuthNow()) && RefreshCredentials()){result=GS_IO;goto done;}
    gBusy=1;result=NetHTTP(binding->repository,NULL,0,&wire,&n);
    if(!result)result=GNDiscover(wire,n,16384,&advertisement);
    free(wire);wire=NULL;gBusy=0;if(result || gDone)goto done;
    selected=NetPickRemote(&advertisement,local,binding->route.tracked?binding->route.remoteBranch:NULL,1,NULL,next.remoteBranch,&next.tracked);
    if(selected<0){result=selected;goto done;}if(!selected || gDone)goto done;
    strcpy(next.localBranch,local);strcpy(next.repository,binding->repository);
    if(!next.tracked && !binding->origin){SetStatus("This repository has no origin; it remains untracked.");goto done;}
    if(!NetUpstreamConfirm(binding,&next) || gDone)goto done;
    gBusy=1;result=CheckoutAttach(&folder);
    if(!result)result=GSMacEnter(&gUICheckout.store,0);
    if(!result)result=NetBindingCheck(&gUICheckout.store,binding);
    if(!result){reader=gUICheckout.raw;reader.read=NetRead;result=NetHeadCheck(&reader,local,tip,haveHead);}
    if(!result && !binding->origin) {
        n=(size_t)snprintf(config,sizeof(config),"%s%s\n%s\n",netOriginMagic,binding->repository,next.remoteBranch);
        result=n>=sizeof(config)?GB_SPACE:reader.replace(reader.context,"ghclient-origin",NULL,0,config,n);
    }
    if(!result)result=GUUpstreamSet(&reader,binding->source==GU_UPSTREAM_EXPLICIT?&binding->route:NULL,&next);
    if(!result)saved=1;
done:
    closed=CheckoutRelease();if(!result)result=closed;gBusy=0;
    free(wire);GNFree(&advertisement);NetBindingFree(binding);free(binding);
    if(!gDone) {
        NetworkHeader();
        if(result){snprintf(message,sizeof(message),"Upstream settings could not be confirmed (error %d). The origin or target may already have been saved. Reopen Upstream to inspect the current setting; no upload or working-file change was requested.",result);SetStatus(message);Message("Upstream Branch",message);}
        else if(saved)SetStatus(next.tracked?"Upstream saved for this local branch. No upload or working-file change.":"This local branch is no longer tracking a remote branch. Branches and files are kept.");
        else SetStatus("Upstream selection closed. No new target was approved.");
        SetPort(gWindow);InvalRect(&gWindow->portRect);
    }
    return result?result:saved;
}
static int NetGraphProgress(void *context, size_t count) {
    (void)count; return CheckoutProgress(context, "verify graph");
}
static int NetFetchTarget(const FSSpec *folder, GSMacStore *store, const char *hint,
                           char outBranch[1025], unsigned char outTip[20], int *saved,NetBinding *outBinding,
                           int useDefault,const char *expectedOwner) {
    GNAdvertisement a;
    const GNRef *chosen;
    GSRepository reader;
    GKLimits limits;
    GKResult imported;
    GVLimits graphLimits;
    GVResult graph;
    unsigned char *original = NULL, *wire = NULL, *request = NULL;
    unsigned char oldTip[20],localTip[20];char *local=NULL;
    size_t originalLength = 0, n = 0, requestLength = 0, packLength = 0;
    char owner[256], branch[1025], tracking[1100], config[1400], message[512];
    NetBinding binding;GUUpstream cloneRoute,priorRoute;NetEmptyState *cloneBefore=NULL;
    int result, closed, haveOld = 0, newOrigin = 0, updated = 0,attempt,haveHead=0,configure=0,priorExists=0,localGraph=0,verifiedHave=0;
    *saved = 0;
    gGitFetchHaveCount=0;gGitFetchPackBytes=0;gGitFetchImportedObjects=0;
    gCheckoutStopped = 0;
    if (OARefreshNeeded(&gCredentials, AuthNow()) && RefreshCredentials()) return GS_IO;
    GNInit(&a);NetBindingInit(&binding);GUUpstreamInit(&cloneRoute);
    memset(&imported, 0, sizeof(imported)); memset(&graph, 0, sizeof(graph));
    if(!hint) {
        for(attempt=0;attempt<2;++attempt) {
            free(local);local=NULL;NetBindingFree(&binding);configure=0;
            result=CheckoutAttach(folder);if(!result)result=GSMacEnter(&gUICheckout.store,0);
            if(!result) {
                NetReader(&reader,&gUICheckout.store);result=GSHead(&reader,&local,localTip);haveHead=!result;
                if(result==GS_NOT_FOUND && local)result=0;
            }
            if(!result && (strcmp(local,gWork.branch) || haveHead!=gWork.haveHead || (haveHead && memcmp(localTip,gWork.tip,20))))result=GS_CONFLICT;
            if(!result){result=NetBindingCapture(&gUICheckout.store,local,NULL,&binding);configure=result==GS_NOT_FOUND && !binding.origin;}
            closed=CheckoutRelease();if(!result)result=closed;
            if(useDefault)break;
            if(!result && !binding.route.tracked)configure=1;
            if(!configure || attempt || gDone)break;
            result=NetworkUpstream();if(result!=1 || gDone){if(result>0)result=0;goto done;}result=0;
        }
        if(result)goto done;
        if(!useDefault && !binding.route.tracked)goto done;
        strcpy(owner,binding.repository);strcpy(branch,binding.route.remoteBranch);
        if(expectedOwner && strcmp(owner,expectedOwner)){result=GS_CONFLICT;goto done;}
    } else {
    result = NetOriginRead(store, owner, branch, &original, &originalLength);
    if (result == GS_NOT_FOUND) {
        newOrigin = 1; owner[0] = 0; result = 0;
        if (hint) {
            if (strlen(hint) > 254) { result = GB_BAD; goto done; }
            strcpy(owner, hint);
        } else if (!AskAction("Set Up Origin", "Next choose a branch to fetch. Your current branch and files stay in place.","Continue",ASK_REPOSITORY, owner)) goto done;
        if (!GHValidRepository(owner)) { result = GB_BAD; goto done; }
        result = 0;
    } else if (result) goto done;
    if (hint && strcmp(owner, hint)) { result = GS_CONFLICT; goto done; }
    }
    if(hint) {
        cloneBefore=(NetEmptyState *)calloc(1,sizeof(*cloneBefore));if(!cloneBefore){result=GB_MEMORY;goto done;}
        result=CheckoutAttach(folder);if(!result)result=GSMacEnter(&gUICheckout.store,0);
        if(!result){NetReader(&reader,&gUICheckout.store);result=GSHead(&reader,&local,localTip);if(result==GS_NOT_FOUND && local)result=0;}
        if(!result)result=NetEmptySnapshot(local,cloneBefore);
        closed=CheckoutRelease();if(!result)result=closed;if(result)goto done;
    }
    gBusy = 1;
    result = NetHTTP(owner, NULL, 0, &wire, &n);
    if (!result) result = GNDiscover(wire, n, 16384, &a);
    free(wire); wire = NULL;
    if (result) goto done;
    gBusy = 0;
    if(hint && a.count) {
        unsigned char *emptyPlan=NULL;size_t emptyPlanLength=0;
        result=NetRead(store,"ghclient-empty-clone",&emptyPlan,&emptyPlanLength);free(emptyPlan);
        if(result!=GS_NOT_FOUND){if(!result)result=GS_CONFLICT;goto done;}
        result=0;
    }
    if(hint && !a.count) {
        result=NetEmptyClone(folder,owner,&a,cloneBefore,outBranch,&updated);
        if(updated)updated=2;
        goto done;
    }
    chosen = useDefault ? (a.head && GSValidRef(a.head) ? GNFind(&a,a.head) : NULL) :
        newOrigin ? NetPickBranch(&a,owner) : GNFind(&a, branch);
    if (!chosen) {
        if(useDefault) {
            result=CheckoutAttach(folder);if(!result)result=GSMacEnter(&gUICheckout.store,0);
            if(!result)result=GTNormalWriteAllowed(&gUICheckout.raw);
            if(!result)result=NetBindingCheck(&gUICheckout.store,&binding);
            if(!result){NetReader(&reader,&gUICheckout.store);result=NetHeadCheck(&reader,local,localTip,haveHead);}
            if(!result){reader=gUICheckout.raw;reader.read=NetRead;result=NetObserveDefault(&reader,owner,&a);}
            if(!result)result=GS_NOT_FOUND;
        } else result = newOrigin ? 0 : GS_NOT_FOUND;
        goto done;
    }
    if (strlen(chosen->name) > 1024 || !GSValidRef(chosen->name)) { result = GB_BAD; goto done; }
    strcpy(branch, chosen->name);
    snprintf(tracking, sizeof(tracking), "refs/remotes/origin/%s", branch + 11);
    NetReader(&reader, store);
    result = GSReadRef(&reader, tracking, oldTip);
    if (!result) haveOld = 1;
    else if (result == GS_NOT_FOUND) result = 0;
    if (result) goto done;
    graphLimits.objects = 65536; graphLimits.objectBytes = 2UL * 1024 * 1024;
    graphLimits.readBytes = 64UL * 1024 * 1024;
    /* Advertise a have only after verifying its COMPLETE local closure.
       A tracking ref alone does not prove we possess all its ancestors/files.
       Equal tips keep the lease through no-pack publication. Changed tips
       release it before HTTP; final graph validation still checks the union
       before publishing, including any local objects omitted by the server. */
    if (haveOld) {
        result=CheckoutAttach(folder);
        if(!result)result=GSMacEnter(&gUICheckout.store,0);
        if(!result)result=GTNormalWriteAllowed(&gUICheckout.raw);
        if(!result) {
            CheckoutBegin("Checking already-fetched history... Escape cancels.");
            NetReader(&reader,&gUICheckout.store);
            result=GVVerify(&reader,oldTip,&graphLimits,NetGraphProgress,NULL,&graph);
            if(!result) {
                if(!memcmp(oldTip,chosen->oid,20))localGraph=1;
                else verifiedHave=1;
            }
            else if(result==GS_NOT_FOUND && !gDone && !gCheckoutStopped) {
                /* Incomplete local history needs the ordinary verified pack. */
                result=0;memset(&graph,0,sizeof(graph));
            }
        }
        if(!localGraph){closed=CheckoutRelease();if(!result)result=closed;}
        if(result)goto done;
    }
    if(!localGraph) {
        result = GNFetchRequest(&a, branch, verifiedHave ? oldTip : NULL, verifiedHave ? 1 : 0, &request, &requestLength);
        if (result) goto done;
        gGitFetchHaveCount=verifiedHave ? 1 : 0;
        gBusy = 1;
        result = NetHTTP(owner, request, requestLength, &wire, &n);
        if (!result) result = GNFetchResponse(wire, n, a.sideBand, &packLength);
        if (result) goto done;
        gGitFetchPackBytes=(unsigned long)packLength;
        result = CheckoutAttach(folder);
        if (!result) result = GSMacEnter(&gUICheckout.store, 0);
        if (result) goto done;
    }
    CheckoutBegin("Validating fetched objects... Escape cancels before branch publication.");
    if(!hint) {
        result=NetBindingCheck(&gUICheckout.store,&binding);
        if(!result){NetReader(&reader,&gUICheckout.store);result=NetHeadCheck(&reader,local,localTip,haveHead);}
    } else {
        result=NetExact(&gUICheckout.store,"ghclient-origin",original,originalLength);
        if(!result){NetReader(&reader,&gUICheckout.store);result=GUUpstreamRead(&reader,owner,branch,&priorRoute,&priorExists);}
        if(!result && priorExists && (!priorRoute.tracked || strcmp(priorRoute.remoteBranch,branch)))result=GS_CONFLICT;
        if(!result){strcpy(cloneRoute.repository,owner);strcpy(cloneRoute.localBranch,branch);strcpy(cloneRoute.remoteBranch,branch);cloneRoute.tracked=1;}
    }
    if (result) goto done;
    limits.packBytes = GH_HTTP_BODY_LIMIT; limits.objects = 32768;
    limits.objectBytes = 2UL * 1024 * 1024; limits.expandedBytes = 64UL * 1024 * 1024; limits.deltaDepth = 128;
    if(!localGraph)result = GKImportPump(&gUICheckout.raw, wire, packLength, &limits, NULL, NULL,
                          CheckoutProgress, NULL, &imported);
    if(!result && !localGraph)gGitFetchImportedObjects=(unsigned long)imported.objectsWritten;
    free(wire); wire = NULL;
    NetReader(&reader, &gUICheckout.store);
    if (!result && !localGraph) result = GVVerify(&reader, chosen->oid, &graphLimits, NetGraphProgress, NULL, &graph);
    if (!result) result = CheckoutProgress(NULL, "publish tracking ref");
    if(!result)result=hint?NetExact(&gUICheckout.store,"ghclient-origin",original,originalLength):NetBindingCheck(&gUICheckout.store,&binding);
    if(!result && !hint){NetReader(&reader,&gUICheckout.store);result=NetHeadCheck(&reader,local,localTip,haveHead);}
    if (!result && newOrigin) {
        n = (size_t)snprintf(config, sizeof(config), "%s%s\n%s\n", netOriginMagic, owner, branch);
        if (n >= sizeof(config)) result = GB_SPACE;
        else result = gUICheckout.raw.replace(gUICheckout.raw.context, "ghclient-origin", NULL, 0, config, n);
    }
    if(!result){reader=gUICheckout.raw;reader.read=NetRead;result=NetObserveDefault(&reader,owner,&a);}
    if(!result && localGraph) {
        /* A no-op fetch makes no ref/object writes. Still refuse a tracking
           change during progress callbacks instead of declaring it saved. */
        result=GSReadRef(&reader,tracking,localTip);
        if(!result && memcmp(localTip,chosen->oid,20))result=GS_CONFLICT;
    } else if (!result) result = GSUpdateRef(&gUICheckout.raw, tracking, haveOld ? oldTip : NULL, chosen->oid);
    if (!result) {
        updated = 1;
        strcpy(outBranch, branch); memcpy(outTip, chosen->oid, 20);
    }
    if(!result && hint && !priorExists) {
        reader=gUICheckout.raw;reader.read=NetRead;result=GUUpstreamSet(&reader,NULL,&cloneRoute);
    }
done:
    free(original);free(local);free(wire);free(request);GNFree(&a);
    if(cloneBefore){NetEmptyFree(cloneBefore);free(cloneBefore);}
    closed = CheckoutRelease(); if (!result) result = closed;
    if(!result && updated && outBinding && !hint){*outBinding=binding;NetBindingInit(&binding);}
    NetBindingFree(&binding);
    gBusy = 0;
    if (!gDone) {
        if (result) {
            snprintf(message, sizeof(message), updated ? "Fetch saved its tracking branch, but cleanup needs attention (error %d). Keep the repository intact and refresh."
                                                      : "Fetch stopped (error %d). Your local branch and working files were not changed.", result);
            if (result == SSL_NO_SEED) strcpy(message, "Secure networking needs setup or unlock. Choose Help > Test GitHub Connection, then retry Fetch.");
            else if (result == SSL_CANCELLED || gCheckoutStopped) strcpy(message, "Fetch cancelled. Your local branch and working files stayed in place.");
            else if (result == 401 || result == 403) strcpy(message, "GitHub did not authorize this fetch. Sign in with access to the repository, then try again.");
            else if (result == GB_SPACE || result == GK_LIMIT) strcpy(message, "This fetch exceeds the 64 MiB transfer, 64 MiB expanded-pack, or 2 MiB object limit. Your local branch and files stayed in place.");
            SetStatus(message);
        } else if (updated==2) {
            SetStatus("Empty clone saved. Add files and commit, then Push creates its first remote branch.");
        } else if (updated) {
            if(localGraph)snprintf(message,sizeof(message),"Checked origin/%.100s: no pack download; %lu local objects verified. Local branch and files kept.",branch+11,(unsigned long)graph.objects);
            else snprintf(message, sizeof(message), "Fetched origin/%.100s: %lu objects imported; %lu reachable objects verified. Local branch and files kept.",
                     branch + 11, (unsigned long)imported.objectsWritten, (unsigned long)graph.objects);
            SetStatus(message);
        } else SetStatus("Fetch cancelled. Your local branch and working files stayed in place.");
    }
    *saved = updated;
    return result;
}
static int NetFetchFolder(const FSSpec *folder,GSMacStore *store,const char *hint,
                         char outBranch[1025],unsigned char outTip[20],int *saved,NetBinding *outBinding) {
    return NetFetchTarget(folder,store,hint,outBranch,outTip,saved,outBinding,0,NULL);
}
static int NetFetchDefaultFolder(const FSSpec *folder,const char *owner,
                                char outBranch[1025],unsigned char outTip[20],int *saved) {
    return NetFetchTarget(folder,&gWork.database,NULL,outBranch,outTip,saved,NULL,1,owner);
}
static void NetworkFetch(void) {
    char branch[1025], message[256];
    unsigned char tip[20];
    int result, saved;
    if (!gLocal || gBusy || gLocalBlocked) return;
    LocalRefresh(); if (gLocalBlocked || gDone) return;
    result = NetFetchFolder(&gWork.folder, &gWork.database, NULL, branch, tip, &saved,NULL);
    strcpy(message, gStatus);
    if (!gDone) {
        LocalRefresh(); NetworkHeader(); SetStatus(message);
        if (result) Message("Fetch Origin", message);
        SetPort(gWindow); InvalRect(&gWindow->portRect);
    }
}

typedef struct {const NetBinding *binding;unsigned char target[20];} NetPullCondition;
static int NetPullCheck(void *context,GSMacStore *store) {
    NetPullCondition *condition=(NetPullCondition *)context;GSRepository reader;unsigned char tip[20];char tracking[1100];
    int result=NetBindingCheck(store,condition->binding);
    snprintf(tracking,sizeof(tracking),"refs/remotes/origin/%s",condition->binding->route.remoteBranch+11);
    if(!result){NetReader(&reader,store);result=GSReadRef(&reader,tracking,tip);}
    if(!result && memcmp(tip,condition->target,20))result=GS_CONFLICT;
    return result;
}
static void NetPullGuard(const NetPullCondition *condition) {
    gUICheckout.precondition=condition?NetPullCheck:NULL;gUICheckout.preconditionContext=(void *)condition;
}
static int NetPullConfirm(const NetBinding *binding,const MMPlan *plan) {
    OperationPrompt prompt;char local[256],remote[256],state[620],current[41],incoming[41];
    memset(&prompt,0,sizeof(prompt));LocalDisplayPath(plan->branch+11,local);LocalDisplayPath(binding->route.remoteBranch+11,remote);
    snprintf(state,sizeof(state),"Local: %s\rIncoming: origin/%s",local,remote);GBOIDFormat(plan->tips,current);GBOIDFormat(plan->tips+20,incoming);
    prompt.title="Pull Remote Changes";prompt.repository=binding->repository;prompt.state=state;prompt.primary="Merge Changes";prompt.canPrimary=1;
    prompt.primaryText=plan->kind==MM_CONFLICT?"Start a saved merge review. Conflicting files need explicit choices before a merge commit is created.":
        "Combine the fetched remote branch with your local history. Both histories remain in the resulting merge commit.";
    prompt.secondaryText="Keep the fetched tracking branch, but leave the local branch, index and working files in place.";
    prompt.footer="Local edits that would be replaced stop the merge. Unrelated staged and working changes are kept. The upstream is checked again before starting.";
    prompt.labels[0]="Local branch";prompt.values[0]=plan->branch;prompt.labels[1]="Fetched tracking branch";prompt.values[1]=plan->otherRef;
    prompt.labels[2]="Current local commit";prompt.values[2]=current;prompt.labels[3]="Fetched remote commit";prompt.values[3]=incoming;
    return OperationConfirm(&prompt)==1;
}
static void NetworkPull(void) {
    FSSpec folder;
    GQError why;
    char remoteBranch[1025],tracking[1100], message[768], *localBranch,seconds[32],commitMessage[512],display[256];
    unsigned char oldTip[20], targetTip[20],oid[20];NetBinding *binding;NetPullCondition condition;
    MMLimits limits;MSLimits sl;MMPlan plan;MSChoices none;unsigned long macTime;long delta;MachineLocation location;
    int result, closed, saved = 0, advanced = 0, haveHead,started=0;
    if (!gLocal || gBusy || gLocalBlocked) return;
    LocalRefresh(); if (gLocalBlocked || gDone) return;
    folder = gWork.folder; haveHead = gWork.haveHead;
    localBranch = (char *)malloc(strlen(gWork.branch) + 1);
    if (!localBranch) { LocalError("Pull", GB_MEMORY); return; }
    binding=(NetBinding *)malloc(sizeof(*binding));if(!binding){free(localBranch);LocalError("Pull",GB_MEMORY);return;}
    NetBindingInit(binding);MMInit(&plan);MSChoicesInit(&none);NativeMergeLimits(&limits);MUIStateLimits(&sl);
    strcpy(localBranch, gWork.branch); memcpy(oldTip, gWork.tip, 20);
    memset(&why, 0, sizeof(why));
    result = NetFetchFolder(&folder, &gWork.database, NULL, remoteBranch, targetTip, &saved,binding);
    strcpy(message, gStatus);
    if (result || !saved || gDone) goto done;
    condition.binding=binding;memcpy(condition.target,targetTip,20);
    result = CheckoutAttach(&folder);
    if (!result) {
        CheckoutBegin("Checking Pull ancestry and local changes... Escape stops at a recoverable checkpoint.");
        NetPullGuard(&condition);
        result = GXFastForward(&gUICheckout, localBranch, haveHead ? oldTip : NULL,
                               targetTip, &why, &advanced);
    }
    NetPullGuard(NULL);
    closed = CheckoutRelease(); if (!result) result = closed;
    if(result==GX_DIVERGED) {
        snprintf(tracking,sizeof(tracking),"refs/remotes/origin/%s",remoteBranch+11);
        result=CheckoutAttach(&folder);
        if(!result) {
            CheckoutBegin("Reviewing fetched and local history...");NetPullGuard(&condition);
            result=GXMergePrepare(&gUICheckout,localBranch,oldTip,tracking,targetTip,0,'\n',&limits,&plan);
        }
        NetPullGuard(NULL);closed=CheckoutRelease();if(!result)result=closed;gBusy=0;
        if(result)goto failed;
        if(plan.kind==MM_MULTIPLE_BASES || plan.kind==MM_UNRELATED) {
            result=MM_POLICY;strcpy(message,plan.kind==MM_MULTIPLE_BASES?
                "Fetch completed. Pull found multiple best common ancestors; recursive merge-base handling is not available yet. Local files and branches were kept.":
                "Fetch completed. Local and remote histories have no common ancestor. Pull did not merge unrelated histories or replace local files.");goto done;
        }
        if(plan.kind==MM_UPTODATE){strcpy(message,"The fetched remote history is already included in this local branch.");goto done;}
        if(!NetPullConfirm(binding,&plan) || gDone){strcpy(message,"Fetch kept; the Pull merge was not approved. Your local branch and working files stayed in place.");goto done;}
        if(plan.kind!=MM_CONFLICT && plan.kind!=MM_FAST_FORWARD && !LocalAuthor(0)) {
            strcpy(message,"Fetch kept. Pull needs a commit author before creating a merge commit.");goto done;
        }
        result=CheckoutAttach(&folder);
        if(!result) {
            CheckoutBegin(plan.kind==MM_CONFLICT?"Saving a recoverable Pull merge...":"Merging the fetched remote changes...");NetPullGuard(&condition);
            if(plan.kind==MM_CONFLICT) {
                result=MSPlanID(&plan,none.planID);
                if(!result)result=GXMergeBegin(&gUICheckout,&plan,&none,&sl,&why,&started);
            } else {
                GetDateTime(&macTime);ReadLocation(&location);delta=location.u.gmtDelta & 0x00ffffffL;
                if(delta & 0x00800000L)delta|=0xff000000L;
                snprintf(seconds,sizeof(seconds),"%lu",macTime-delta-2082844800UL);LocalDisplayPath(remoteBranch+11,display);
                snprintf(commitMessage,sizeof(commitMessage),"Pull origin/%.255s",display);
                result=GXMergeApply(&gUICheckout,&plan,gLocalIdentity,gLocalIdentity,seconds,"+0000",commitMessage,&why,&advanced,oid);
            }
        }
        NetPullGuard(NULL);closed=CheckoutRelease();if(!result)result=closed;
        if(result)goto failed;
        strcpy(message,started?"Pull saved a merge review. Resolve the conflicts, then Continue Merge; Abort restores the original files.":
            "Pull merged the fetched remote history. The local branch, index and Macintosh forks were updated together.");goto done;
    }
    if (!result)
        strcpy(message, advanced ? "Pull complete. The current branch, index, files and Macintosh forks advanced together."
                                 : "Already up to date. Your local branch and working files stayed in place.");
    else {
failed:
    if (why.reason)
        snprintf(message, sizeof(message), "Pull stopped because local changes conflict with the update: %.250s. Commit your changes or move the conflicting file, then try Pull again. The fetched objects are kept.", why.path);
    else
        snprintf(message, sizeof(message), "Pull stopped (error %d). Refresh before continuing. If checkout recovery is offered, choose Finish or Restore Original; keep the repository folder intact.", result);
    }
done:
    NetPullGuard(NULL);NetBindingFree(binding);free(binding);MMFree(&plan);MSChoicesFree(&none);free(localBranch); gBusy = 0;
    if (!gDone) {
        LocalRefresh(); NetworkHeader(); SetStatus(message);
        if (result) Message("Pull", message);
        SetPort(gWindow); InvalRect(&gWindow->portRect);
    }
}

typedef struct {
    FSSpec spec;
    short ref;
    int opened, owned;
    long id;
    const unsigned char *command;
    size_t commandLength, packLength;
} NetPushFile;
typedef struct {
    GSMacStore *store;
    NetBinding binding;
    char local[1025],remote[1025];
    char accountID[32];
    FSSpec folder;
    unsigned char lease[20];
    NetPushFile file;
} NetPushContext;
static int NetPushFileEnd(void *context) {
    NetPushContext *c = (NetPushContext *)context;
    OSErr error = noErr;
    GFCatalog catalog;
    if (c->file.opened) {
        error = FSClose(c->file.ref);
        if (!error) c->file.opened = 0;
    }
    if (!error && c->file.owned) {
        if (GFCatalogRead(&c->file.spec, &catalog, &error) || catalog.id != c->file.id) return GS_CONFLICT;
        error = FSpDelete(&c->file.spec);
        if (!error) c->file.owned = 0;
    }
    return error ? GS_IO : 0;
}
static int NetPushFileBegin(void *context) {
    NetPushContext *c = (NetPushContext *)context;
    char name[32]; Str31 leaf;
    unsigned int attempt; OSErr error; GFCatalog catalog;
    if (!c->store->leaseHeld || c->file.opened || c->file.owned) return GS_CONFLICT;
    for (attempt = 0; attempt < 256; ++attempt) {
        sprintf(name, "ghpush-%08lx-%02x", TickCount(), attempt);
        leaf[0] = (unsigned char)strlen(name); memcpy(leaf + 1, name, leaf[0]);
        error = FSMakeFSSpec(c->store->volume, c->store->directory, leaf, &c->file.spec);
        if (!error) continue;
        if (error != fnfErr) return GS_IO;
        error = FSpCreate(&c->file.spec, 'GHCl', 'GHPk', smSystemScript);
        if (error == dupFNErr) continue;
        if (error) return GS_IO;
        c->file.owned = 1;
        if (GFCatalogRead(&c->file.spec, &catalog, &error)) return GS_IO;
        c->file.id = catalog.id;
        error = FSpOpenDF(&c->file.spec, fsRdWrPerm, &c->file.ref);
        if (!error) { c->file.opened = 1; return 0; }
        NetPushFileEnd(context); return GS_IO;
    }
    return GS_CONFLICT;
}
static int NetPushFileRead(void *context, size_t at, void *bytes, size_t length) {
    NetPushContext *c = (NetPushContext *)context;
    long n; OSErr error;
    if (!c->file.opened || at > 0x7fffffffUL || length > 32768) return GB_BAD;
    error = SetFPos(c->file.ref, fsFromStart, (long)at); n = (long)length;
    if (!error && length) error = FSRead(c->file.ref, &n, bytes);
    return error || n != (long)length ? GS_IO : 0;
}
static int NetPushFileWrite(void *context, size_t at, const void *bytes, size_t length) {
    NetPushContext *c = (NetPushContext *)context;
    long n; OSErr error;
    if (!c->file.opened || at > 0x7fffffffUL || length > 32768) return GB_BAD;
    error = SetFPos(c->file.ref, fsFromStart, (long)at); n = (long)length;
    if (!error && length) error = FSWrite(c->file.ref, &n, bytes);
    return error || n != (long)length ? GS_IO : 0;
}
static int NetPushSource(void *context, size_t at, void *bytes, size_t length) {
    NetPushContext *c = (NetPushContext *)context;
    size_t prefix = 0, offset;
    if (at > c->file.commandLength + c->file.packLength ||
        length > c->file.commandLength + c->file.packLength - at) return GB_BAD;
    if (at < c->file.commandLength) {
        prefix = c->file.commandLength - at; if (prefix > length) prefix = length;
        memcpy(bytes, c->file.command + at, prefix);
    }
    if (prefix == length) return 0;
    offset = at + prefix - c->file.commandLength;
    return NetPushFileRead(context, offset, (unsigned char *)bytes + prefix, length - prefix);
}
static int NetPushFilePost(void *context, const char *repository, const void *command,
                            size_t commandLength, size_t packLength, unsigned char **body, size_t *length) {
    NetPushContext *c = (NetPushContext *)context;
    long end; int error;
    if (!c->file.opened || commandLength > (size_t)-1 - packLength) return GB_BAD;
    error = GetEOF(c->file.ref, &end);
    if (error || end < 0 || (size_t)end != packLength) return GS_IO;
    c->file.command = (const unsigned char *)command;
    c->file.commandLength = commandLength; c->file.packLength = packLength;
    error = NetServiceHTTPSource(1, repository, NULL, commandLength + packLength,
                                NetPushSource, context, body, length);
    c->file.command = NULL; c->file.commandLength = c->file.packLength = 0;
    return error;
}
static void NetPushFileIO(GUFileIO *io, NetPushContext *context) {
    memset(io, 0, sizeof(*io)); io->context = context;
    io->begin = NetPushFileBegin; io->read = NetPushFileRead; io->write = NetPushFileWrite;
    io->post = NetPushFilePost; io->end = NetPushFileEnd;
}

static int NetPushBind(void *context, const GUIntent *intent) {
    NetPushContext *c = (NetPushContext *)context;
    if (!gCredentials.bound || !gToken[0] || strcmp(gCredentials.accountID, c->accountID) ||
        strcmp(intent->accountID, c->accountID)) return OA_WRONG_ACCOUNT;
    if(strcmp(intent->repository,c->binding.repository) || strcmp(intent->branch,c->remote) ||
        strcmp(intent->version>=2?intent->localBranch:intent->branch,c->local))return GS_CONFLICT;
    return NetBindingCheck(c->store,&c->binding);
}
static int NetPushExchange(void *context, int post, const char *repository,
                             const void *payload, size_t n, unsigned char **body, size_t *length) {
    (void)context;
    if (gDone || gCheckoutStopped) return SSL_CANCELLED;
    if (post != (payload != NULL)) return GB_BAD;
    return NetServiceHTTP(1, repository, payload, n, body, length);
}
static int NetPushRetry(void *context, const GUIntent *intent) {
    OperationPrompt prompt;char repository[256],branch[256],local[256],state[620],oldTip[41],newTip[41];
    (void)context;
    if (gDone || !intent) return 0;
    memset(&prompt,0,sizeof(prompt));LocalDisplayPath(intent->repository,repository);LocalDisplayPath(intent->branch,branch);
    LocalDisplayPath(intent->version>=2?intent->localBranch:intent->branch,local);
    snprintf(state,sizeof(state),"Local: %s\rRemote: %s",local,branch);
    GBOIDFormat(intent->oldTip,oldTip);GBOIDFormat(intent->newTip,newTip);
    prompt.title=intent->version==3?"Retry Force Push with Lease":"Retry Pending Push";prompt.repository=repository;prompt.state=state;
    prompt.primary=intent->version==3?"Retry Force Push":"Retry Push";prompt.canPrimary=1;
    prompt.primaryText=intent->version==3?
        "Retry the saved history replacement. GitHub must still have the exact originally approved remote commit; this can remove remote-only commits from the branch.":
        "GitHub still advertises the original remote commit. Retry sends the same saved commit with the original remote-tip guard.";
    prompt.secondaryText="Keep the saved upload pending. You can review it again without sending another request.";
    prompt.footer="Retrying does not change your local branch or working files.";
    prompt.labels[0]="Local branch";prompt.values[0]=intent->version>=2?intent->localBranch:intent->branch;prompt.labels[1]="Remote branch";prompt.values[1]=intent->branch;
    prompt.labels[2]="Original remote commit";prompt.values[2]=oldTip;prompt.labels[3]="Saved upload commit";prompt.values[3]=newTip;
    return OperationConfirm(&prompt)==1;
}
static char *NetPushDetails(const GUIntent *intent) {
    OperationPrompt prompt;char oldTip[41],newTip[41],state[100];
    memset(&prompt,0,sizeof(prompt));GBOIDFormat(intent->oldTip,oldTip);GBOIDFormat(intent->newTip,newTip);
    snprintf(state,sizeof(state),"Earlier Push: result unconfirmed.\rBound account ID: %s",intent->accountID);
    prompt.title=intent->version==3?"Pending Force Push with Lease":"Pending Push";prompt.repository=intent->repository;prompt.state=state;
    prompt.primaryText="Set Aside archives the exact saved intent before releasing the active record. It cannot cancel an upload or confirm failure.";
    prompt.footer="The next Push discovers GitHub again. Local/tracking refs, index and working files stay in place.";
    prompt.labels[0]="Local branch";prompt.values[0]=intent->version>=2?intent->localBranch:intent->branch;
    prompt.labels[1]="Remote branch";prompt.values[1]=intent->branch;prompt.labels[2]="Previous remote tip";prompt.values[2]=oldTip;
    prompt.labels[3]="Saved upload commit";prompt.values[3]=newTip;
    return OperationDetails(&prompt);
}
/* Review is entirely local and needs no token, current origin or matching HEAD.
   The modal review holds no writer lease. Reattach, bind the database catalog
   identity and compare the complete intent again before making either write. */
static void NetPushShortName(const char *name, char display[256]) {
    LocalDisplayPath(name, display);
    if (strlen(display) > 54) strcpy(display + 51, "...");
}
static const GUIntent *gPushReview;
static UserItemUPP gPushReviewArt;
static pascal void NetPushReviewDraw(DialogPtr dialog,short number) {
    GrafPtr saved;PenState pen;RGBColor foreground;short kind,font,size;Style face;Handle item;Rect r;
    char repository[256],local[256],remote[256];const char *localRef;
    if(!gPushReview)return;
    (void)number;GetPort(&saved);SetPort((GrafPtr)dialog);font=((GrafPtr)dialog)->txFont;size=((GrafPtr)dialog)->txSize;face=((GrafPtr)dialog)->txFace;
    GetPenState(&pen);GetForeColor(&foreground);PenNormal();GetDialogItem(dialog,4,&kind,&item,&r);
    Box(r.left,r.top,r.right,r.bottom,255,255,255);
    localRef=gPushReview->version>=2?gPushReview->localBranch:gPushReview->branch;
    NetPushShortName(gPushReview->repository,repository);NetPushShortName(localRef+11,local);NetPushShortName(gPushReview->branch+11,remote);
    Text(28,77,"REMOTE REPOSITORY",gGeneva,9,64,64,64);Text(28,96,repository,gGeneva,14,0,0,0);
    Text(28,123,"Local branch",gGeneva,9,64,64,64);Text(28,140,local,gGeneva,12,0,0,0);
    Text(28,163,"Remote branch",gGeneva,9,64,64,64);Text(28,180,remote,gGeneva,12,0,0,0);
    Color(128,128,128);MoveTo(28,194);LineTo(520,194);
    Text(28,218,gPushReview->version==3?"Force Push: result unconfirmed":"Result unconfirmed",gGeneva,14,0,0,0);
    Text(28,235,"This earlier upload may still finish on GitHub.",gGeneva,9,64,64,64);
    Text(28,264,"Set Aside",gGeneva,12,32,70,128);
    Text(28,282,"Keep a local receipt, then release this pending record.",gGeneva,9,0,0,0);
    Text(28,296,"This does not cancel an upload or change files or refs.",gGeneva,9,0,0,0);
    Text(28,324,"Keep Pending",gGeneva,12,32,70,128);
    Text(28,342,"Keep the record. The next Push checks GitHub again.",gGeneva,9,0,0,0);
    Text(28,359,"Details contains full branch names, account ID and commit IDs.",gGeneva,9,64,64,64);
    RGBForeColor(&foreground);SetPenState(&pen);TextFont(font);TextSize(size);TextFace(face);SetPort(saved);
}
static void NetworkReviewPush(void) {
    GSRepository repository;
    GUIntent intent;
    FSSpec folder;
    DialogPtr d;
    short volume = 0, hit = 0,kind;Handle item;Rect bounds;
    long directory = 0;
    char *details = NULL;
    int result, closed, active = 0, selected = 0, count;
    if (!gLocal || gBusy || gLocalBlocked) return;
    folder = gWork.folder;
    result = CheckoutAttach(&folder);
    if (!result) {
        NetReader(&repository, &gUICheckout.store);
        result = GUIntentRead(&repository, &intent, &active);
        volume = gUICheckout.store.volume; directory = gUICheckout.store.directory;
    }
    closed = CheckoutRelease(); if (!result) result = closed;
    if (result) {
        Message("Review Pending Push", "The saved Push could not be read or validated. No record was cleared. Keep this repository folder intact and refresh before continuing.");
        return;
    }
    if (!active) { Message("Review Pending Push", "This repository has no pending Push record."); return; }
    details = NetPushDetails(&intent);
    if (!details) { Message("Review Pending Push", "Not enough memory to review the complete saved Push. No record was cleared."); return; }
    count=(int)strlen(details);
    d = GetNewDialog(147, NULL, (WindowPtr)-1);
    if (!d) { free(details); return; }
    if(!gPushReviewArt)gPushReviewArt=NewUserItemProc(NetPushReviewDraw);
    if(!gPushReviewArt || !PrepareDialogChrome(d,5,6)){DisposeDialog(d);free(details);SetPort(gWindow);return;}
    gPushReview=&intent;GetDialogItem(d,4,&kind,&item,&bounds);SetDialogItem(d,4,kind,(Handle)gPushReviewArt,&bounds);
    PrepareDialog(d, 1, 1);
    while (!gDone && hit != 1 && hit != 2) {
        RunModalDialog(gDialogFilter, &hit);
        if (hit == 3) { ZeroScrap(); PutScrap((long)count, 'TEXT', details); }
        if(hit==7) {Message("Saved Push Details",details);SetPort((GrafPtr)d);InvalRect(&((WindowPtr)d)->portRect);}
    }
    selected = !gDone && hit == 2;
    DisposeDialog(d);gPushReview=NULL;free(details);SetPort(gWindow);
    if (!selected) return;
    gBusy = 1;
    result = CheckoutAttach(&folder);
    if (!result && (volume != gUICheckout.store.volume || directory != gUICheckout.store.directory)) result = GS_CONFLICT;
    if (!result) result = GSMacEnter(&gUICheckout.store, 0);
    if (!result) {
        repository = gUICheckout.raw; repository.read = NetRead;
        result = GURetire(&repository, &intent);
    }
    closed = CheckoutRelease(); if (!result) result = closed;
    gBusy = 0;
    if (!gDone) {
        LocalRefresh(); NetworkHeader();
        if (result) {
            SetStatus("Could not confirm setting aside the saved Push. Review Pending Push again.");
            Message("Review Pending Push", "Setting aside could not be confirmed. The snapshot may already be saved. Keep the repository folder intact, refresh and review again. This says nothing about the earlier upload's remote result.");
        } else SetStatus("Saved Push set aside locally. Snapshot kept; the next Push checks GitHub again. An earlier upload may still finish.");
        SetPort(gWindow); InvalRect(&gWindow->portRect);
    }
}
/* The reviewed lease comes only from the previously fetched tracking ref.
   Release the store before the modal review; the caller reattaches and checks
   exact configuration, HEAD, account and tracking bytes before discovery. */
static int NetForcePushConfirm(const NetPushContext *context,const unsigned char tip[20]) {
    OperationPrompt prompt;char oldTip[41],newTip[41],state[160];
    memset(&prompt,0,sizeof(prompt));GBOIDFormat(context->lease,oldTip);GBOIDFormat(tip,newTip);
    snprintf(state,sizeof(state),"Remote was: %s\rUpload: %s",oldTip,newTip);
    prompt.title="Force Push with Lease";prompt.repository=context->binding.repository;prompt.state=state;
    prompt.primary="Force Push";prompt.canPrimary=1;
    prompt.primaryText="Replace the remote branch with your local history. Remote-only commits can leave this branch. GitHub must still match the exact reviewed remote commit above.";
    prompt.secondaryText="Keep the remote branch unchanged. No upload is sent.";
    prompt.footer="Local files stay in place. Details shows full branch names and commit IDs. A changed remote is refused; Fetch and review again.";
    prompt.labels[0]="Local branch";prompt.values[0]=context->local;
    prompt.labels[1]="Remote branch to replace";prompt.values[1]=context->remote;
    prompt.labels[2]="Approved remote commit";prompt.values[2]=oldTip;
    prompt.labels[3]="Upload commit";prompt.values[3]=newTip;
    return OperationConfirm(&prompt)==1;
}
static void NetworkPushMode(int force) {
    NetPushContext *context;
    GUCallbacks calls;
    GUFileIO fileIO;
    GUPushResult pushed;
    GSRepository repository;
    GVLimits limits;
    char *branch = NULL,message[768],tracking[1100];GUIntent pendingIntent;
    unsigned char tip[20],currentLease[20],zero[20];
    int result = 0, closed,attempt,active=0,configure;
    if (!gLocal || !gWork.haveHead || gBusy || gLocalBlocked) return;
    LocalRefresh(); if (gLocalBlocked || gDone) return;
    if (!gCredentials.bound || !gToken[0]) SignIn();
    if (!gCredentials.bound || !gToken[0] || gDone) return;
    if (OARefreshNeeded(&gCredentials, AuthNow()) && RefreshCredentials()) return;
    context=(NetPushContext *)calloc(1,sizeof(*context));if(!context){LocalError("Push",GB_MEMORY);return;}
    NetBindingInit(&context->binding);memset(&pushed,0,sizeof(pushed));GUIntentInit(&pendingIntent);memset(zero,0,sizeof(zero));
    context->folder=gWork.folder;
    for(attempt=0;attempt<2;++attempt) {
    free(branch);branch=NULL;NetBindingFree(&context->binding);configure=0;gBusy=1;
    result = CheckoutAttach(&context->folder);
    if (!result) result = GSMacEnter(&gUICheckout.store, 0);
    if (result) goto done;
    context->store = &gUICheckout.store;
    repository = gUICheckout.raw; repository.read = NetRead;
    result = GSHead(&repository, &branch, tip);
    if (!result && (strcmp(branch, gWork.branch) || memcmp(tip, gWork.tip, 20))) result = GS_CONFLICT;
    if (result) goto done;
    result=GUIntentRead(&repository,&pendingIntent,&active);pushed.pending=active;
    if(result){pushed.pending=1;goto done;}
    if(force && active){strcpy(message,"An earlier Push is still pending. Use Push to check its result, or Review Pending Push to inspect it before approving a new history replacement.");goto finish;}
    result=NetBindingCapture(context->store,branch,NULL,&context->binding);
    configure=!active && ((result==GS_NOT_FOUND && !context->binding.origin) || (!result && !context->binding.route.tracked));
    if(configure && !attempt) {
        closed=CheckoutRelease();gBusy=0;if(closed){result=closed;goto done;}
        result=NetworkUpstream();if(result!=1 || gDone){if(!result || gDone){result=0;strcpy(message,"Push cancelled before upload. No new target was approved.");goto finish;}goto done;}
        result=0;continue;
    }
    if (result) goto done;
    if(!active && !context->binding.route.tracked){strcpy(message,"Choose an upstream before publishing this branch. No upload was sent.");goto finish;}
    if(!gCredentials.bound || !gToken[0]){result=OA_PERMISSION;goto done;}
    strcpy(context->accountID,gCredentials.accountID);
    strcpy(context->local,active?(pendingIntent.version>=2?pendingIntent.localBranch:pendingIntent.branch):branch);
    strcpy(context->remote,active?pendingIntent.branch:context->binding.route.remoteBranch);
    if(force) {
        snprintf(tracking,sizeof(tracking),"refs/remotes/origin/%s",context->remote+11);
        result=GSReadRef(&repository,tracking,context->lease);
        if(result==GS_NOT_FOUND || (!result && !memcmp(context->lease,zero,20))) {
            result=0;strcpy(message,"Fetch this upstream before Force Push with Lease. Review its remote history first; no upload was sent.");goto finish;
        }
        if(result)goto done;
        closed=CheckoutRelease();gBusy=0;if(closed){result=closed;goto done;}
        if(!NetForcePushConfirm(context,tip) || gDone){strcpy(message,"Force Push cancelled before upload. No history replacement was approved.");goto finish;}
        gBusy=1;result=CheckoutAttach(&context->folder);
        if(!result)result=GSMacEnter(&gUICheckout.store,0);
        if(!result)result=NetBindingCheck(&gUICheckout.store,&context->binding);
        if(!result) {
            repository=gUICheckout.raw;repository.read=NetRead;
            result=NetHeadCheck(&repository,context->local,tip,1);
        }
        if(!result)result=GSReadRef(&repository,tracking,currentLease);
        if(!result && memcmp(currentLease,context->lease,20))result=GS_CONFLICT;
        if(!result)result=GUIntentRead(&repository,&pendingIntent,&active);
        if(!result && active){pushed.pending=1;result=GS_CONFLICT;}
        if(result)goto done;
    }
    CheckoutBegin(force?"Preparing the approved Force Push with Lease...":"Preparing Push... Your local branch and files stay in place.");
    calls.context = context; calls.exchange = NetPushExchange; calls.bind = NetPushBind;
    calls.retry = NetPushRetry; calls.progress = NetGraphProgress;
    NetPushFileIO(&fileIO, context);
    limits.objects = 65536; limits.objectBytes = 2UL * 1024 * 1024; limits.readBytes = 256UL * 1024 * 1024;
    result = GUExecuteFileTo(&repository, context->binding.repository, context->local, context->remote,
                              context->accountID, tip, force ? context->lease : NULL, &limits,
                              128UL * 1024 * 1024, &calls, &fileIO, &pushed);
    break;
    }
done:
    if (result) {
        if (pushed.remoteAccepted)
            strcpy(message, "GitHub accepted the Push, but local acknowledgement needs recovery. Keep this folder intact and choose Push again to check the remote before continuing.");
        else if (pushed.pending)
            strcpy(message, "Push has no confirmed final result. Its record is kept. Choose Push again to check GitHub, or Repository > Review Pending Push to inspect its original binding and set it aside locally. Do not assume the upload failed.");
        else if (result == GB_SPACE)
            strcpy(message, "Push exceeds the 128 MiB on-disk pack, 256 MiB history-read, or 2 MiB object limit. No upload was started. Your local commit and files were kept.");
        else if (result == SSL_NO_SEED)
            strcpy(message, "Secure networking needs setup or unlock. Choose Help > Test GitHub Connection, then retry Push.");
        else if (result == 401 || result == 403 || result == OA_PERMISSION || result == OA_WRONG_ACCOUNT)
            strcpy(message, "GitHub did not authorize Push. Sign in with write access to this repository; GitHub passwords are not used for Git authentication.");
        else
            snprintf(message, sizeof(message), "Push stopped before a pending upload (error %d). Fetch first to obtain remote history, then retry. Your local branch, index and files were kept.", result);
    } else switch (pushed.outcome) {
    case GU_PUSH_ACCEPTED:
        strcpy(message, "Push confirmed by GitHub. The origin tracking branch is updated; your local branch and files stayed in place."); break;
    case GU_PUSH_CURRENT:
        strcpy(message, "Already up to date. GitHub advertises this branch at the same commit."); break;
    case GU_PUSH_REJECTED:
        snprintf(message, sizeof(message), pushed.pending ? "GitHub rejected this retry: %.250s. The earlier upload is still uncertain, so its record stays pending. Choose Push again to check GitHub."
                                                        : "GitHub rejected the Push: %.250s. The pending record is cleared; your local branch and files were kept.", pushed.reason); break;
    case GU_PUSH_DIVERGED:
        strcpy(message, "Push refused because the remote tip is not an ancestor of your local branch. Fetch/Pull and resolve divergence first. To publish deliberately rewritten history, review Repository > Force Push with Lease separately. No force update was sent."); break;
    case GU_PUSH_LEASE_CHANGED:
        strcpy(message,"Force Push refused: GitHub no longer has the exact remote commit you approved. No upload was sent. Fetch, inspect the changed history, then review a new lease if appropriate.");break;
    case GU_PUSH_REMOTE_CHANGED:
        strcpy(message, "The remote changed after an uncertain Push. Its tip matches neither saved value, so the record stays pending. Fetch and inspect History. Repository > Review Pending Push can keep a snapshot and set the record aside locally; no force update was sent."); break;
    case GU_PUSH_LOCAL_CHANGED:
        strcpy(message, "The saved Push is still pending, but your local branch changed. It was not resent. Repository > Review Pending Push can keep a snapshot and set the record aside locally. The next Push checks GitHub again."); break;
    default:
        strcpy(message, "Push retry cancelled. The earlier operation stays pending; choose Push again to check GitHub."); break;
    }
finish:
    free(branch);NetBindingFree(&context->binding);free(context);
    closed = CheckoutRelease();
    if (closed) {
        result = closed;
        strcat(message, " Repository cleanup needs attention; refresh before continuing.");
    }
    gBusy = 0;
    if (!gDone) {
        LocalRefresh(); NetworkHeader(); SetStatus(message);
        if (result || (pushed.outcome && pushed.outcome != GU_PUSH_ACCEPTED && pushed.outcome != GU_PUSH_CURRENT)) Message(force?"Force Push with Lease":"Push", message);
        SetPort(gWindow); InvalRect(&gWindow->portRect);
    }
}
static void NetworkPush(void) {NetworkPushMode(0);}
static void NetworkForcePush(void) {NetworkPushMode(1);}

/* Exercise the production disk-backed pack writer without network or ref changes. */
static void NetworkPushCheck(void) {
    GSRepository reader; GVLimits limits; GVResult graph; GUFileIO file;
    NetPushContext *context; char *branch = NULL, message[512]; unsigned char tip[20];
    size_t n = 0; int result, closed, opened = 0;
    if (!gLocal || !gWork.haveHead || gBusy || gLocalBlocked) return;
    LocalRefresh(); if (gLocalBlocked || gDone) return;
    context = (NetPushContext *)calloc(1, sizeof(*context));
    if (!context) { LocalError("Test Push Pack", GB_MEMORY); return; }
    result = CheckoutAttach(&gWork.folder);
    if (!result) result = GSMacEnter(&gUICheckout.store, 0);
    if (!result) {
        CheckoutBegin("Checking a push pack on disk... No network request will be sent.");
        context->store = &gUICheckout.store; NetPushFileIO(&file, context);
        NetReader(&reader, context->store); result = GSHead(&reader, &branch, tip);
        if (!result && (strcmp(branch, gWork.branch) || memcmp(tip, gWork.tip, 20))) result = GS_CONFLICT;
        limits.objects = 65536; limits.objectBytes = 2UL * 1024 * 1024; limits.readBytes = 256UL * 1024 * 1024;
        if (!result) { result = file.begin(file.context); if (!result) opened = 1; }
        if (!result) result = GUPackWrite(&reader, tip, &limits, 32UL * 1024 * 1024,
                                          NetGraphProgress, NULL, &file, &n, &graph);
        if (opened) { closed = file.end(file.context); if (!result) result = closed; }
    }
    free(branch); free(context); closed = CheckoutRelease(); if (!result) result = closed; gBusy = 0;
    if (!gDone) {
        LocalRefresh(); NetworkHeader();
        if (result) snprintf(message, sizeof(message), "Disk push-pack check stopped (error %d). No upload or branch change.", result);
        else snprintf(message, sizeof(message), "Disk push pack checked: %lu bytes, %lu verified objects. Temporary file removed; no upload or branch change.",
                       (unsigned long)n, (unsigned long)graph.objects);
        SetStatus(message); if (result) Message("Test Push Pack", message);
        SetPort(gWindow); InvalRect(&gWindow->portRect);
    }
}

/* Clone owns only a newly selected empty folder or a folder carrying its exact
   saved operation record. A completed record remains as provenance. */
static int NetCloneDestination(const FSSpec *folder, const char *pending, size_t pn,
                                const char *complete, size_t cn, int *empty, int *finished) {
    GSMacStore root, store;
    GSRepository r;
    FSSpec database;
    CInfoPBRec pb;
    Str31 name;
    unsigned char *bytes = NULL;
    size_t n = 0;
    OSErr error;
    int result;
    *empty = *finished = 0;
    result = GSMacAttach(&r, &root, folder, 0);
    if (result) return result;
    memset(&pb, 0, sizeof(pb));
    pb.dirInfo.ioVRefNum = root.volume; pb.dirInfo.ioDrDirID = root.directory;
    pb.dirInfo.ioFDirIndex = 1; pb.dirInfo.ioNamePtr = name;
    error = PBGetCatInfoSync(&pb);
    if (error == fnfErr) { *empty = 1; return 0; }
    if (error) return GS_IO;
    error = FSMakeFSSpec(root.volume, root.directory, "\p.git", &database);
    if (error) return error == fnfErr ? GS_CONFLICT : GS_IO;
    result = GSMacAttach(&r, &store, &database, 0);
    if (!result) result = GSMacReadLimit(&store, "ghclient-clone", &bytes, &n, 512);
    if (!result) {
        if (n == cn && !memcmp(bytes, complete, n)) *finished = 1;
        else if (n != pn || memcmp(bytes, pending, n)) result = GS_CONFLICT;
    } else if (result == GS_NOT_FOUND) result = GS_CONFLICT;
    free(bytes); return result;
}
#include "GitCloneUI.c"
static void NetworkClone(void) {
    GWWorkspace clone;
    FSSpec folder;
    GQError why;
    unsigned char tip[20], *bytes = NULL;
    char owner[256] = "", branch[1025], configured[256], tracking[1100];
    char pending[300], complete[300], message[768], status[256];
    size_t pn, cn, n = 0;
    int result = 0, closed, empty, finished, saved = 0, owned = 0, opened = 0;
    if (gBusy) return;
    if (!CloneChooseDestination(owner, &folder)) return;
    GWInit(&clone);
    pn = (size_t)snprintf(pending, sizeof(pending), "GHClone1\n%s\n", owner);
    cn = (size_t)snprintf(complete, sizeof(complete), "GHCloneDone1\n%s\n", owner);
    result = NetCloneDestination(&folder, pending, pn, complete, cn, &empty, &finished);
    if (result) goto done;
    owned = !empty;
    result = GWOpen(&clone, &folder, empty);
    if (result == GC_RECOVERY && owned && !gDone) {
        if (!CheckoutRecovery(&folder)) goto done;
        result = GWOpen(&clone, &folder, 0);
    }
    if (result) goto done;
    opened = 1;
    if (empty) {
        result = clone.repository.replace(clone.repository.context, "ghclient-clone", NULL, 0, pending, pn);
        if (result) goto done;
        owned = 1;
    }
    if (clone.haveHead) {
        result = NetOriginRead(&clone.database, configured, branch, &bytes, &n);
        if (!result && (strcmp(configured, owner) || strcmp(clone.branch, branch))) result = GS_CONFLICT;
        if (!result) {
            snprintf(tracking, sizeof(tracking), "refs/remotes/origin/%s", branch + 11);
            result = GSReadRef(&clone.repository, tracking, tip);
        }
        if (!result && memcmp(tip, clone.tip, 20)) result = GS_CONFLICT;
        if (result) goto done;
    } else {
        if (clone.index.count) { result = GS_CONFLICT; goto done; }
        if(finished) {
            result=NetRead(&clone.database,"ghclient-empty-clone",&bytes,&n);
            free(bytes);bytes=NULL;n=0;
            if(result){if(result==GS_NOT_FOUND)result=GS_CONFLICT;goto done;}
        }
        result = NetFetchFolder(&folder, &clone.database, owner, branch, tip, &saved,NULL);
        if (result || !saved || gDone) goto done;
        if(saved==2){finished=1;goto done;}
        if(finished){result=GS_CONFLICT;goto done;}
        result = CheckoutAttach(&folder);
        if (!result) {
            CheckoutBegin("Checking out the cloned branch... Escape stops at a recoverable checkpoint.");
            result = GXToCommit(&gUICheckout, branch, NULL, tip, &why);
        }
        closed = CheckoutRelease(); if (!result) result = closed;
        if (result) goto done;
    }
    if (!finished)
        result = clone.repository.replace(clone.repository.context, "ghclient-clone", pending, pn, complete, cn);
    if (!result) finished = 1;
done:
    free(bytes); GWClose(&clone);
    closed = CheckoutRelease(); if (!result) result = closed;
    gBusy = 0; strcpy(status, gStatus);
    if (!gDone) {
        if (gLocal) { LocalRefresh(); NetworkHeader(); }
        if (!result && finished) {
            LocalOpenSpec(&folder, 0);
            if (gLocal && gWork.folder.vRefNum == folder.vRefNum &&
                gWork.folder.parID == folder.parID && !RelString(gWork.folder.name, folder.name, false, true))
                SetStatus(saved==2?"Empty clone complete. Add files and commit; Push will create its first remote branch.":"Clone complete. The selected branch, index, files and Macintosh forks are checked out.");
            else SetStatus("Clone saved. Use Add Local Repository to open its folder.");
        } else if (result) {
            if (!owned)
                snprintf(message, sizeof(message), "Clone could not start (error %d). Choose an empty folder; existing files were kept.", result);
            else
                snprintf(message, sizeof(message), "Clone is incomplete (error %d). %s\r\rThe folder is kept. Choose Clone again and select the same folder to resume; Add Local Repository can also open checkout recovery.", result, opened ? status : "Checkout recovery may be pending.");
            SetStatus("Clone did not complete. Its folder and existing files were kept.");
            Message("Clone Repository", message);
        } else SetStatus("Clone cancelled. Its initialized folder is kept; choose Clone again to resume.");
        SetPort(gWindow); InvalRect(&gWindow->portRect);
    }
}
