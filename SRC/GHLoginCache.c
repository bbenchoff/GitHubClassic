/* Included by the client; passphrase lives only in app/helper RAM, never disk.
   Helper is an installed sibling application. No automatic installation into
   System Folder, no OS restart requirement, no retained key across Mac reboots. */
#include <Processes.h>
static int LCName(const Str255 name) {
    static const char title[]="GHClient Login Helper";
    return name[0]==sizeof(title)-1 && !memcmp(name+1,title,sizeof(title)-1);
}
static OSErr LCFind(ProcessSerialNumber *psn,int launch) {
    ProcessInfoRec info;Str255 name;FSSpec app,self;ProcessSerialNumber current;LaunchParamBlockRec pb;OSErr error;
    psn->highLongOfPSN=psn->lowLongOfPSN=0;
    while(!GetNextProcess(psn)) {
        memset(&info,0,sizeof(info));info.processInfoLength=sizeof(info);info.processName=name;info.processAppSpec=&app;
        if(!GetProcessInformation(psn,&info) && LCName(app.name) && (info.processMode&modeOnlyBackground))return noErr;
    }
    if(!launch)return fnfErr;
    error=GetCurrentProcess(&current);if(error)return error;
    memset(&info,0,sizeof(info));info.processInfoLength=sizeof(info);info.processAppSpec=&self;
    error=GetProcessInformation(&current,&info);if(error)return error;
    error=FSMakeFSSpec(self.vRefNum,self.parID,"\pGHClient Login Helper",&app);if(error)return error;
    memset(&pb,0,sizeof(pb));pb.launchBlockID=extendedBlock;pb.launchEPBLength=extendedBlockLen;
    pb.launchControlFlags=launchContinue|launchNoFileFlags|launchDontSwitch;pb.launchAppSpec=&app;
    error=LaunchApplication(&pb);if(!error)*psn=pb.launchProcessSN;return error;
}
static OSErr LCRequest(OSType action,char pass[1025]) {
    ProcessSerialNumber psn;AEAddressDesc address;AppleEvent event,reply;DescType type;Size length=0;OSErr error;long remote=0;size_t i;
    error=LCFind(&psn,action=='stor');if(error)return error;
    memset(&address,0,sizeof(address));memset(&event,0,sizeof(event));memset(&reply,0,sizeof(reply));
    error=AECreateDesc(typeProcessSerialNumber,&psn,sizeof(psn),&address);
    if(!error)error=AECreateAppleEvent('GHVk',action,&address,kAutoGenerateReturnID,kAnyTransactionID,&event);
    if(!error && action=='stor')error=AEPutParamPtr(&event,keyDirectObject,typeChar,pass,(Size)strlen(pass));
    if(!error)error=AESend(&event,&reply,kAEWaitReply|kAENeverInteract|kAEDontRecord,kAENormalPriority,600,NULL,NULL);
    if(!error && !AEGetParamPtr(&reply,keyErrorNumber,typeLongInteger,&type,&remote,sizeof(remote),&length) && remote)error=(OSErr)remote;
    if(!error && action=='load') {
        GVClear(pass,1025);error=AEGetParamPtr(&reply,keyDirectObject,typeChar,&type,pass,1024,&length);
        if(!error && (length<1 || length>1024))error=paramErr;
        if(!error)for(i=0;i<(size_t)length;++i)if((unsigned char)pass[i]<32 || (unsigned char)pass[i]>126){error=paramErr;break;}
        if(error)GVClear(pass,1025);
    }
    AEDisposeDesc(&reply);AEDisposeDesc(&event);AEDisposeDesc(&address);return error;
}
static OSErr LCLoad(char pass[1025]) {return LCRequest('load',pass);}
static OSErr LCStore(const char pass[1025]) {
    char copy[1025];OSErr error;
    if(!pass || strlen(pass)>1024)return paramErr;
    strcpy(copy,pass);error=LCRequest('stor',copy);GVClear(copy,sizeof(copy));return error;
}
static void LCDrop(void) {LCRequest('drop',NULL);}
/* A key is usable only for the exact authenticated ciphertext identity. Older
   helpers reject these events; the caller then performs the ordinary KDF. */
static OSErr LCKeyRequest(OSType action,const void *vault,size_t n,unsigned char key[32]) {
    ProcessSerialNumber psn;AEAddressDesc address;AppleEvent event,reply;DescType type;
    unsigned char record[64],received[32];Size length=0;OSErr error;long remote=0;
    memset(record,0,sizeof(record));memset(received,0,sizeof(received));
    memset(&address,0,sizeof(address));memset(&event,0,sizeof(event));memset(&reply,0,sizeof(reply));
    error=GVKeyID(vault,n,record)?paramErr:noErr;
    if(!error)error=LCFind(&psn,0);
    if(!error && action=='ksto')memcpy(record+32,key,32);
    if(!error)error=AECreateDesc(typeProcessSerialNumber,&psn,sizeof(psn),&address);
    if(!error)error=AECreateAppleEvent('GHVk',action,&address,kAutoGenerateReturnID,kAnyTransactionID,&event);
    if(!error)error=AEPutParamPtr(&event,keyDirectObject,typeData,record,action=='ksto'?64:32);
    if(!error)error=AESend(&event,&reply,kAEWaitReply|kAENeverInteract|kAEDontRecord,kAENormalPriority,600,NULL,NULL);
    if(!error && !AEGetParamPtr(&reply,keyErrorNumber,typeLongInteger,&type,&remote,sizeof(remote),&length) && remote)error=(OSErr)remote;
    if(!error && action=='kloa') {
        error=AEGetParamPtr(&reply,keyDirectObject,typeData,&type,received,sizeof(received),&length);
        if(!error && (type!=typeData || length!=32))error=paramErr;
        if(!error)memcpy(key,received,32);
    }
    AEDisposeDesc(&reply);AEDisposeDesc(&event);AEDisposeDesc(&address);
    GVClear(record,sizeof(record));GVClear(received,sizeof(received));return error;
}
static OSErr LCKeyLoad(const void *vault,size_t n,unsigned char key[32]) {return LCKeyRequest('kloa',vault,n,key);}
static OSErr LCKeyStore(const void *vault,size_t n,const unsigned char key[32]) {
    unsigned char copy[32];OSErr error;
    if(!key)return paramErr;
    memcpy(copy,key,32);error=LCKeyRequest('ksto',vault,n,copy);GVClear(copy,sizeof(copy));return error;
}
