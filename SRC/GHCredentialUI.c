/* Native Preferences credential vault. Included after GHAuthUI.c. */
static VFStore gVaultStore;
static char gVaultPassword[1025],gVaultEntry[1025];
static unsigned char *gVaultCipher;
static size_t gVaultCipherLength;
static int gRememberVault,gVaultEntrySelected,gVaultFileError,gVaultCryptoChecked;
static int VaultCryptoReady(void) {int result;if(gVaultCryptoChecked)return 0;result=GVCheck();if(!result)gVaultCryptoChecked=1;return result;}
static void VaultBytesFree(unsigned char **bytes,size_t *length) {
    if(*bytes){GVClear(*bytes,*length);free(*bytes);*bytes=NULL;}*length=0;
}
static void VaultResetMemory(void) {
    GVClear(gVaultPassword,sizeof(gVaultPassword));VaultBytesFree(&gVaultCipher,&gVaultCipherLength);gRememberVault=0;
}
static unsigned long VaultUTC(void) {
    unsigned long seconds;long delta;MachineLocation location;
    GetDateTime(&seconds);ReadLocation(&location);delta=location.u.gmtDelta&0x00ffffffL;
    if(delta&0x00800000L)delta|=0xff000000L;
    seconds-=delta;return seconds>=2082844800UL?seconds-2082844800UL:0;
}
static int VaultProgress(void *unused) {(void)unused;return PumpEvents(0);}
static void VaultMask(DialogPtr dialog) {
    GrafPtr saved;Handle item;short kind;Rect r;Str255 stars;size_t i,n=strlen(gVaultEntry);
    GetPort(&saved);SetPort((GrafPtr)dialog);
    if(n>55)n=55;stars[0]=(unsigned char)n;for(i=0;i<n;++i)stars[i+1]='*';
    GetDialogItem(dialog,4,&kind,&item,&r);SetDialogItemText(item,stars);
    GetDialogItem(dialog,1,&kind,&item,&r);HiliteControl((ControlHandle)item,gVaultEntry[0]?0:255);SetPort(saved);
}
static pascal void VaultFrame(DialogPtr dialog,short number) {
    GrafPtr saved;PenState pen;RGBColor foreground;Handle item;short kind;Rect r;
    GetPort(&saved);SetPort((GrafPtr)dialog);GetPenState(&pen);GetForeColor(&foreground);PenNormal();
    GetDialogItem(dialog,number,&kind,&item,&r);Color(0,0,0);FrameRect(&r);
    RGBForeColor(&foreground);SetPenState(&pen);SetPort(saved);
}
static pascal Boolean VaultFilter(DialogPtr dialog,EventRecord *event,short *hit) {
    unsigned char key;size_t n,i;Handle scrap;long count,offset;int replace=0;
    if(event->what!=keyDown && event->what!=autoKey)return NativeDialogFilter(dialog,event,hit);
    /* A consumed keystroke is not a dialog item. ModalDialog may leave its
       previous item number here; returning true without clearing it dismisses
       this dialog on ordinary typing. */
    *hit=0;
    key=(unsigned char)(event->message&charCodeMask);n=strlen(gVaultEntry);
    if(key==27 || ((event->modifiers&cmdKey) && key=='.')){*hit=2;return true;}
    if(key==13 || key==3){if(n)*hit=1;else SysBeep(1);return true;}
    if(event->modifiers&cmdKey) {
        if(key=='q' || key=='Q'){gDone=1;*hit=2;return true;}
        if(key=='a' || key=='A'){gVaultEntrySelected=1;return true;}
        if(key=='v' || key=='V') {
            scrap=NewHandle(0);if(!scrap)return true;count=GetScrap(scrap,'TEXT',&offset);
            if(count>0 && count<(long)sizeof(gVaultEntry)) {
                HLock(scrap);for(i=0;i<(size_t)count;++i)if((unsigned char)(*scrap)[i]<32 || (unsigned char)(*scrap)[i]>126)break;
                if(i==(size_t)count){GVClear(gVaultEntry,sizeof(gVaultEntry));memcpy(gVaultEntry,*scrap,(size_t)count);replace=1;}
                HUnlock(scrap);
            }
            if(GetHandleSize(scrap)>0){HLock(scrap);GVClear(*scrap,(size_t)GetHandleSize(scrap));HUnlock(scrap);}
            DisposeHandle(scrap);if(!replace)SysBeep(1);
        } else return true;
    } else if(key==8 || key==127) {
        if(gVaultEntrySelected)GVClear(gVaultEntry,sizeof(gVaultEntry));else if(n)gVaultEntry[n-1]=0;
    } else if(key>=32 && key<=126) {
        if(gVaultEntrySelected){GVClear(gVaultEntry,sizeof(gVaultEntry));n=0;}
        if(n+1<sizeof(gVaultEntry)){gVaultEntry[n]=(char)key;gVaultEntry[n+1]=0;}else SysBeep(1);
    } else return true;
    gVaultEntrySelected=0;VaultMask(dialog);return true;
}
static int VaultPassphrase(const char *title,const char *body,const char *action,char out[1025]) {
    DialogPtr dialog;ModalFilterUPP filter;UserItemUPP frame;short hit=0,kind;Handle item;Rect rect;Str255 text;
    GVClear(gVaultEntry,sizeof(gVaultEntry));gVaultEntrySelected=0;dialog=GetNewDialog(152,NULL,(WindowPtr)-1);if(!dialog)return 0;
    filter=NewModalFilterProc(VaultFilter);frame=NewUserItemProc(VaultFrame);
    if(!filter || !frame){if(filter)DisposeRoutineDescriptor((UniversalProcPtr)filter);if(frame)DisposeRoutineDescriptor((UniversalProcPtr)frame);DisposeDialog(dialog);return 0;}
    Pascal(title,text);SetWTitle((WindowPtr)dialog,text);AuthDialogText(dialog,3,body);
    PrepareDialogChrome(dialog,7,9);
    GetDialogItem(dialog,1,&kind,&item,&rect);Pascal(action,text);SetControlTitle((ControlHandle)item,text);
    GetDialogItem(dialog,5,&kind,&item,&rect);SetDialogItem(dialog,5,kind,(Handle)frame,&rect);PrepareDialog(dialog,1,2);VaultMask(dialog);
    while(hit!=1 && hit!=2){RunModalDialog(filter,&hit);if(hit==1 && !gVaultEntry[0])hit=0;}
    if(hit==1)strcpy(out,gVaultEntry);
    GVClear(gVaultEntry,sizeof(gVaultEntry));DisposeDialog(dialog);DisposeRoutineDescriptor((UniversalProcPtr)filter);DisposeRoutineDescriptor((UniversalProcPtr)frame);SetPort(gWindow);return hit==1;
}
static int VaultRemoveSnapshot(const unsigned char *bytes,size_t length,int present) {
    return StartupClearCredentials(bytes,length,present);
}
static int VaultForgetRemembered(void) {
    int result=0;
    if(gRememberVault)result=VaultRemoveSnapshot(gVaultCipher,gVaultCipherLength,1);
    if(gRememberVault)LCDrop();VaultResetMemory();if(!result)StartupKeepUnlocked();gVaultFileError=result;return result;
}
static int VaultEncrypt(const OACredentials *credentials,const char *password,const unsigned char *expected,size_t expectedLength,int present,
                       unsigned char **saved,size_t *savedLength) {
    unsigned char *plain=NULL,*current=NULL;size_t pn=0,cn=0;int result,previousBusy=gBusy;
    gBusy=1;gCancel=0;
    SetStatus("Encrypting saved credentials... Escape cancels. Your GitHub password is not stored.");
    result=VaultCryptoReady();
    if(!result)result=CRPack(credentials,VaultUTC(),AuthNow(),&plain,&pn);
    if(!result)result=StartupSaveCredentials(plain,pn,password,expected,expectedLength,present,saved,savedLength);
    /* Reconciliation can confirm a newer proposal before a later cancellation.
       Refresh the caller's owned cache only after expected is no longer used;
       it may alias gVaultCipher. Spent-pair cleanup then compares the actual
       confirmed current record, never a stale remembered predecessor. */
    if(result && gRememberVault && !StartupReadConfirmed(&current,&cn)) {
        VaultBytesFree(&gVaultCipher,&gVaultCipherLength);gVaultCipher=current;gVaultCipherLength=cn;
        current=NULL;cn=0;
    }
    VaultBytesFree(&current,&cn);
    VaultBytesFree(&plain,&pn);gBusy=previousBusy;gCancel=0;return result;
}
static void VaultSaveCredentials(void) {
    unsigned char *before=NULL,*saved=NULL;size_t bn=0,sn=0;int present=0,result;char pass[1025],again[1025],body[512];
    memset(pass,0,sizeof(pass));memset(again,0,sizeof(again));
    if(!gCredentials.bound || !gCredentials.access[0]){SetStatus("Sign in to GitHub before saving credentials.");return;}
    result=VFRead(&gVaultStore,&before,&bn,&present);
    if(result){Message("Saved Credentials","The saved credential file could not be read or is in use. Your current sign-in remains in memory.");goto done;}
    snprintf(body,sizeof(body),"Save the login for %.80s in System Folder:Preferences.\rUse a separate local passphrase of at least 12 characters.\r%s",gUser,present?"This updates the encrypted local vault.":"Unlock once per Macintosh session, not every app launch.");
    if(!StartupCopyPassword(pass)) {
        if(!VaultPassphrase("Save Credentials",body,"Continue",pass))goto done;
        if(!GVNewPassphraseValid((const unsigned char *)pass,strlen(pass))){Message("Passphrase Too Short","Use at least 12 characters for the local credential passphrase. No credentials were saved.");goto done;}
        if(!VaultPassphrase("Confirm Passphrase","Enter the same local passphrase again.\rIt protects your saved GitHub authorization.","Save",again))goto done;
        if(strcmp(pass,again)){Message("Passphrases Differ","The local passphrases did not match. No credentials were saved.");goto done;}
    }
    if(!GVNewPassphraseValid((const unsigned char *)pass,strlen(pass))) {
        Message("Change Local Passphrase","This vault uses a passphrase shorter than 12 characters. Choose Change Local Passphrase in Preferences before saving a login. Your current session and existing vault are unchanged.");
        goto done;
    }
    result=VaultEncrypt(&gCredentials,pass,before,bn,present,&saved,&sn);
    if(result){Message("Credentials Not Saved","The save did not complete. The previous file is retained, or a complete encrypted replacement may have been written. Your current sign-in remains in memory. Try Save Credentials again.");goto done;}
    VaultResetMemory();strcpy(gVaultPassword,pass);gVaultCipher=saved;gVaultCipherLength=sn;saved=NULL;sn=0;gRememberVault=1;gVaultFileError=0;
    if(LCStore(pass))Message("Credentials Saved","Your login is encrypted and saved, but its background unlock helper could not start. Unlock Saved Login in Preferences after relaunching.");
    else {StartupKeepUnlocked();SetStatus("Encrypted login saved. It will restore automatically until the Macintosh restarts.");}
done:
    GVClear(pass,sizeof(pass));GVClear(again,sizeof(again));VaultBytesFree(&before,&bn);VaultBytesFree(&saved,&sn);SetPort(gWindow);InvalRect(&gWindow->portRect);
}
static int VaultReadAccount(OACredentials *pending,const char *expected,int *rotated) {
    OACredentials *next=NULL;unsigned char *body=NULL;size_t n=0;char *form=NULL;int result=OA_BAD_RESPONSE;
    *rotated=0;
    if(pending->deviceIssued && pending->refresh[0]) {
        /* Saved identity authorizes only this temporary refresh request. The
           replacement still must bind to the exact saved account via /user. */
        pending->bound=1;next=(OACredentials *)calloc(1,sizeof(*next));form=(char *)calloc(1,32768);
        if(!next || !form)goto done;
        if(OARefreshForm(pending,pending->clientID,AuthNow(),form,32768))goto done;
        if(InitializeTLS())goto done;
        *rotated=1; /* A transport error after this point can consume the pair. */
        if(RawRequest("github.com","/login/oauth/access_token",NULL,form,&body,&n))goto done;
        OAClear(form,32768);
        if(OARefreshReply(pending,(char *)body,n,AuthNow(),next))goto done;
        AuthRelease(&body,&n);OAClear(pending,sizeof(*pending));*pending=*next;
    }
    if(RawRequest("api.github.com","/user",pending->access,NULL,&body,&n))goto done;
    result=OAAccount(pending,(char *)body,n,expected);
done:
    AuthRelease(&body,&n);if(next){OAClear(next,sizeof(*next));free(next);}if(form){OAClear(form,32768);free(form);}return result;
}
/* A successful /user check does not authorize overwriting a newer saved file.
   Reuse the authenticated ciphertext only if its snapshot still matches. */
static int VaultCheckSnapshot(const unsigned char *expected,size_t length) {
    unsigned char *current=NULL;size_t n=0;int present=0,result;
    result=VFRead(&gVaultStore,&current,&n,&present);
    if(!result && (!present || n!=length || memcmp(current,expected,n)))result=VF_CONFLICT;
    VaultBytesFree(&current,&n);return result;
}
static void VaultRestoreCredentials(int automatic) {
    unsigned char *before=NULL,*plain=NULL,*saved=NULL;size_t bn=0,pn=0,sn=0;
    OACredentials *pending=NULL;char pass[1025],expected[32],savedLogin[128];unsigned char derived[32];int present=0,result,expired=0,rotated=0;
    memset(pass,0,sizeof(pass));memset(derived,0,sizeof(derived));result=VFRead(&gVaultStore,&before,&bn,&present);
    if(result || !present){if(!automatic)Message("Saved Login",result?"The saved credential file could not be read or is in use. Try again after closing another Classic Github instance.":"No credentials are saved on this Macintosh. Sign in, then choose Save Credentials in Preferences.");else if(result)SetStatus("Saved login could not be read. Try Restore Saved Login in Preferences.");goto done;}
    if(LCLoad(pass)) {
        if(!VaultPassphrase("Unlock Saved Login","Enter your local credential passphrase.\rYour saved account will be checked with GitHub before use.","Unlock",pass))goto done;
    }
    gBusy=1;gCancel=0;SetStatus("Unlocking saved credentials... Escape cancels.");
    result=VaultCryptoReady();
    if(!result) {
        if(!LCKeyLoad(before,bn,derived)) {
            result=GVOpenWithKey(before,bn,derived,&plain,&pn);
            if(result==GV_AUTH)result=GVOpenRemember(before,bn,(const unsigned char *)pass,strlen(pass),VaultProgress,NULL,&plain,&pn,derived);
        } else result=GVOpenRemember(before,bn,(const unsigned char *)pass,strlen(pass),VaultProgress,NULL,&plain,&pn,derived);
    }
    gBusy=0;gCancel=0;
    if(result){if(result!=GV_CANCEL)LCDrop();if(automatic)SetStatus(result==GV_CANCEL?"Saved login unlock cancelled. The saved file and session unlock are retained.":"Saved login could not be unlocked. Open Saved Login in Preferences to try again.");else Message("Login Not Unlocked",result==GV_CANCEL?"Unlock was cancelled. The saved file and session unlock are unchanged.":"The passphrase is incorrect or the saved file is damaged. The file is unchanged.");goto done;}
    {
        const unsigned char *credential=plain;size_t credentialLength=pn;SCView state;
        if(pn>=8 && !memcmp(plain,"GHSV0001",8)) {
            result=SCRead(plain,pn,&state);
            if(!result){credential=state.credentials;credentialLength=state.credentialLength;}
        }else if(pn<48 || memcmp(plain,"GHAC0001",8))result=CR_BAD;
        if(!result)result=StartupPrepare(&before,&bn,derived,pass);
        if(result){SetStatus(result==GV_CANCEL?"Secure network setup cancelled. Saved login was not installed.":result==SSL_NO_SEED?"That setup file could not be used. Choose a fresh network setup file and try again.":"The encrypted network state could not be prepared. Saved login was not installed.");goto done;}
        if(!credentialLength){SetStatus(gUser[0]?"No GitHub login is saved. Your current session is unchanged.":"Encrypted local network state is ready. Sign in to GitHub.");goto done;}
        pending=(OACredentials *)calloc(1,sizeof(*pending));if(!pending)goto done;
        result=CRUnpack(credential,credentialLength,VaultUTC(),AuthNow(),pending,&expired);
    }
    VaultBytesFree(&plain,&pn);
    if(result){if(automatic)SetStatus(result==CR_CLOCK?"Correct the Macintosh clock before restoring the saved login.":"The saved authorization has expired or is invalid. Sign in again.");else Message("Saved Login",result==CR_CLOCK?"The Macintosh clock is earlier than when these credentials were saved. Correct the clock before restoring.":"The saved authorization has expired or is invalid. Sign in again; the saved file has not been changed.");goto done;}
    strcpy(expected,pending->accountID);strcpy(savedLogin,pending->login);SetStatus("Checking saved account with GitHub...");result=VaultReadAccount(pending,expected,&rotated);
    if(result) {
        if(rotated)VaultRemoveSnapshot(before,bn,1);
        if(automatic)SetStatus("Saved login could not be verified. Try Restore Saved Login in Preferences, or sign in again.");
        else Message("Saved Login Not Verified","GitHub could not verify the saved account. If a refresh was attempted, its old saved credential file was removed when possible. Sign in again.");goto done;
    }
    if(rotated || strcmp(savedLogin,pending->login))result=VaultEncrypt(pending,pass,before,bn,1,&saved,&sn);
    else {
        result=VaultCheckSnapshot(before,bn);
        if(!result){saved=before;sn=bn;before=NULL;bn=0;}
    }
    if(result && rotated)VaultRemoveSnapshot(before,bn,1);
    AuthInstall(pending);
    if(!result) {
        strcpy(gVaultPassword,pass);gVaultCipher=saved;gVaultCipherLength=sn;saved=NULL;sn=0;gRememberVault=1;gVaultFileError=0;
        StartupKeepUnlocked();
        SetStatus(rotated?"Saved login restored. GitHub authorization refreshed and saved.":"Saved login restored and verified with GitHub.");
    } else if(automatic)SetStatus("Saved account verified for this run, but its saved file could not be checked or updated. Use Save Login in Preferences.");
    else Message("Signed In for This Run","GitHub verified the account, but the saved file changed or could not be checked or updated. Your sign-in remains in memory. Use Save Login to try again.");
done:
    GVClear(pass,sizeof(pass));GVClear(derived,sizeof(derived));VaultBytesFree(&before,&bn);VaultBytesFree(&plain,&pn);VaultBytesFree(&saved,&sn);
    if(pending){OAClear(pending,sizeof(*pending));free(pending);}gBusy=0;gCancel=0;SetPort(gWindow);InvalRect(&gWindow->portRect);
}
static void VaultUnlockCredentials(void) {VaultRestoreCredentials(0);}
static void VaultAutoRestore(void) {VaultRestoreCredentials(1);}
static void VaultChangePassphrase(void) {
    unsigned char *before=NULL,*saved=NULL;size_t bn=0,sn=0;char pass[1025],again[1025];int present=0,result,remember=0;
    memset(pass,0,sizeof(pass));memset(again,0,sizeof(again));
    if(!VaultPassphrase("Change Local Passphrase","Choose a new local vault passphrase. Use 12 or more characters for stronger protection.\rYour GitHub password is not used.","Continue",pass))goto done;
    if(!GVNewPassphraseValid((const unsigned char *)pass,strlen(pass))) {
        Message("Passphrase Too Short","Use at least 12 characters for the new local passphrase. The saved vault is unchanged.");goto done;
    }
    if(!VaultPassphrase("Confirm New Passphrase","Enter the new local passphrase again.\rYour saved login and secure network state will be retained.","Change",again))goto done;
    if(strcmp(pass,again)){Message("Passphrases Differ","The local passphrases did not match. The saved vault is unchanged.");goto done;}
    result=InitializeTLS();if(result)goto failed;
    result=VFRead(&gVaultStore,&before,&bn,&present);if(result || !present){if(!result)result=VF_CONFLICT;goto failed;}
    remember=gRememberVault && gVaultCipherLength==bn && !memcmp(gVaultCipher,before,bn);
    gBusy=1;gCancel=0;SetStatus("Changing local passphrase... Escape cancels.");
    result=StartupRekeyPassword(before,bn,pass,&saved,&sn);gBusy=0;gCancel=0;
    if(result)goto failed;
    VaultResetMemory();
    if(remember){strcpy(gVaultPassword,pass);gVaultCipher=saved;gVaultCipherLength=sn;saved=NULL;sn=0;gRememberVault=1;}
    gVaultFileError=0;
    SetStatus("Local passphrase changed. Your saved GitHub login and network state were retained.");
    goto done;
failed:
    Message("Passphrase Change Not Completed","The change could not be confirmed. Keep both local passphrases until the saved vault can be checked. Your current GitHub session remains in memory.");
done:
    GVClear(pass,sizeof(pass));GVClear(again,sizeof(again));VaultBytesFree(&before,&bn);VaultBytesFree(&saved,&sn);
    gBusy=0;gCancel=0;SetPort(gWindow);InvalRect(&gWindow->portRect);
}
static int VaultHasSaved(void) {
    unsigned char *bytes=NULL;size_t length=0;int present=0,has=0;
    gVaultFileError=VFRead(&gVaultStore,&bytes,&length,&present);
    if(!gVaultFileError && present){gVaultFileError=StartupHasCredentials(bytes,length,&has);if(!gVaultFileError)present=has;}
    VaultBytesFree(&bytes,&length);
    return gVaultFileError?-1:present;
}
typedef struct {int signOut,present,bound;char account[128];} VaultRemovalView;
static const VaultRemovalView *gVaultRemovalView;
static pascal void VaultRemovalDraw(DialogPtr dialog,short number) {
    GrafPtr previous;PenState pen;RGBColor foreground;short font,size;Style face;const VaultRemovalView *v=gVaultRemovalView;
    if(!v)return;
    GetPort(&previous);SetPort((GrafPtr)dialog);font=((GrafPtr)dialog)->txFont;size=((GrafPtr)dialog)->txSize;face=((GrafPtr)dialog)->txFace;
    GetPenState(&pen);GetForeColor(&foreground);PenNormal();
    if(number==3) {
        Text(34,82,"GITHUB ACCOUNT",gGeneva,9,64,64,64);
        FitText(34,105,v->account[0]?v->account:"Not signed in",gGeneva,14,480,0,0,0);
    } else if(number==4) {
        FitText(34,144,v->signOut?"End your current GitHub session.":"Remove the saved login from this Macintosh.",gGeneva,12,480,0,0,0);
        FitText(34,166,v->signOut?(v->present?"Remove the saved login on this Macintosh.":"No login is saved on this Macintosh."):
            (v->bound?"Your current GitHub session stays signed in.":"No account is currently signed in."),gGeneva,12,480,0,0,0);
        FitText(34,192,v->signOut?"Sign in again when you next want to use GitHub.":"After quitting Classic Github, you will need to sign in again.",gGeneva,9,480,64,64,64);
    } else {
        Text(34,234,"YOUR REPOSITORIES",gGeneva,9,64,64,64);
        FitText(34,256,"Local folders, files and commits stay on this Macintosh.",gGeneva,12,480,0,0,0);
        Text(34,280,"This does not revoke Classic Github's authorization on GitHub.",gGeneva,9,64,64,64);
    }
    RGBForeColor(&foreground);SetPenState(&pen);TextFont(font);TextSize(size);TextFace(face);SetPort(previous);
}
static int VaultConfirmRemoval(int signOut,int present) {
    VaultRemovalView view;DialogPtr dialog;UserItemUPP draw;short hit=0,kind,i;Handle item;Rect bounds;Str255 title;int accepted;
    if(gDone || gVaultRemovalView)return 0;
    dialog=GetNewDialog(153,NULL,(WindowPtr)-1);if(!dialog)return 0;
    draw=NewUserItemProc(VaultRemovalDraw);
    if(!draw || !PrepareDialogChrome(dialog,6,7)) {
        if(draw)DisposeRoutineDescriptor((UniversalProcPtr)draw);DisposeDialog(dialog);SetPort(gWindow);return 0;
    }
    view.signOut=signOut;view.present=present;view.bound=gCredentials.bound;strcpy(view.account,gUser);gVaultRemovalView=&view;
    Pascal(signOut?"Sign Out of GitHub":"Forget Saved Login",title);SetWTitle((WindowPtr)dialog,title);
    GetDialogItem(dialog,1,&kind,&item,&bounds);Pascal(signOut?"Sign Out":"Forget Login",title);SetControlTitle((ControlHandle)item,title);
    for(i=3;i<=5;++i){GetDialogItem(dialog,i,&kind,&item,&bounds);SetDialogItem(dialog,i,kind,(Handle)draw,&bounds);}
    PrepareDialog(dialog,2,2);
    while(!gDone && hit!=1 && hit!=2)RunModalDialog(gDialogFilter,&hit);
    accepted=hit==1 && !gDone;gVaultRemovalView=NULL;DisposeDialog(dialog);DisposeRoutineDescriptor((UniversalProcPtr)draw);SetPort(gWindow);return accepted;
}
/* Bind approval to the exact encrypted file shown by this operation. A newer
   file, failed removal or uncertain close must not clear the current session. */
static void VaultRemoveLogin(int signOut) {
    unsigned char *before=NULL;size_t length=0;int present=0,result;
    if(gDone)return;
    result=VFRead(&gVaultStore,&before,&length,&present);
    if(result) {
        gVaultFileError=result;Message(signOut?"Sign Out Not Completed":"Saved Login Unavailable",
            "The saved login could not be checked. Your current session is unchanged. Close another Classic Github instance if one is using Preferences, then try again.");goto done;
    }
    if(!VaultConfirmRemoval(signOut,present)) {
        if(!gDone)SetStatus("Cancelled. Your GitHub session and saved login are unchanged.");goto done;
    }
    result=VaultRemoveSnapshot(before,length,present);gVaultFileError=result;
    if(result) {
        Message(signOut?"Sign Out Not Completed":"Saved Login Not Removed",
            "Removal of the saved login could not be confirmed. It may have changed or a file operation failed. Your current session is unchanged. Check Saved Login in Preferences before trying again.");goto done;
    }
    LCDrop();VaultResetMemory();StartupKeepUnlocked();if(signOut)ClearSession();gVaultFileError=0;
    SetStatus(signOut?"Signed out. Saved login removed from this Macintosh.":"Saved login removed. Your current GitHub session is unchanged.");
done:
    VaultBytesFree(&before,&length);
}
static void VaultForgetSaved(void) {
    VaultRemoveLogin(0);
}
static void VaultSignOut(void) {
    VaultRemoveLogin(1);
}
static void VaultAfterRotation(void) {
    unsigned char *saved=NULL;size_t n=0;int result;
    if(!gRememberVault)return;
    result=VaultEncrypt(&gCredentials,gVaultPassword,gVaultCipher,gVaultCipherLength,1,&saved,&n);
    if(!result){VaultBytesFree(&gVaultCipher,&gVaultCipherLength);gVaultCipher=saved;gVaultCipherLength=n;}
    else {VaultForgetRemembered();Message("Credentials Refreshed","GitHub authorization was refreshed, but could not be saved. Your current sign-in remains in memory. Use Save Credentials to try again.");}
}
static void VaultShutdown(void) {VaultResetMemory();GVClear(gVaultEntry,sizeof(gVaultEntry));VFClose(&gVaultStore);}
