/* Developer-only tests on disposable media and the isolated Lease Test store.
   No selected working repository is changed. A requested held lease is left for
   an independent Script Editor process and process-termination cleanup test. */
static GSMacStore gHeldLeaseProbe;
static int TestMacLease(const char *disk, int *held) {
    GSMacStore normal, owner, peer;
    GSRepository r, raw, second;
    FSSpec folder;
    unsigned char *bytes = NULL;
    size_t n = 0;
    char path[128];
    OSErr error;
    int result, blocked = 0, guarded = 0, gated = 0, erased = 0;
    FILE *file;
    *held = 0;
    memset(&normal, 0, sizeof(normal));
    memset(&owner, 0, sizeof(owner));
    memset(&peer, 0, sizeof(peer));
    error = FSMakeFSSpec(0, 0, "\pMacintosh HD:Projects:GitHubClient:Lease Test", &folder);
    result = error && error != fnfErr ? GS_IO : GSMacAttach(&r, &normal, &folder, 1);
    if (!result)
        result = GSMacAttach(&raw, &owner, &folder, 0);
    if (!result)
        result = GSMacAttach(&second, &peer, &folder, 0);
    if (!result)
        result = GSMacEnter(&normal, 0);
    if (!result) {
        blocked = GSMacEnter(&peer, 0) == GS_CONFLICT;
        if (peer.leaseHeld)
            GSMacLeave(&peer);
        if (!blocked)
            result = GS_FORMAT;
        {
            int closed = GSMacLeave(&normal);
            if (!result)
                result = closed;
        }
    }
    if (!result)
        result = GSMacEnter(&peer, 0);
    if (!result)
        result = GSMacLeave(&peer);
    /* Prepare only a known test value; unknown old fixture bytes are retained. */
    if (!result) {
        int found = r.read(r.context, "HEAD", &bytes, &n);
        if (found == GS_NOT_FOUND)
            result = r.replace(r.context, "HEAD", NULL, 0, "before", 6);
        else if (found)
            result = found;
        else if (n != 6 || memcmp(bytes, "before", 6))
            result = GS_CONFLICT;
        free(bytes);
        bytes = NULL;
    }
    if (!result)
        result = GSMacEnter(&owner, 1);
    if (!result)
        result = GSMacOwnerToken(&owner, "00000001-00000000000000000000");
    if (!result) {
        guarded = raw.replace(raw.context, "HEAD", "before", 6, "after", 5) == GS_CONFLICT;
        if (!guarded)
            result = GS_FORMAT;
    }
    if (!result)
        result = GSMacGuard(&owner, "HEAD", 1);
    if (!result)
        result = raw.replace(raw.context, "HEAD", "before", 6, "after", 5);
    if (!result && raw.replace(raw.context, "HEAD", "before", 6, "wrong", 5) != GS_CONFLICT)
        result = GS_FORMAT;
    if (!result)
        result = raw.replace(raw.context, "HEAD", "after", 5, "before", 6);
    if (!result)
        result = GSMacGuard(&owner, "HEAD", 0);
    if (!result)
        result = raw.replace(raw.context, "checkout-journal", NULL, 0, "not an idle journal", 19);
    if (owner.leaseHeld) {
        int closed = GSMacLeave(&owner);
        if (!result)
            result = closed;
    }
    if (!result) {
        gated = r.replace(r.context, "index", NULL, 0, "blocked", 7) == GC_RECOVERY;
        if (!gated)
            result = GS_FORMAT;
    }
    if (!result)
        result = GSMacEnter(&owner, 1);
    if (!result)
        result = GSMacOwnerToken(&owner, "00000001-00000000000000000000");
    if (!result) {
        erased = GSMacErase(&owner, "checkout-journal", "wrong", 5) == GS_CONFLICT;
        if (!erased)
            result = GS_FORMAT;
    }
    if (!result)
        result = GSMacErase(&owner, "checkout-journal", "not an idle journal", 19);
    if (!result)
        result = raw.replace(raw.context, "checkout-intent", NULL, 0, "native intent", 13);
    if (owner.leaseHeld) {
        int closed = GSMacLeave(&owner);
        if (!result)
            result = closed;
    }
    if (!result && r.replace(r.context, "index", NULL, 0, "blocked", 7) != GC_RECOVERY)
        result = GS_FORMAT;
    if (!result)
        result = GSMacEnter(&owner, 1);
    if (!result)
        result = GSMacOwnerToken(&owner, "00000001-00000000000000000000");
    if (!result)
        result = GSMacErase(&owner, "checkout-intent", "native intent", 13);
    if (owner.leaseHeld) {
        int closed = GSMacLeave(&owner);
        if (!result)
            result = closed;
    }
    if (!result)
        result = GSMacEnter(&normal, 0);
    if (normal.leaseHeld) {
        int closed = GSMacLeave(&normal);
        if (!result)
            result = closed;
    }
    if (!result) {
        sprintf(path, "%s:Hold Lease", disk);
        file = fopen(path, "rb");
        if (file) {
            int c = fgetc(file);
            fclose(file);
            if (c == 'H') {
                if (gHeldLeaseProbe.leaseHeld)
                    result = GB_BAD;
                else
                    result = GSMacAttach(&second, &gHeldLeaseProbe, &folder, 0);
                if (!result)
                    result = GSMacEnter(&gHeldLeaseProbe, 0);
                *held = !result;
            }
        }
    }
    sprintf(path, "%s:Native Lease.txt", disk);
    file = fopen(path, "wb");
    if (file) {
        fprintf(file,
                "GHClient native lease check "
                "v1\rresult=%d\rpeer_context_blocked=%d\rowner_guard_required=%d\rjournal_gate=%"
                "d\rerase_CAS=%d\rheld=%d\r",
                result, blocked, guarded, gated, erased, *held);
        fclose(file);
    }
    return result;
}
static int GFWriteWord(FILE *file, GBWord value) {
    unsigned char b[4];
    b[0] = (unsigned char)(value >> 24);
    b[1] = (unsigned char)(value >> 16);
    b[2] = (unsigned char)(value >> 8);
    b[3] = (unsigned char)value;
    return fwrite(b, 1, 4, file) == 4 ? 0 : GS_IO;
}
static int GFWriteItem(FILE *file, const GQWork *w, const GFCatalog *c) {
    GBWord fields[12];
    size_t i, a = strlen(w->path), b = strlen(w->native);
    fields[0] = (GBWord)a;
    fields[1] = (GBWord)b;
    fields[2] = (GBWord)w->file.present;
    fields[3] = (GBWord)c->id;
    fields[4] = (GBWord)c->spec.parID;
    fields[5] = (GBWord)c->attributes;
    fields[6] = c->created;
    fields[7] = c->modified;
    fields[8] = c->backup;
    fields[9] = c->dataLength;
    fields[10] = c->resourceLength;
    fields[11] = (GBWord)c->children;
    for (i = 0; i < 12; ++i)
        if (GFWriteWord(file, fields[i]))
            return GS_IO;
    if (fwrite(c->finderInfo, 1, 32, file) != 32 || fwrite(w->file.dataOID, 1, 20, file) != 20 ||
        fwrite(w->file.resourceOID, 1, 20, file) != 20 ||
        fwrite(w->file.finderInfo, 1, 32, file) != 32 || fwrite(w->path, 1, a, file) != a ||
        fwrite(w->native, 1, b, file) != b)
        return GS_IO;
    return 0;
}
static int TestNativeMoves(const char *disk) {
    GFLockedFile locked;
    GSMacStore root;
    GSRepository unused;
    GFCatalog original, snapshots[4], stale, moved;
    GCFile identity, wrong, checked;
    GQWork row;
    FSSpec spec, source;
    Str255 p;
    char path[128];
    long live = 0, backup = 0, occupied = 0, id;
    short peer;
    OSErr error = noErr, observed;
    int result, kind, i, badHash = 0, badCatalog = 0, dataBusy = 0, resourceBusy = 0;
    int partialReleased = 0, heldData = 0, heldResource = 0, collision = 0, roundtrip = 0;
    FILE *file;
    GFLockInit(&locked);
    memset(&root, 0, sizeof(root));
    sprintf(path, "%s:Move Files", disk);
    Pascal(path, p);
    error = FSMakeFSSpec(0, 0, p, &spec);
    result = error ? GS_IO : GSMacAttach(&unused, &root, &spec, 0);
    if (!result)
        result = GFResolve(&root, "Live", &spec, &kind, &live, &error);
    if (!result && kind != 2)
        result = GS_FORMAT;
    if (!result)
        result = GFResolve(&root, "Backup", &spec, &kind, &backup, &error);
    if (!result && kind != 2)
        result = GS_FORMAT;
    if (!result)
        result = GFResolve(&root, "Occupied", &spec, &kind, &occupied, &error);
    if (!result && kind != 2)
        result = GS_FORMAT;
    if (!result)
        result = GFResolve(&root, "Live:Icon\r", &source, &kind, &id, &error);
    if (!result && kind != 1)
        result = GS_FORMAT;
    if (!result)
        result = GFIdentity(&source, &identity, &original, &error);
    if (!result) {
        snapshots[0] = original;
        wrong = identity;
        wrong.resourceOID[0] ^= 1;
        badHash = GFLockFile(&source, &wrong, &original, &locked, &error) == GS_CONFLICT;
        if (!badHash || locked.haveData || locked.haveResource)
            result = GS_FORMAT;
    }
    if (!result) {
        stale = original;
        stale.id ^= 1;
        badCatalog = GFLockFile(&source, &identity, &stale, &locked, &error) == GS_CONFLICT;
        if (!badCatalog || locked.haveData || locked.haveResource)
            result = GS_FORMAT;
    }
    if (!result) {
        error = FSpOpenDF(&source, fsWrPerm, &peer);
        if (error)
            result = GS_IO;
        else {
            dataBusy = GFLockFile(&source, &identity, &original, &locked, &error) == GS_CONFLICT;
            observed = FSClose(peer);
            if (!dataBusy || observed || locked.haveData || locked.haveResource)
                result = GS_FORMAT;
        }
    }
    if (!result) {
        error = FSpOpenRF(&source, fsWrPerm, &peer);
        if (error)
            result = GS_IO;
        else {
            resourceBusy =
                GFLockFile(&source, &identity, &original, &locked, &error) == GS_CONFLICT;
            observed = FSClose(peer);
            if (!resourceBusy || observed || locked.haveData || locked.haveResource)
                result = GS_FORMAT;
        }
        if (!result) {
            observed = FSpOpenDF(&source, fsWrPerm, &peer);
            if (!observed) {
                partialReleased = 1;
                observed = FSClose(peer);
            }
            if (!partialReleased || observed)
                result = GS_FORMAT;
        }
    }
    if (!result)
        result = GFLockFile(&source, &identity, &original, &locked, &error);
    if (!result) {
        observed = FSpOpenDF(&source, fsWrPerm, &peer);
        heldData = observed == opWrErr;
        if (!observed)
            FSClose(peer);
        observed = FSpOpenRF(&source, fsWrPerm, &peer);
        heldResource = observed == opWrErr;
        if (!observed)
            FSClose(peer);
        if (!heldData || !heldResource)
            result = GS_FORMAT;
    }
    if (!result) {
        collision = GFMoveLocked(&locked, occupied, &moved, &error) == GS_CONFLICT;
        if (!collision)
            result = GS_FORMAT;
    }
    if (!result)
        result = GFMoveLocked(&locked, backup, snapshots + 1, &error);
    if (!result) {
        /* Access paths must remain exclusive after the catalog move as well. */
        observed = FSpOpenDF(&locked.file, fsWrPerm, &peer);
        if (!observed)
            FSClose(peer);
        if (observed != opWrErr)
            result = GS_FORMAT;
        observed = FSpOpenRF(&locked.file, fsWrPerm, &peer);
        if (!observed)
            FSClose(peer);
        if (observed != opWrErr)
            result = GS_FORMAT;
    }
    if (!result)
        result = GFMoveLocked(&locked, live, snapshots + 2, &error);
    if (!result) {
        roundtrip = locked.file.parID == original.spec.parID && snapshots[2].id == original.id &&
                    GFStableCatalog(&original, snapshots + 2);
        if (!roundtrip)
            result = GS_FORMAT;
    }
    if (!result)
        result = GFMoveLocked(&locked, backup, &moved, &error);
    {
        int closed = GFUnlockFile(&locked, &error);
        if (!result)
            result = closed;
    }
    if (!result)
        result = GFIdentity(&locked.file, &checked, snapshots + 3, &error);
    if (!result &&
        (!GCFileEqual(&checked, &identity) || !GFStableCatalog(&original, snapshots + 3)))
        result = GS_CONFLICT;
    if (!result) {
        sprintf(path, "%s:Move Inventory", disk);
        file = fopen(path, "wb");
        if (!file)
            result = GS_IO;
        else {
            if (fwrite("GFNAT001", 1, 8, file) != 8 || GFWriteWord(file, 4))
                result = GS_IO;
            memset(&row, 0, sizeof(row));
            row.file = identity;
            for (i = 0; !result && i < 4; ++i) {
                row.path = row.native = i == 0   ? "before"
                                        : i == 1 ? "moved"
                                        : i == 2 ? "restored"
                                                 : "final";
                result = GFWriteItem(file, &row, snapshots + i);
            }
            if (fclose(file) && !result)
                result = GS_IO;
        }
    }
    sprintf(path, "%s:Native Moves.txt", disk);
    file = fopen(path, "wb");
    if (file) {
        fprintf(file,
                "GHClient native locked moves v1\rresult=%d\rfile_manager=%d\r"
                "bad_hash=%d\rbad_catalog=%d\rdata_busy=%d\rresource_busy=%d\rpartial_released=%d\r"
                "held_data=%d\rheld_resource=%d\rcollision=%d\rroundtrip=%d\r",
                result, (int)error, badHash, badCatalog, dataBusy, resourceBusy, partialReleased,
                heldData, heldResource, collision, roundtrip);
        fclose(file);
    }
    return result;
}
/* Actual HFS metadata session; deliberately zero working-file callbacks. This
   checks the coordinator/lease/guards, not a native working-tree transaction. */
typedef struct {
    GSMacStore store;
    GSRepository raw;
    GTControl base;
    int failGuard, failIndex;
} GTMacCheck;
static int GTCheckEnter(void *p) {
    GTMacCheck *s = (GTMacCheck *)p;
    return s->base.enter(s->base.context);
}
static int GTCheckLeave(void *p) {
    GTMacCheck *s = (GTMacCheck *)p;
    return s->base.leave(s->base.context);
}
static int GTCheckOwner(void *p, const char *t) {
    GTMacCheck *s = (GTMacCheck *)p;
    return s->base.owner(s->base.context, t);
}
static int GTCheckGuard(void *p, const char *key, int action) {
    GTMacCheck *s = (GTMacCheck *)p;
    int result = s->base.guard(s->base.context, key, action);
    if (!result && action == GT_CLAIM && s->failGuard && !strcmp(key, "index")) {
        s->failGuard = 0;
        return GS_IO;
    }
    return result;
}
static int GTCheckRead(void *p, const char *key, unsigned char **bytes, size_t *n) {
    GTMacCheck *s = (GTMacCheck *)p;
    return s->raw.read(s->raw.context, key, bytes, n);
}
static int GTCheckReplace(void *p, const char *key, const void *old, size_t on, const void *bytes,
                          size_t n) {
    GTMacCheck *s = (GTMacCheck *)p;
    int result = s->raw.replace(s->raw.context, key, old, on, bytes, n);
    if (!result && s->failIndex && !strcmp(key, "index")) {
        s->failIndex = 0;
        return GS_IO;
    }
    return result;
}
static int GTCheckErase(void *p, const char *key, const void *old, size_t n) {
    return GSMacErase(&((GTMacCheck *)p)->store, key, old, n);
}
static int GTCheckBegin(void *p, const GCTransaction *t) {
    (void)p;
    return t->fileCount ? GB_BAD : 0;
}
static int GTCheckFinish(void *p, const GCTransaction *t, int committed) {
    (void)p;
    (void)committed;
    return t->fileCount ? GB_BAD : 0;
}
static int GTCheckInspect(void *p, const GCTransaction *t, int area, size_t slot, const char *path,
                          GCFile *f) {
    (void)p;
    (void)t;
    (void)area;
    (void)slot;
    (void)path;
    (void)f;
    return GB_BAD;
}
static int GTCheckPrepare(void *p, const GCTransaction *t, size_t slot) {
    (void)p;
    (void)t;
    (void)slot;
    return GB_BAD;
}
static int GTCheckMove(void *p, const GCTransaction *t, size_t slot, int a, const char *x, int b,
                       const char *y, const GCFile *f) {
    (void)p;
    (void)t;
    (void)slot;
    (void)a;
    (void)x;
    (void)b;
    (void)y;
    (void)f;
    return GB_BAD;
}
static int GTCheckBytes(GSRepository *r, const char *key, const void *want, size_t length,
                        int present) {
    unsigned char *p = NULL;
    size_t n = 0;
    int result = r->read(r->context, key, &p, &n);
    int match =
        present ? !result && n == length && (!n || !memcmp(p, want, n)) : result == GS_NOT_FOUND;
    free(p);
    return match;
}
static int TestNativeSession(const char *disk) {
    static unsigned char firstMap[] = {1, 2, 0, 255}, firstIndex[] = {68, 73, 82, 67, 0, 1, 255};
    static unsigned char firstHead[] = "session one\n", secondIndex[] = {68, 73, 82, 67, 0, 2, 128};
    static unsigned char secondHead[] = "session two\n", foreign[] = "Legacy session owner\n";
    const char *keys[3] = {"ghclient-map", "index", "HEAD"};
    const unsigned char *values[3];
    size_t sizes[3], i, length = 0;
    unsigned char binding[32], other[32], *intent = NULL;
    GTMacCheck s;
    GTControl c;
    GCBackend b;
    GSRepository r, unused;
    GSMacStore peer;
    GCTransaction t, parsed;
    GCMetadata metadata[3];
    FSSpec folder;
    Str255 p;
    OSErr error = noErr;
    char path[128];
    int result, unwind = 0, committed = 0, rollback = 0, gated = 0, orphan = 0, rejected = 0,
                preserved = 0;
    FILE *file;
    memset(&s, 0, sizeof(s));
    memset(&peer, 0, sizeof(peer));
    memset(&b, 0, sizeof(b));
    memset(metadata, 0, sizeof(metadata));
    GCInit(&t);
    GCInit(&parsed);
    memset(binding, 41, 32);
    values[0] = firstMap;
    values[1] = firstIndex;
    values[2] = firstHead;
    sizes[0] = sizeof(firstMap);
    sizes[1] = sizeof(firstIndex);
    sizes[2] = sizeof(firstHead) - 1;
    sprintf(path, "%s:Session Store", disk);
    Pascal(path, p);
    error = FSMakeFSSpec(0, 0, p, &folder);
    result = error ? GS_IO : GSMacAttach(&s.raw, &s.store, &folder, 0);
    if (!result)
        result = GSMacCheckoutControl(&s.store, &s.base);
    r.context = &s;
    r.read = GTCheckRead;
    r.replace = GTCheckReplace;
    c.context = &s;
    c.enter = GTCheckEnter;
    c.leave = GTCheckLeave;
    c.owner = GTCheckOwner;
    c.guard = GTCheckGuard;
    b.context = &s;
    b.begin = GTCheckBegin;
    b.inspect = GTCheckInspect;
    b.prepare = GTCheckPrepare;
    b.move = GTCheckMove;
    b.erase = GTCheckErase;
    b.finish = GTCheckFinish;
    b.directories = NULL;
    t.generation = 1;
    t.phase = GC_PREPARE;
    t.metadata = metadata;
    t.metadataCount = 3;
    for (i = 0; i < 3; ++i) {
        metadata[i].path = (char *)keys[i];
        metadata[i].afterPresent = 1;
        metadata[i].after = (unsigned char *)values[i];
        metadata[i].afterLength = sizes[i];
        if (!result && !GTCheckBytes(&r, keys[i], NULL, 0, 0))
            result = GS_CONFLICT;
    }
    if (!result) {
        s.failGuard = 1;
        unwind = GTStart(&r, &b, &c, binding, GWMacNameEqual, NULL, &t) == GS_IO &&
                 !GTWriteAllowed(&r) && GTCheckBytes(&r, "checkout-intent", NULL, 0, 0);
        for (i = 0; i < 3; ++i)
            unwind = unwind && GTCheckBytes(&r, keys[i], NULL, 0, 0);
        if (!unwind)
            result = GS_FORMAT;
    }
    if (!result)
        result = GTStart(&r, &b, &c, binding, GWMacNameEqual, NULL, &t);
    if (!result) {
        committed = 1;
        for (i = 0; i < 3; ++i)
            committed = committed && GTCheckBytes(&r, keys[i], values[i], sizes[i], 1);
        if (!committed)
            result = GS_FORMAT;
    }
    /* Prepare a known absent-map before-state, so rollback must erase a map
       created by the interrupted transaction. Every target still has its map. */
    if (!result)
        result = c.enter(c.context);
    if (!result)
        result = c.owner(c.context, "00000000-00000000000000000000");
    if (!result)
        result = c.guard(c.context, "ghclient-map", GT_CLAIM);
    if (!result)
        result = GSMacErase(&s.store, "ghclient-map", firstMap, sizeof(firstMap));
    if (!result)
        result = c.guard(c.context, "ghclient-map", GT_RELEASE);
    if (s.store.leaseHeld) {
        int closed = c.leave(c.context);
        if (!result)
            result = closed;
    }
    values[0] = NULL;
    sizes[0] = 0;
    for (i = 0; i < 3; ++i) {
        metadata[i].beforePresent = values[i] != NULL;
        metadata[i].before = (unsigned char *)values[i];
        metadata[i].beforeLength = sizes[i];
    }
    metadata[1].after = secondIndex;
    metadata[1].afterLength = sizeof(secondIndex);
    metadata[2].after = secondHead;
    metadata[2].afterLength = sizeof(secondHead) - 1;
    if (!result) {
        s.failIndex = 1;
        if (GTStart(&r, &b, &c, binding, GWMacNameEqual, NULL, &t) != GS_IO)
            result = GS_FORMAT;
    }
    if (!result)
        result = GSMacAttach(&unused, &peer, &folder, 0);
    if (!result) {
        gated = GSMacEnter(&peer, 0) == GC_RECOVERY;
        if (peer.leaseHeld)
            GSMacLeave(&peer);
        if (!gated)
            result = GS_FORMAT;
    }
    if (!result)
        result = GTResume(&r, &b, &c, binding, GWMacNameEqual, NULL, 1);
    if (!result) {
        rollback = !GTWriteAllowed(&r);
        for (i = 0; i < 3; ++i)
            rollback =
                rollback && GTCheckBytes(&r, keys[i], values[i], sizes[i], values[i] != NULL);
        if (!rollback)
            result = GS_FORMAT;
    }
    /* Closed durable pre-journal checkpoint, rather than an actual process kill.
       Host process-death tests separately cover this coordinator protocol. */
    t.generation = 3;
    if (!result)
        result = GTIntentEncode(binding, &t, GWMacNameEqual, NULL, &intent, &length);
    if (!result)
        result = GTIntentParse(intent, length, binding, GWMacNameEqual, NULL, &parsed);
    if (!result)
        result = c.enter(c.context);
    if (!result)
        result = c.owner(c.context, parsed.token);
    if (!result)
        result = r.replace(r.context, "checkout-intent", NULL, 0, intent, length);
    if (!result)
        result = c.guard(c.context, "HEAD", GT_CLAIM);
    if (s.store.leaseHeld) {
        int closed = c.leave(c.context);
        if (!result)
            result = closed;
    }
    if (!result) {
        sprintf(path, "%s:Session Intent", disk);
        file = fopen(path, "wb");
        if (!file)
            result = GS_IO;
        else {
            if (fwrite(intent, 1, length, file) != length)
                result = GS_IO;
            if (fclose(file) && !result)
                result = GS_IO;
        }
    }
    if (!result) {
        memcpy(other, binding, 32);
        other[0] ^= 1;
        rejected = GTResume(&r, &b, &c, other, GWMacNameEqual, NULL, 0) == GS_CONFLICT &&
                   GTWriteAllowed(&r) == GC_RECOVERY &&
                   GTCheckBytes(&r, "checkout-intent", intent, length, 1);
        if (!rejected)
            result = GS_FORMAT;
    }
    if (!result)
        result = GTResume(&r, &b, &c, binding, GWMacNameEqual, NULL, 0);
    if (!result) {
        orphan = !GTWriteAllowed(&r) && GTCheckBytes(&r, "checkout-intent", NULL, 0, 0);
        for (i = 0; i < 3; ++i)
            orphan = orphan && GTCheckBytes(&r, keys[i], values[i], sizes[i], values[i] != NULL);
        if (!orphan)
            result = GS_FORMAT;
    }
    if (!result)
        result = c.enter(c.context);
    if (!result)
        result = c.owner(c.context, parsed.token);
    if (!result)
        result = r.replace(r.context, "HEAD.lock", NULL, 0, foreign, sizeof(foreign) - 1);
    if (s.store.leaseHeld) {
        int closed = c.leave(c.context);
        if (!result)
            result = closed;
    }
    if (!result) {
        preserved = GTStart(&r, &b, &c, binding, GWMacNameEqual, NULL, &t) == GS_CONFLICT &&
                    GTCheckBytes(&r, "HEAD.lock", foreign, sizeof(foreign) - 1, 1) &&
                    !GTWriteAllowed(&r);
        if (!preserved)
            result = GS_FORMAT;
    }
    sprintf(path, "%s:Native Session.txt", disk);
    file = fopen(path, "wb");
    if (file) {
        fprintf(
            file,
            "GHClient native metadata session v1\rresult=%d\rprejournal_unwind=%d\rcommitted=%d\r"
            "rollback=%d\rnormal_gate=%d\rorphan_cleanup=%d\rbinding_rejected=%d\rforeign_guard_"
            "preserved=%d\r"
            "working_file_callbacks=0\r",
            result, unwind, committed, rollback, gated, orphan, rejected, preserved);
        fclose(file);
    }
    free(intent);
    GCFree(&parsed);
    return result;
}
static int TestNativeFiles(void) {
    const char *disk = "GH Patch";
    GFInventory inventory;
    GFCatalog folder, desired, again;
    GSMacStore root;
    GSRepository unused;
    GPMap mapping;
    GQWork rootItem;
    FSSpec spec;
    unsigned char *bytes = NULL;
    char path[128];
    size_t n = 0, i;
    long id;
    OSErr error = noErr;
    int result = 0, kind, held = 0, stale = 0, unchanged = 0;
    FILE *file;
    GFInit(&inventory);
    GPInit(&mapping);
    memset(&root, 0, sizeof(root));
    sprintf(path, "%s:Native Map", disk);
    file = fopen(path, "rb");
    if (!file) {
        disk = "GH Fat";
        sprintf(path, "%s:Native Map", disk);
        file = fopen(path, "rb");
    }
    if (!file)
        result = GS_NOT_FOUND;
    if (!result) {
        long size;
        if (fseek(file, 0, SEEK_END) || (size = ftell(file)) < 0 || fseek(file, 0, SEEK_SET))
            result = GS_IO;
        else {
            n = (size_t)size;
            bytes = (unsigned char *)malloc(n ? n : 1);
            if (!bytes)
                result = GB_MEMORY;
        }
        if (!result && fread(bytes, 1, n, file) != n)
            result = GS_IO;
        if (fclose(file) && !result)
            result = GS_IO;
    }
    if (!result)
        result = GPParse(bytes, n, GWMacNameEqual, NULL, &mapping);
    free(bytes);
    bytes = NULL;
    if (!result) {
        Str255 p;
        sprintf(path, "%s:Native Files", disk);
        Pascal(path, p);
        error = FSMakeFSSpec(0, 0, p, &spec);
        result = error ? GS_IO : GSMacAttach(&unused, &root, &spec, 0);
    }
    if (!result)
        result = GFResolve(&root, "Folder", &spec, &kind, &id, &error);
    if (!result && kind != 2)
        result = GS_FORMAT;
    if (!result)
        result = GFCatalogRead(&spec, &folder, &error);
    if (!result) {
        desired = folder;
        for (i = 0; i < 32; ++i)
            desired.finderInfo[i] = (unsigned char)(i + 1);
        desired.created = 3820000000U;
        desired.modified = 3820000010U;
        desired.backup = 3820000020U;
        result = GFDirectoryRestore(&desired, &folder, &error);
    }
    if (!result)
        result = GFCatalogRead(&spec, &again, &error);
    if (!result) {
        folder = again;
        folder.modified ^= 1;
        stale = GFDirectoryRestore(&desired, &folder, &error) == GS_CONFLICT;
        if (!stale)
            result = GS_FORMAT;
    }
    if (!result)
        result = GFCollect(&root, &mapping, &inventory, &error);
    if (!result && inventory.count != 9)
        result = GS_FORMAT;
    if (!result) {
        GQWork *accepted = inventory.items;
        GSMacStore missing = root;
        missing.directory = 0x7ffffffeL;
        unchanged =
            GFCollect(&missing, &mapping, &inventory, &error) != 0 && inventory.items == accepted;
        if (!unchanged)
            result = GS_FORMAT;
        error = noErr;
    }
    if (!result) {
        sprintf(path, "%s:Native Inventory", disk);
        file = fopen(path, "wb");
        if (!file)
            result = GS_IO;
        else {
            memset(&rootItem, 0, sizeof(rootItem));
            rootItem.path = "";
            rootItem.native = "";
            rootItem.file.present = 2;
            if (fwrite("GFNAT001", 1, 8, file) != 8 ||
                GFWriteWord(file, (GBWord)inventory.count + 1))
                result = GS_IO;
            if (!result)
                result = GFWriteItem(file, &rootItem, &inventory.root);
            for (i = 0; !result && i < inventory.count; ++i)
                result = GFWriteItem(file, inventory.items + i, inventory.catalog + i);
            if (fclose(file) && !result)
                result = GS_IO;
        }
    }
    if (!result)
        result = TestMacLease(disk, &held);
    if (!result)
        result = TestNativeMoves(disk);
    if (!result)
        result = TestNativeSession(disk);
    if (!result)
        result = TestNativeCheckout(disk);
    sprintf(path, "%s:Native Files.txt", disk);
    file = fopen(path, "wb");
    if (file) {
        fprintf(file,
                "GHClient native file foundation "
                "v1\rresult=%d\rfile_manager=%d\ritems=%lu\rdir_CAS=%d\rfailed_inventory_preserved="
                "%d\rheld=%d\rsizeof_int=%lu\rsizeof_size_t=%lu\r",
                result, (int)error, (unsigned long)inventory.count, stale, unchanged, held,
                (unsigned long)sizeof(int), (unsigned long)sizeof(size_t));
        fclose(file);
    }
    GFFree(&inventory);
    GPFree(&mapping);
    return result;
}
