/* Saved replay controller. Shared MUI controls render borrowed file versions;
   only GXRebase* may own or change this replay's checkpoint. No lease crosses
   a modal dialog, child comparison or native file picker. */
typedef struct {MUIDraft draft;RLSession saved;} ERDraft;
static void ERInit(ERDraft *d){memset(d,0,sizeof(*d));MUIInit(&d->draft);RLSessionInit(&d->saved);}
static void ERFree(ERDraft *d){TMInit(&d->draft.saved.review.files);MUIFree(&d->draft);RLSessionFree(&d->saved);ERInit(d);}
static void ERLimits(RLLimits *l) {
    MMLimits merge;NativeMergeLimits(&merge);memset(l,0,sizeof(*l));MUIStateLimits(&l->state.records);
    l->state.steps=4096;l->state.nodes=8192;l->journalBytes=32UL*1024*1024;
    l->replay.plan.graph=merge.graph;l->replay.plan.steps=4096;l->replay.step=merge.tree;l->replay.all=merge.tree.read;
    l->replay.all.readBytes=256UL*1024*1024;l->replay.all.reads=131072;
}
static void RebasePaused(void) {
    gLocalBlocked=gRebasePending=1;gMergePending=0;gLocalRowCount=gLocalStaged=gLocalHistoryCount=0;gLocalSelection=-1;
    if(gCommitField)TEDeactivate(gCommitField==1?gSummaryEdit:gDescriptionEdit);gCommitField=0;
    strcpy(gPatch,"This repository has a saved rebase.\rChoose Branch > Rebase or Repository > Refresh to review conflicts, Continue or Abort.\r");
    gDiffTop=0;gDiffLines=2;FindReset();DiffScroll();LocalEditState();SetStatus("Rebase paused. Choose Branch > Rebase or Refresh to resume.");InvalRect(&gWindow->portRect);
}
static int ERMissing(void) {
    unsigned char *raw=NULL;size_t n=0;int result,closed,entered=0;
    if(!gUICheckout.state || gUICheckout.held.haveData || gUICheckout.held.haveResource)return GS_IO;
    result=0;if(!gUICheckout.store.leaseHeld){result=GSMacEnter(&gUICheckout.store,1);entered=!result;}
    if(result)return result==GS_NOT_FOUND?GS_IO:result;
    result=MUIRead(&gUICheckout.store,"ghclient-rebase",&raw,&n);free(raw);
    closed=entered?GSMacLeave(&gUICheckout.store):0;if(closed)return closed;
    return result==GS_NOT_FOUND?MUI_NO_SESSION:result?result:GS_FORMAT;
}
static int ERLoad(const FSSpec *folder,ERDraft *out) {
    ERDraft *next;MUIDraft *d;RLSession *s;RLLimits limits;size_t i,j,k=0,n;int result;
    next=(ERDraft *)calloc(1,sizeof(*next));if(!next)return GB_MEMORY;ERInit(next);ERLimits(&limits);d=&next->draft;s=&next->saved;
    result=CheckoutAttach(folder);
    if(!result){CheckoutBegin("Reading the saved rebase... Escape cancels.");result=GXRebaseOpen(&gUICheckout,&limits,s);}
    if(result==GS_NOT_FOUND)result=ERMissing();result=MUICloseReader(result);
    if(!result) {
        d->replay=1;d->replayStep=s->state.replay.completed+1;d->replayTotal=s->state.replay.count;
        GBOIDFormat(s->state.replay.tip,d->replayTip);GBOIDFormat(s->replay.conflict.candidate,d->replayCandidate);
        /* Read-only borrowed renderer inputs. The replay still owns all trees,
           immutable chosen contents and the real outer CAS checkpoint. */
        d->saved.review.files=s->replay.conflict.merge;d->saved.drafts.index.unresolved=s->drafts.index.unresolved;
        n=strlen(s->state.replay.branch)+1;d->saved.state.branch=(char *)malloc(n);
        if(d->saved.state.branch)memcpy(d->saved.state.branch,s->state.replay.branch,n);else result=GB_MEMORY;
        n=strlen(s->state.replay.ontoRef)+1;d->saved.state.otherRef=(char *)malloc(n);
        if(d->saved.state.otherRef)memcpy(d->saved.state.otherRef,s->state.replay.ontoRef,n);else result=GB_MEMORY;
        for(i=0;i<d->saved.review.files.count;++i)if(d->saved.review.files.files[i].conflicts)++d->count;
        if(!result){d->rows=(MUIChoice *)calloc(d->count?d->count:1,sizeof(*d->rows));if(!d->rows)result=GB_MEMORY;}
    }
    for(i=0;!result && i<d->saved.review.files.count;++i) {
        if(!d->saved.review.files.files[i].conflicts)continue;
        d->rows[k].node=d->rows[k].value.node=i;
        for(j=0;j<s->replay.choices.count;++j)if(s->replay.choices.items[j].node==i) {
            d->rows[k].chosen=1;d->rows[k].value=s->replay.choices.items[j];break;
        }
        ++k;
    }
    if(!result){MUIKeepSelection(d,&out->draft);ERFree(out);*out=*next;ERInit(next);}ERFree(next);free(next);return result;
}
static void ERStopped(ERDraft *d,int result,const char *title) {
    if(result==GS_IO || result==GC_RECOVERY)d->draft.needsRecovery=1;
    if(result==GS_CONFLICT)d->draft.mustReload=1;
    Message(title,"Your choices are still in this window. Unexpected edits, incompatible destinations or a changed saved checkpoint can stop this operation. Recover an interrupted operation, then reload its saved choices. Keep the repository folder intact.");
}
static void ERProtection(ERDraft *d,int result,const GQError *why,const char *title) {
    char path[256],message[900];
    if(result!=GS_CONFLICT || why->reason!=GQ_DIRTY){ERStopped(d,result,title);return;}
    d->draft.mustReload=1;LocalDisplayPath(why->path,path);
    snprintf(message,sizeof(message),
        "This file changed outside the saved rebase:\r\r%s\r\r"
        "The file and your saved choices have been kept. Reload checks the repository; it does not restore this file.\r\r"
        "To use your edits, first copy the file outside this repository, then restore the version recorded by the rebase. "
        "Reload Saved Choices, open Review Conflict and choose File from this Macintosh to select your copy.",path);
    Message("File Changed During Rebase",message);
}
static int ERSave(const FSSpec *folder,ERDraft *d) {
    RLLimits limits;TMResolution *values;GQError why;size_t i,n=0;int result,installed=0;
    values=(TMResolution *)malloc((d->draft.count?d->draft.count:1)*sizeof(*values));if(!values){ERStopped(d,GB_MEMORY,"Rebase Choices Not Saved");return GB_MEMORY;}
    for(i=0;i<d->draft.count;++i)if(d->draft.rows[i].chosen)values[n++]=d->draft.rows[i].value;
    memset(&why,0,sizeof(why));ERLimits(&limits);result=CheckoutAttach(folder);
    if(!result){CheckoutBegin("Saving rebase choices... Escape stops safely.");
        result=GXRebaseResolve(&gUICheckout,d->saved.state.original,d->saved.state.originalLength,values,n,&limits,&why,&installed);}
    result=MUICloseReader(result);free(values);if(!result && !installed)result=GS_CONFLICT;
    if(result)ERProtection(d,result,&why,"Rebase Choices Not Saved");return result;
}
static int ERAbortConfirm(const FSSpec *folder,const ERDraft *d) {
    OperationPrompt prompt;char repository[256],state[620],head[41];
    memset(&prompt,0,sizeof(prompt));MUIOperationContext(folder,d->saved.state.replay.branch,d->saved.state.replay.ontoRef,repository,state,&prompt);
    GBOIDFormat(d->saved.state.replay.head,head);prompt.labels[1]="Rebase target";prompt.labels[2]="Original branch tip";prompt.values[2]=head;
    prompt.title=prompt.primary="Abort Rebase";prompt.canPrimary=1;
    prompt.primaryText="Restore the original branch, working files, both forks and index. Unrelated changes are kept.";
    prompt.secondaryText="Return to the saved rebase. Your draft choices remain available.";
    prompt.footer="Unsaved choices are discarded only if Abort succeeds. Unexpected edits to files owned by this rebase stop it.";
    return OperationConfirm(&prompt)==1;
}
/* 0 cancelled/refused, 1 moved to next conflict, 2 session finished. */
static int ERExit(const FSSpec *folder,ERDraft *d,int action) {
    RLLimits limits;GQError why;GXRebaseOutcome outcome;int result,finished=0;
    if(action==2 && !ERAbortConfirm(folder,d))return 0;
    memset(&why,0,sizeof(why));memset(&outcome,0,sizeof(outcome));ERLimits(&limits);result=CheckoutAttach(folder);
    if(!result){CheckoutBegin(action==1?"Continuing rebase... Escape stops at a recoverable checkpoint.":"Restoring the original files... Escape stops safely.");
        if(action==1)result=GXRebaseContinue(&gUICheckout,d->saved.state.original,d->saved.state.originalLength,&limits,&why,&outcome);
        else result=GXRebaseAbort(&gUICheckout,d->saved.state.original,d->saved.state.originalLength,&limits,&why,&finished);}
    result=MUICloseReader(result);if(result){ERProtection(d,result,&why,"Rebase Paused");return 0;}
    if(action==2)return finished?2:0;
    if(outcome.advanced){SetStatus(outcome.droppedSignatures?"Rebase complete. Rewritten commits are unsigned; old signatures were removed.":"Rebase complete. Original authors and messages retained.");return 2;}
    if(outcome.kind!=RQ_CONFLICT){ERStopped(d,GS_FORMAT,"Rebase Paused");return 0;}
    d->draft.mustReload=1;return 1;
}
static int ERSame(const ERDraft *a,const ERDraft *b) {
    return a->saved.state.originalLength==b->saved.state.originalLength &&
        !memcmp(a->saved.state.original,b->saved.state.original,a->saved.state.originalLength);
}
/* Only independently absent marker, successful Continue completion or Abort
   returns1. Missing required objects never mean a finished session. */
static int RebaseManage(const FSSpec *folder) {
    ERDraft *draft,*recovered;int result,action,done=0,advanced;
    if(gMUIRepository[0])return 0;draft=(ERDraft *)calloc(1,sizeof(*draft));if(!draft){CheckoutError("Read Rebase",GB_MEMORY);return 0;}ERInit(draft);
    result=ERLoad(folder,draft);if(result){if(result!=MUI_NO_SESSION)CheckoutError("Read Rebase",result);ERFree(draft);free(draft);return result==MUI_NO_SESSION;}
    MUIRepositoryLabel(folder,gMUIRepository);
    for(;;) {
        action=MUIModal(folder,&draft->draft);
        if(action==10){if(MUIDiscard(&draft->draft))break;if(gDone)gDone=0;continue;}
        if(action==7 && (MUIActions(&draft->draft)&MUI_SAVE)){if(ERSave(folder,draft))continue;}
        else if(action==8 && (MUIActions(&draft->draft)&MUI_CONTINUE)) {
            advanced=ERExit(folder,draft,1);if(advanced==2){done=1;break;}if(!advanced)continue;
        } else if(action==9 && (MUIActions(&draft->draft)&MUI_ABORT)) {if(ERExit(folder,draft,2)==2){done=1;break;}continue;}
        else if(action==13 && (MUIActions(&draft->draft)&MUI_RELOAD)){if(!MUIDiscard(&draft->draft))continue;}
        else if(action==14 && draft->draft.needsRecovery) {
            if(!CheckoutRecovery(folder))continue;
            recovered=(ERDraft *)calloc(1,sizeof(*recovered));if(!recovered){ERStopped(draft,GB_MEMORY,"Read Recovered Rebase");continue;}ERInit(recovered);
            result=ERLoad(folder,recovered);
            if(result==MUI_NO_SESSION){ERFree(recovered);free(recovered);done=1;break;}
            if(!result){draft->draft.needsRecovery=0;
                if(ERSame(draft,recovered))draft->draft.mustReload=0;
                else if(draft->draft.dirty)draft->draft.mustReload=1;
                else {MUIKeepSelection(&recovered->draft,&draft->draft);ERFree(draft);*draft=*recovered;ERInit(recovered);}}
            else {draft->draft.mustReload=1;ERStopped(draft,result,"Read Recovered Rebase");}
            ERFree(recovered);free(recovered);continue;
        } else continue;
        result=ERLoad(folder,draft);if(result==MUI_NO_SESSION){done=1;break;}
        if(result){draft->draft.mustReload=1;ERStopped(draft,result,"Reload Rebase");}
    }
    ERFree(draft);free(draft);gMUIRepository[0]=0;return done;
}
