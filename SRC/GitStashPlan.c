#include "GitStashPlan.h"
#include "GitCheckoutSession.h"
#include "GitHistory.h"
#include <stdlib.h>
#include <string.h>
void SPStateInit(SPState *s){memset(s,0,sizeof(*s));SLInit(&s->log);}
void SPStateFree(SPState *s){SLFree(&s->log);free(s->ref);SPStateInit(s);}
void SPInit(SPPlan *p){memset(p,0,sizeof(*p));GCInit(&p->transaction);}
void SPFree(SPPlan *p){GCFree(&p->transaction);SPInit(p);}
static void *SPCopy(const void *p,size_t n){void *q=malloc(n?n:1);if(q && n)memcpy(q,p,n);return q;}
static int SPOnlyObjects(void *ctx,const char *key,const void *a,size_t an,const void *b,size_t bn){
    GSRepository *r=ctx;
    if(strncmp(key,"objects/",8) || a || an)return GS_FORMAT;
    return r->replace(r->context,key,a,an,b,bn);
}
static int SPReadThrough(void *ctx,const char *key,unsigned char **p,size_t *n){GSRepository *r=ctx;return r->read(r->context,key,p,n);}
static int SPReadOptional(GSRepository *r,const char *key,size_t max,unsigned char **p,size_t *n,int *present){
    int result;*p=NULL;*n=0;*present=0;result=r->read(r->context,key,p,n);
    if(result==GS_NOT_FOUND){free(*p);*p=NULL;*n=0;return 0;}
    if(result)return result;
    if(!*p || *n>max)return *n>max?GB_SPACE:GS_FORMAT;
    *present=1;return 0;
}
int SPRead(GSRepository *r,const SLLimits *limits,SPState *out){
    SPState next;unsigned char *p=NULL;size_t n=0;char key[64],hex[41];int result;
    if(!r || !r->read || !limits || !limits->bytes || limits->bytes==(size_t)-1 || !limits->entries || !limits->lineBytes || !out)return GB_BAD;
    SPStateInit(&next);result=GSRefKey("refs/stash",key);
    if(!result)result=SPReadOptional(r,key,52,&next.ref,&next.refLength,&next.refPresent);
    if(!result && next.refPresent){
        if(next.refLength!=52 || memcmp(next.ref,"refs/stash",11) || next.ref[51]!='\n')result=GS_FORMAT;
        else {memcpy(hex,next.ref+11,40);hex[40]=0;if(GBOIDParse(hex,next.tip))result=GS_FORMAT;}
    }
    if(!result)result=SPReadOptional(r,SP_LOG_KEY,limits->bytes,&p,&n,&next.logPresent);
    if(!result)result=SLParse(p,n,limits,&next.log);
    if(!result && (next.refPresent!=(next.log.count!=0) ||
       (next.refPresent && memcmp(next.tip,next.log.entries[next.log.count-1].after,20))))result=GS_CONFLICT;
    if(!result){SPStateFree(out);*out=next;SPStateInit(&next);}free(p);SPStateFree(&next);return result;
}
static GCMetadata *SPMeta(GCTransaction *t,const char *key){size_t i;for(i=0;i<t->metadataCount;++i)if(!strcmp(t->metadata[i].path,key))return t->metadata+i;return NULL;}
static int SPAdd(GCTransaction *t,const char *key,const void *a,size_t an,int ap,const void *b,size_t bn,int bp){
    GCMetadata *m;
    if(SPMeta(t,key))return GS_FORMAT;
    if(t->metadataCount>=(size_t)-1/sizeof(*m))return GB_SPACE;
    m=realloc(t->metadata,(t->metadataCount+1)*sizeof(*m));if(!m)return GB_MEMORY;
    t->metadata=m;m+=t->metadataCount++;memset(m,0,sizeof(*m));m->path=SPCopy(key,strlen(key)+1);
    m->beforePresent=ap;m->afterPresent=bp;m->beforeLength=an;m->afterLength=bn;
    if(ap)m->before=SPCopy(a,an);if(bp)m->after=SPCopy(b,bn);
    return !m->path || (ap && !m->before) || (bp && !m->after)?GB_MEMORY:0;
}
static int SPGuardNow(GSRepository *r,const GCTransaction *t){
    unsigned char *p=NULL;size_t i,n=0;GBWord generation;int result=GTNormalWriteAllowed(r);
    if(!result)result=GTNextGeneration(r,&generation);
    if(!result && generation!=t->generation)result=GS_CONFLICT;
    for(i=0;!result && i<t->metadataCount;++i){const GCMetadata *m=t->metadata+i;
        result=r->read(r->context,m->path,&p,&n);
        if(result==GS_NOT_FOUND)result=m->beforePresent?GS_CONFLICT:0;
        else if(!result && (!m->beforePresent || n!=m->beforeLength || (n && (!p || memcmp(p,m->before,n)))))result=GS_CONFLICT;
        free(p);p=NULL;
    }
    return result;
}
static int SPCheckSavedPlan(const WSPlan *saved,const WSRecord *record,const WSLimits *limits,GPEqual eq,void *ctx){
    GCTransaction view=saved->transaction;const GCMetadata *m;WSList before,after;
    unsigned char *a=NULL,*b=NULL;size_t an=0,bn=0;int result;
    WSListInit(&before);WSListInit(&after);
    if(!view.metadataCount || strcmp(view.metadata[view.metadataCount-1].path,WS_LIST_KEY))return GS_FORMAT;
    m=view.metadata+--view.metadataCount;
    result=GCEncode(&view,eq,ctx,&a,&an);if(!result)result=GCEncode(&record->discard,eq,ctx,&b,&bn);
    if(!result && (an!=bn || memcmp(a,b,an)))result=GS_CONFLICT;
    if(!result && (!m->afterPresent || (!m->beforePresent && m->beforeLength)))result=GS_FORMAT;
    if(!result && m->beforePresent)result=WSListParse(m->before,m->beforeLength,limits,&before);
    if(!result)result=WSListParse(m->after,m->afterLength,limits,&after);
    if(!result && (before.count>=limits->entries || after.count!=before.count+1 ||
       memcmp(after.ids[0],saved->oid,20) || (before.count && memcmp(after.ids+1,before.ids,before.count*20))))result=GS_CONFLICT;
    free(a);free(b);WSListFree(&before);WSListFree(&after);return result;
}
static int SPFileSame(const GRSnapshot *a,const GRFile *x,const GRSnapshot *b,const GRFile *y){
    if(!x || !y)return x==y;
    if(x->mode!=y->mode || x->hasFinderInfo!=y->hasFinderInfo || memcmp(a->index.entries[x->entry].oid,b->index.entries[y->entry].oid,20))return 0;
    return !x->hasFinderInfo || !memcmp(a->index.entries[x->metadataEntry].oid,b->index.entries[y->metadataEntry].oid,20);
}
static int SPCommitSnapshot(GSRepository *r,const unsigned char oid[20],const WSLimits *l,GRSnapshot *out){
    unsigned char *p=NULL;size_t n=0;char type[7];GHCommitInfo info;GIReadLimits bounds;int result;
    memset(&bounds,0,sizeof(bounds));bounds.entries=l->files*4;bounds.depth=128;bounds.pathBytes=l->pathBytes;
    result=GSGetObjectLimit(r,oid,type,&p,&n,l->stateBytes);
    if(!result)result=strcmp(type,"commit")?GS_FORMAT:GHCommitParse(p,n,&info);
    if(!result)result=GRFromTreeBounded(r,info.tree,out,&bounds);free(p);return result;
}
static int SPTrackedSelection(const GRSnapshot s[3],const WSRecord *record){
    size_t at[3],i,j,selected=0;const char *path;const GRFile *file[3];
    memset(at,0,sizeof(at));
    for(i=0;i<3;++i)for(j=1;j<s[i].count;++j)if(strcmp(s[i].files[j-1].path,s[i].files[j].path)>=0)return GS_FORMAT;
    while(at[0]<s[0].count || at[1]<s[1].count || at[2]<s[2].count){
        path=NULL;
        for(i=0;i<3;++i)if(at[i]<s[i].count && (!path || strcmp(s[i].files[at[i]].path,path)<0))path=s[i].files[at[i]].path;
        for(i=0;i<3;++i){file[i]=NULL;if(at[i]<s[i].count && !strcmp(s[i].files[at[i]].path,path))file[i]=s[i].files+at[i]++;}
        while(selected<record->pathCount && strcmp(record->paths[selected],path)<0)++selected;
        if(selected<record->pathCount && !strcmp(record->paths[selected],path))continue;
        if(!SPFileSame(s,file[0],s+1,file[1]) || !SPFileSame(s,file[0],s+2,file[2]))return GS_CONFLICT;
    }
    return 0;
}
static int SPFullTracked(GSRepository *r,const WSRecord *record,const WSLimits *l){
    GRSnapshot s[3];size_t i;int result;
    for(i=0;i<3;++i)GRInit(s+i);
    result=SPCommitSnapshot(r,record->base,l,s);if(!result)result=SPCommitSnapshot(r,record->staged,l,s+1);
    if(!result)result=SPCommitSnapshot(r,record->working,l,s+2);
    if(!result)result=SPTrackedSelection(s,record);
    for(i=0;i<3;++i)GRFree(s+i);return result;
}
int SPPrepareStore(GSRepository *source,const WSPlan *saved,const WSLimits *limits,const SLLimits *logLimits,
    const char *identity,const char *seconds,const char *zone,GPEqual eq,void *ctx,SPPlan *out){
    SPPlan next;SPState state;WSRecord record;WSRecord checked;WSList list;GSRepository objects;
    GCMetadata *m;unsigned char *p=NULL,*wire=NULL,*log=NULL,parents[60],ref[52];size_t n=0,wn=0,ln=0,pc=0,bl;
    char key[64],hex[41],*message=NULL,*branch=NULL;int result;
    if(!source || !source->read || !source->replace || !saved || !limits || !logLimits || !identity || !seconds || !zone || !eq || !out)return GB_BAD;
    SPInit(&next);SPStateInit(&state);WSInit(&record);WSInit(&checked);WSListInit(&list);
    objects.context=source;objects.read=SPReadThrough;objects.replace=SPOnlyObjects;
    result=WSOpen(&objects,saved->oid,limits,eq,ctx,&record);
    if(!result && !record.haveBase)result=GI_UNSUPPORTED;
    if(!result)result=SPCheckSavedPlan(saved,&record,limits,eq,ctx);
    if(!result)result=SPFullTracked(&objects,&record,limits);
    if(!result)result=SPGuardNow(source,&saved->transaction);
    if(!result)result=SPRead(source,logLimits,&state);
    if(!result){m=SPMeta(&record.discard,"HEAD");if(!m || !m->beforePresent || m->beforeLength<7)result=GS_FORMAT;
        else {bl=m->beforeLength-6;branch=malloc(bl+1);if(!branch)result=GB_MEMORY;else {memcpy(branch,m->before+5,bl);branch[bl]=0;if(!GSValidRef(branch))result=GS_FORMAT;}}}
    if(!result){bl=strlen(branch+11);if(bl>(size_t)-1/2-64)result=GB_SPACE;
        else {message=malloc(bl*2+48);if(!message)result=GB_MEMORY;else {strcpy(message,"On ");strcat(message,branch+11);strcat(message,": !!GitHub_Desktop<");strcat(message,branch+11);strcat(message,">");}}}
    if(!result){memcpy(parents+pc++*20,record.base,20);memcpy(parents+pc++*20,record.staged,20);if(record.haveUntracked)memcpy(parents+pc++*20,record.untracked,20);
        result=GSWriteCommitObject(&objects,record.aliases.tree,parents,pc,identity,identity,seconds,zone,message,record.working);}
    if(!result)result=WSEncode(&record,limits,eq,ctx,&p,&n);
    if(!result)result=GSPutObject(&objects,"blob",p,n,next.saved);free(p);p=NULL;
    if(!result)result=WSOpen(&objects,next.saved,limits,eq,ctx,&checked);
    if(!result)memcpy(next.working,checked.working,20);
    if(!result)result=GCEncode(&saved->transaction,eq,ctx,&p,&n);
    if(!result && n>limits->stateBytes)result=GB_SPACE;
    if(!result)result=GCParse(p,n,eq,ctx,&next.transaction);free(p);p=NULL;
    if(!result){m=SPMeta(&next.transaction,WS_LIST_KEY);result=WSListParse(m->after,m->afterLength,limits,&list);
        if(!result){memcpy(list.ids[0],next.saved,20);result=WSListEncode(&list,limits,&wire,&wn);}
        if(!result){free(m->after);m->after=wire;m->afterLength=wn;wire=NULL;}}
    if(!result)result=SLAppend(&state.log,state.refPresent?state.tip:NULL,next.working,identity,seconds,zone,message,logLimits,&log,&ln);
    if(!result){memcpy(ref,"refs/stash",11);GBOIDFormat(next.working,hex);memcpy(ref+11,hex,40);ref[51]='\n';result=GSRefKey("refs/stash",key);}
    if(!result)result=SPAdd(&next.transaction,key,state.ref,state.refLength,state.refPresent,ref,52,1);
    if(!result)result=SPAdd(&next.transaction,SP_LOG_KEY,state.logPresent?state.log.bytes:NULL,state.logPresent?state.log.length:0,state.logPresent,log,ln,1);
    if(!result)result=SPGuardNow(source,&next.transaction);
    if(!result)result=GCEncode(&next.transaction,eq,ctx,&p,&n);
    if(!result && n>limits->stateBytes)result=GB_SPACE;
    if(!result){SPFree(out);*out=next;SPInit(&next);}
    free(p);free(wire);free(log);free(branch);free(message);WSListFree(&list);WSFree(&record);WSFree(&checked);SPStateFree(&state);SPFree(&next);return result;
}
