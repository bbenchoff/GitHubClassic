/* Native conflict review. Include after GitCheckoutUI.c and GitMergeCheck.c. */
#define MUI_NO_SESSION 1 /* Only an independently absent marker, never an object error. */
/* Owned by MergeManage for the entire review, including its child panels.
   Never infer the target from gWork: another repository can remain behind it. */
static char gMUIRepository[256];
static UserItemUPP gMUIHeadingArt;
static void MUIRepositoryLabel(const FSSpec *folder,char name[256]) {
    size_t i,n=folder?folder->name[0]:0;unsigned char c;
    if(!n || n>=sizeof(folder->name)){strcpy(name,"(unavailable)");return;}
    for(i=0;i<n;++i){c=folder->name[i+1];name[i]=c<32 || c==127?'?':(char)c;}
    name[n]=0; /* Folder names are native MacRoman, not UTF-8 Git paths. */
}
static pascal void MUIHeadingDraw(DialogPtr dialog,short number) {
    GrafPtr saved;PenState pen;RGBColor foreground;short font,size,kind;Style face;Handle item;Rect r;Str255 p;
    char title[256],subtitle[280];
    GetPort(&saved);SetPort((GrafPtr)dialog);font=((GrafPtr)dialog)->txFont;size=((GrafPtr)dialog)->txSize;face=((GrafPtr)dialog)->txFace;
    GetPenState(&pen);GetForeColor(&foreground);PenNormal();GetDialogItem(dialog,number,&kind,&item,&r);
    GetWTitle((WindowPtr)dialog,p);memcpy(title,p+1,p[0]);title[p[0]]=0;Box(r.left,r.top,r.right,r.bottom,255,255,255);Color(0,0,0);
    DialogHeading(&r,title,"");snprintf(subtitle,sizeof(subtitle),"Repository: %s",gMUIRepository);
    FitText((short)(r.left+46),(short)(r.top+36),subtitle,gGeneva,9,(short)(r.right-r.left-46),64,64,64);
    RGBForeColor(&foreground);SetPenState(&pen);TextFont(font);TextSize(size);TextFace(face);SetPort(saved);
}
static int MUIHeading(DialogPtr dialog,short number) {
    short kind;Handle item;Rect r;
    if(!gMUIRepository[0])return 0;
    if(!gMUIHeadingArt)gMUIHeadingArt=NewUserItemProc(MUIHeadingDraw);
    if(!gMUIHeadingArt)return 0;
    GetDialogItem(dialog,number,&kind,&item,&r);SetDialogItem(dialog,number,kind,(Handle)gMUIHeadingArt,&r);return 1;
}
typedef struct {
    size_t node;
    int chosen;
    TMResolution value;
    TMOutput outputs[2];
    GRContents owned[2];
} MUIChoice;
typedef struct {
    MWSession saved;
    MSValues initial;
    MUIChoice *rows;
    size_t count,selected;
    int dirty,needsRecovery,mustReload;
    const char *previewTitle; /* Non-NULL: borrowed stash plan, local choices only. */
    int replay; /* Borrowed replay plan: rendering only, never merge ownership. */
    size_t replayStep,replayTotal;
    char replayTip[41],replayCandidate[41];
} MUIDraft;
static int MUIResolutionCan(const MUIDraft *,size_t,int);
static const char *MUIResolutionKind(GBWord);
static void MergePaused(void) {
    gRebasePending=0;
    gLocalBlocked=gMergePending=1;gLocalRowCount=gLocalStaged=0;gLocalHistoryCount=0;gLocalSelection=-1;
    if(gCommitField)TEDeactivate(gCommitField==1?gSummaryEdit:gDescriptionEdit);
    gCommitField=0;
    strcpy(gPatch,"This repository has a saved conflict review.\rChoose Branch > Merge or Squash and Merge, or Refresh, to review its conflicts, continue or abort.\r");
    gDiffTop=0;FindReset();DiffScroll();LocalEditState();SetStatus("Conflict review paused. Refresh or choose Branch > Merge or Squash and Merge to resume.");
    InvalRect(&gWindow->portRect);
}
static void MUIInit(MUIDraft *d) {memset(d,0,sizeof(*d));MWSessionInit(&d->saved);MSValuesInit(&d->initial);}
static void MUIFree(MUIDraft *d) {
    size_t i,j;
    if(d->rows)for(i=0;i<d->count;++i)for(j=0;j<2;++j)GRContentsFree(d->rows[i].owned+j);
    free(d->rows);MSValuesFree(&d->initial);MWSessionFree(&d->saved);MUIInit(d);
}
static void MUIStateLimits(MSLimits *l) {l->bytes=4UL*1024*1024;l->choices=l->files=l->paths=8192;l->pathBytes=1024;}
static int MUIRead(void *ctx,const char *key,unsigned char **bytes,size_t *length) {
    return GSMacReadLimit((GSMacStore *)ctx,key,bytes,length,!strncmp(key,"objects/",8)?3UL*1024*1024:4UL*1024*1024);
}
static void MUIReader(GSRepository *r) {r->context=&gUICheckout.store;r->read=MUIRead;r->replace=HistoryNoWrite;}
static int MUIProgress(void *unused) {(void)unused;return CheckoutProgress(NULL,"Reading merge choices");}
static const char *MUIRowPath(const MUIDraft *d,size_t at) {
    if(at>=d->count || d->rows[at].node>=d->saved.review.files.count)return NULL;
    return d->saved.review.files.files[d->rows[at].node].path;
}
static void MUIKeepSelection(MUIDraft *next,const MUIDraft *previous) {
    const char *path=MUIRowPath(previous,previous->selected),*candidate;size_t i;
    next->selected=0;if(!path)return;
    for(i=0;i<next->count;++i) {
        candidate=MUIRowPath(next,i);
        if(candidate && !strcmp(path,candidate)){next->selected=i;break;}
    }
}
static int MUICloseReader(int result) {
    int closed;
    /* GXClose owns held fork handles and the lease. A failed close must keep
       both for retry; do not release the lease before closing those forks. */
    closed=CheckoutRelease();if(!result || (result==MUI_NO_SESSION && closed))result=closed;
    gBusy=0;LocalEditState();return result;
}
static int MUIMissingSession(void) {
    unsigned char *bytes=NULL;size_t length=0;int result,closed=0,entered=0;
    if(!gUICheckout.state)return GS_IO;
    if(gUICheckout.held.haveData || gUICheckout.held.haveResource)return GS_IO;
    result=0;
    if(!gUICheckout.store.leaseHeld){result=GSMacEnter(&gUICheckout.store,1);entered=!result;}
    if(result)return result==GS_NOT_FOUND?GS_IO:result;
    result=MUIRead(&gUICheckout.store,"ghclient-merge",&bytes,&length);free(bytes);
    if(entered)closed=GSMacLeave(&gUICheckout.store);
    if(closed)return closed;
    if(result==GS_NOT_FOUND)return MUI_NO_SESSION;
    return result?result:GS_FORMAT; /* Marker exists: a required object was missing. */
}
static int MUILoad(const FSSpec *folder,MUIDraft *out) {
    MUIDraft next;MMLimits limits;MSLimits sl;GSRepository r;size_t i,j,k;int result;
    MUIInit(&next);NativeMergeLimits(&limits);MUIStateLimits(&sl);
    result=CheckoutAttach(folder);
    if(!result) {CheckoutBegin("Reading the saved merge...");result=GXMergeOpen(&gUICheckout,&limits,&sl,&next.saved);}
    if(!result)result=GSMacEnter(&gUICheckout.store,1);
    if(!result) {MUIReader(&r);result=MSReadChoices(&r,&next.saved.review,&next.saved.state.choices,MUIProgress,NULL,&next.initial);}
    if(result==GS_NOT_FOUND)result=MUIMissingSession();
    result=MUICloseReader(result);
    if(!result) {
        for(i=0;i<next.saved.review.files.count;++i)if(next.saved.review.files.files[i].conflicts)++next.count;
        next.rows=(MUIChoice *)calloc(next.count?next.count:1,sizeof(*next.rows));if(!next.rows)result=GB_MEMORY;
    }
    for(i=k=0;!result && i<next.saved.review.files.count;++i) {
        if(!next.saved.review.files.files[i].conflicts)continue;
        next.rows[k].node=i;next.rows[k].value.node=i;
        for(j=0;j<next.initial.count;++j)if(next.initial.items[j].node==i) {
            next.rows[k].chosen=1;next.rows[k].value=next.initial.items[j];break;
        }
        ++k;
    }
    if(!result){MUIKeepSelection(&next,out);MUIFree(out);*out=next;MUIInit(&next);}MUIFree(&next);return result;
}
static size_t MUIUnchosen(const MUIDraft *d) {
    size_t i,n=0;for(i=0;i<d->count;++i)if(!d->rows[i].chosen)++n;return n;
}
static int MUIVersion(GSRepository *r,const GRSnapshot *snapshot,size_t at,TMOutput *out,GRContents *owned) {
    const GRFile *file;int result;
    if(at==TM_NONE)return GS_NOT_FOUND;
    file=snapshot->files+at;result=GRReadFile(r,snapshot,at,owned);
    if(!result) {
        memset(out,0,sizeof(*out));out->path=file->path;out->file.mode=file->mode;
        out->file.data=owned->data;out->file.dataLength=owned->dataLength;
        out->file.resource=owned->resource;out->file.resourceLength=owned->resourceLength;
        out->file.hasFinderInfo=owned->hasFinderInfo;memcpy(out->file.finderInfo,owned->finderInfo,32);
    }
    return result;
}
static size_t MUIOwnedBytes(const MUIDraft *d) {
    size_t i,j,total=0,n;
    for(i=0;i<d->count;++i)for(j=0;j<2;++j) {
        n=d->rows[i].owned[j].dataLength+d->rows[i].owned[j].resourceLength;
        if(n>(size_t)-1-total)return (size_t)-1;total+=n;
    }
    return total;
}
/* Current/Incoming use original source paths, important for divergent renames.
   Keep Both is available only for distinct paths. Coupled choices stay local
   until Save Choices validates and publishes the complete vector. */
static int MUISet(const FSSpec *folder,MUIDraft *d,size_t at,int action,int *changed) {
    MUIChoice next,*row;TMNode *node;
    GSRepository r;StandardFileReply reply;unsigned char *resource=NULL;size_t rn=0,i,n=0,retained;int side,result=0;
    *changed=0;if(!MUIResolutionCan(d,at,action))return GS_CONFLICT;
    row=d->rows+at;node=d->saved.review.files.files+row->node;
    memset(&next,0,sizeof(next));next.node=row->node;next.value.node=row->node;next.chosen=action!=6;
    if(action==4) {
        StandardGetFile(NULL,-1,NULL,&reply);if(!reply.sfGood || reply.sfIsFolder || reply.sfIsVolume)return 0;
        result=GWReadFileLimit(&reply.sfFile,&next.owned[0].data,&next.owned[0].dataLength,next.owned[0].finderInfo,&resource,&rn,2UL*1024*1024);
        next.owned[0].metadata=resource;next.owned[0].resource=resource;next.owned[0].resourceLength=rn;next.owned[0].hasFinderInfo=1;
        if(!result) {
            next.outputs[0].path=node->path;next.outputs[0].file.mode=0100644;
            if(node->source[1]!=TM_NONE && d->saved.review.files.snapshots[1].files[node->source[1]].mode==0100755)
                next.outputs[0].file.mode=0100755;
            next.outputs[0].file.data=next.owned[0].data;next.outputs[0].file.dataLength=next.owned[0].dataLength;
            next.outputs[0].file.resource=resource;next.outputs[0].file.resourceLength=rn;
            next.outputs[0].file.hasFinderInfo=1;memcpy(next.outputs[0].file.finderInfo,next.owned[0].finderInfo,32);n=1;
        }
    } else if(action<=3) {
        result=CheckoutAttach(folder);
        if(!result){CheckoutBegin("Reading the complete file version...");result=GSMacEnter(&gUICheckout.store,1);}
        if(!result)MUIReader(&r);
        for(side=1;!result && side<=2;++side) {
            if(action!=3 && action!=side)continue;
            if(node->source[side]==TM_NONE)continue;
            result=MUIVersion(&r,d->saved.review.files.snapshots+side,node->source[side],next.outputs+n,next.owned+n);
            if(!result)++n;
        }
        result=MUICloseReader(result);
        if(!result && n==2 && !strcmp(next.outputs[0].path,next.outputs[1].path))result=GS_CONFLICT;
    }
    retained=MUIOwnedBytes(d);
    for(i=0;i<2;++i)retained-=row->owned[i].dataLength+row->owned[i].resourceLength;
    for(i=0;!result && i<n;++i) {
        size_t bytes=next.owned[i].dataLength+next.owned[i].resourceLength;
        if(retained>32UL*1024*1024 || bytes>32UL*1024*1024-retained)result=GB_SPACE;else retained+=bytes;
    }
    if(!result) {
        for(i=0;i<2;++i)GRContentsFree(row->owned+i);
        *row=next;row->value.outputs=row->outputs;row->value.count=n;memset(&next,0,sizeof(next));d->dirty=1;*changed=1;
    }
    for(i=0;i<2;++i)GRContentsFree(next.owned+i);
    if(result)Message("Choose Conflict Version","The complete file could not be selected. Your previous choices are still here. Resource forks and Finder attributes must fit the supported limits.");
    return result;
}
#define MUI_VIEW_ROWS 16
typedef struct {
    DialogPtr dialog;const char *text,*copy,*path,*branch,*other,*original[2];int truncated;
    const GDFile *versions;size_t page,rows;
} MUIView;
static MUIView *gMUIView;
/* Soft wrap display rows without changing the copied preview. Every continued
   addition/deletion retains its +/- gutter, including monochrome displays. */
static size_t MUIWrap(const char *text,size_t at,char line[80],int *style) {
    size_t begin=at,n=0,next;unsigned char c;int column=0,spaces;
    while(begin && text[begin-1]!='\r')--begin;
    *style=text[begin]=='+' && text[begin+1]!='+'?1:text[begin]=='-' && text[begin+1]!='-'?2:
        text[begin]=='@' && text[begin+1]=='@'?3:
        !strncmp(text+begin,"+++",3) || !strncmp(text+begin,"---",3)?4:0;
    if(at==begin && (*style==1 || *style==2))++at;
    while(text[at] && text[at]!='\r' && column<75) {
        c=(unsigned char)text[at];spaces=c=='\t'?8-column%8:1;
        if(column+spaces>75 && n)break;
        if(c=='\t') {while(spaces-- && column<75){line[n++]=' ';++column;}}
        else {line[n++]=c<32?'?':(char)c;++column;}
        ++at;
    }
    line[n]=0;next=at;if(text[next]=='\r')++next;return next;
}
static size_t MUIViewPage(size_t page,size_t rows,short action) {
    size_t last=rows?(rows-1)/MUI_VIEW_ROWS:0;if(page>last)page=last;
    if(action==1 && page)--page;else if(action==2 && page<last)++page;
    else if(action==12)page=0;else if(action==13)page=last;return page;
}
static char *MUIViewCopy(const char *path,const char *current,const char *incoming,const char *rendered,int truncated) {
    size_t a,b,c,n,capacity;char *text;
    const char *note=truncated?"\rPreview reached its display limit; the source files are unchanged.\r":"";
    if(!path || !current || !incoming || !rendered)return NULL;
    a=strlen(path);b=strlen(current);c=strlen(incoming);n=strlen(rendered);
    if(a>8192 || b>8192 || c>8192 || n>=16384)return NULL;
    capacity=a+b+c+n+strlen(note)+strlen(gMUIRepository)+80;text=(char *)malloc(capacity);if(!text)return NULL;
    snprintf(text,capacity,"Repository: %s\rConflict: %s\rCurrent path: %s\rIncoming path: %s\r\r%s%s",gMUIRepository,path,current,incoming,rendered,note);return text;
}
static char *MUIViewDetails(const MUIView *view) {
    char *parts[5],*text=NULL,facts[1100],sides[2][220];size_t i,length=1536;const GDFile *file;
    const char *labels[5]={"Conflict path","Current reference","Incoming reference","Current original path","Incoming original path"};
    const char *values[5];values[0]=view->path;values[1]=view->branch;values[2]=view->other;
    values[3]=view->original[0];values[4]=view->original[1];memset(parts,0,sizeof(parts));
    for(i=0;i<5;++i){parts[i]=ChoiceIdentityDetails(labels[i],values[i]?values[i]:"(unavailable)");if(!parts[i])goto done;length+=strlen(parts[i])+2;}
    for(i=0;i<2;++i) {
        file=view->versions+i;
        if(file->exists)snprintf(sides[i],sizeof(sides[i]),"%s: %s; data %lu bytes; resource %lu bytes; Finder attributes %s.",i?"Incoming":"Current",
            MUIResolutionKind(file->mode),(unsigned long)file->dataLength,(unsigned long)file->resourceLength,file->hasFinderInfo?"included":"absent");
        else snprintf(sides[i],sizeof(sides[i]),"%s: no file exists on this side.",i?"Incoming":"Current");
    }
    snprintf(facts,sizeof(facts),"Repository: %s\r\rImmutable Conflict Versions\r\r%s\r%s\r\rRead-only. This comparison cannot change your draft, working files or saved operation. Copy Preview copies the complete generated preview, including content outside the current page.",gMUIRepository,sides[0],sides[1]);
    text=(char *)malloc(length);if(!text)goto done;strcpy(text,facts);
    for(i=0;i<5;++i){strcat(text,"\r\r");strcat(text,parts[i]);}
done:
    for(i=0;i<5;++i)free(parts[i]);return text;
}
static pascal void MUIViewDraw(DialogPtr dialog,short number) {
    GrafPtr saved;PenState pen;RGBColor foreground;Handle item;Rect r;short kind,font,size;Style face;
    size_t at=0,row=0,first;char line[80],gutter[2];int style;short y;
    char display[256],context[300];const char *branch;
    if(!gMUIView || gMUIView->dialog!=dialog)return;
    GetPort(&saved);SetPort((GrafPtr)dialog);font=((GrafPtr)dialog)->txFont;size=((GrafPtr)dialog)->txSize;face=((GrafPtr)dialog)->txFace;
    GetPenState(&pen);GetForeColor(&foreground);GetDialogItem(dialog,number,&kind,&item,&r);PenNormal();
    Box(r.left,r.top,r.right,r.bottom,255,255,255);Color(0,0,0);
    if(number==8) {
        LocalDisplayPath(gMUIView->path,display);FitText(r.left,r.top+13,display,gGeneva,12,r.right-r.left,0,0,0);
        branch=gMUIView->branch;if(branch && !strncmp(branch,"refs/heads/",11))branch+=11;
        else if(branch && !strncmp(branch,"refs/remotes/",13))branch+=13;
        LocalDisplayPath(branch?branch:"(unavailable)",display);snprintf(context,sizeof(context),"Current (-): %s",display);
        FitText(r.left,r.top+31,context,gGeneva,9,r.right-r.left,39,72,132);
        branch=gMUIView->other;if(branch && !strncmp(branch,"refs/heads/",11))branch+=11;
        else if(branch && !strncmp(branch,"refs/remotes/",13))branch+=13;
        LocalDisplayPath(branch?branch:"(unavailable)",display);snprintf(context,sizeof(context),"Incoming (+): %s",display);
        FitText(r.left,r.top+47,context,gGeneva,9,r.right-r.left,39,72,132);goto done;
    }
    FrameRect(&r);first=gMUIView->page*MUI_VIEW_ROWS;
    while(gMUIView->text[at] && row<first+MUI_VIEW_ROWS) {
        at=MUIWrap(gMUIView->text,at,line,&style);
        if(row>=first) {
            y=(short)(r.top+14+(row-first)*12);gutter[0]=style==1?'+':style==2?'-':' ';gutter[1]=0;
            if(style==1)Box(r.left+1,y-9,r.right-1,y+3,195,235,201);
            else if(style==2)Box(r.left+1,y-9,r.right-1,y+3,244,199,204);
            else if(style==3)Box(r.left+1,y-9,r.right-1,y+3,221,207,240);
            Text((short)(r.left+5),y,gutter,gMonaco,9,0,0,0);
            Text((short)(r.left+20),y,line,gMonaco,9,style==4?39:0,style==4?72:0,style==4?132:0);
        }
        ++row;
    }
done:
    RGBForeColor(&foreground);SetPenState(&pen);TextFont(font);TextSize(size);TextFace(face);SetPort(saved);
}
static pascal Boolean MUIViewFilter(DialogPtr dialog,EventRecord *event,short *hit) {
    unsigned char key;
    if(event->what==keyDown || event->what==autoKey) {
        key=(unsigned char)(event->message&charCodeMask);
        if((event->modifiers&cmdKey) && (key=='c' || key=='C')){*hit=3;return true;}
        if(!(event->modifiers&cmdKey)) {
            if(key==11 || key==30){*hit=1;return true;}
            if(key==12 || key==31){*hit=2;return true;}
            if(key==1 || key==4){*hit=key==1?12:13;return true;}
        }
    }
    return NativeDialogFilter(dialog,event,hit);
}
static void MUIViewText(const char *text,const char *copy,const char *path,const char *branch,const char *other,const char *const original[2],const GDFile *versions,int truncated) {
    MUIView view;DialogPtr dialog;UserItemUPP draw;ModalFilterUPP filter;short hit=0,kind;Handle item;Rect r;
    size_t at=0;char line[80],footer[128],*details;int style;
    if(gDone || gMUIView || !text || !copy || !path || !original || !versions)return;
    memset(&view,0,sizeof(view));view.text=text;view.copy=copy;view.path=path;view.branch=branch;view.other=other;view.versions=versions;view.truncated=truncated;
    view.original[0]=original[0];view.original[1]=original[1];
    while(text[at]){at=MUIWrap(text,at,line,&style);++view.rows;}
    if(!view.rows)view.rows=1;
    dialog=GetNewDialog(151,NULL,(WindowPtr)-1);if(!dialog){Message("Compare Versions","There is not enough memory to open the comparison.");return;}
    draw=NewUserItemProc(MUIViewDraw);filter=NewModalFilterProc(MUIViewFilter);
    if(!draw || !filter || !PrepareDialogChrome(dialog,10,11) || !MUIHeading(dialog,10)) {
        if(draw)DisposeRoutineDescriptor((UniversalProcPtr)draw);
        if(filter)DisposeRoutineDescriptor((UniversalProcPtr)filter);
        DisposeDialog(dialog);SetPort(gWindow);return;
    }
    view.dialog=dialog;gMUIView=&view;GetDialogItem(dialog,5,&kind,&item,&r);SetDialogItem(dialog,5,kind,(Handle)draw,&r);
    GetDialogItem(dialog,8,&kind,&item,&r);SetDialogItem(dialog,8,kind,(Handle)draw,&r);
    DialogText(dialog,6,"- Current    + Incoming    @@ Context    Read-only comparison");PrepareDialog(dialog,4,4);
    SetStatus("Reviewing immutable versions. Pages wrap long lines; Copy includes the full preview.");
    while(!gDone && hit!=4) {
        CheckoutEnable(dialog,1,view.page>0);CheckoutEnable(dialog,2,view.page<(view.rows-1)/MUI_VIEW_ROWS);
        snprintf(footer,sizeof(footer),view.truncated?"Page %lu of %lu. Preview limit reached; original files are unchanged.":
            "Page %lu of %lu. Long lines wrap; Copy Preview includes all pages.",(unsigned long)view.page+1,(unsigned long)((view.rows-1)/MUI_VIEW_ROWS+1));
        DialogText(dialog,7,footer);SetPort((GrafPtr)dialog);DrawDialog(dialog);hit=0;RunModalDialog(filter,&hit);
        if(hit==1 || hit==2 || hit==12 || hit==13)view.page=MUIViewPage(view.page,view.rows,hit);
        else if(hit==3){if(ZeroScrap() || PutScrap((long)strlen(view.copy),'TEXT',view.copy))SysBeep(1);}
        else if(hit==9){details=MUIViewDetails(&view);if(details){Message("Comparison Details",details);free(details);}else SysBeep(1);}
    }
    gMUIView=NULL;DisposeDialog(dialog);DisposeRoutineDescriptor((UniversalProcPtr)draw);DisposeRoutineDescriptor((UniversalProcPtr)filter);SetPort(gWindow);
}
static void MUIFileView(const TMOutput *out,GDFile *file) {
    GDFileInit(file);file->exists=1;file->mode=out->file.mode;
    file->data=(unsigned char *)out->file.data;file->dataLength=out->file.dataLength;
    file->resource=out->file.resource;file->resourceLength=out->file.resourceLength;
    file->hasFinderInfo=out->file.hasFinderInfo;memcpy(file->finderInfo,out->file.finderInfo,32);
}
static void MUICompare(const FSSpec *folder,const MUIDraft *d,size_t at) {
    const TMNode *node=d->saved.review.files.files+d->rows[at].node;GSRepository reader;
    GRContents owned[2];TMOutput versions[2];GDFile views[2];GDResult diff;char *rendered,*text;
    int result,side;char prefix[80],candidate[80];const char *paths[2]={"(absent)","(absent)"};
    for(side=0;side<2;++side){GRContentsInit(owned+side);GDFileInit(views+side);}
    rendered=(char *)malloc(16384);text=NULL;
    if(!rendered){Message("Compare Versions","There is not enough memory to read the comparison. Your choices are unchanged.");return;}
    result=CheckoutAttach(folder);
    if(!result){CheckoutBegin("Comparing immutable file versions... Escape cancels.");result=GSMacEnter(&gUICheckout.store,1);}
    if(!result)MUIReader(&reader);
    for(side=0;!result && side<2;++side)if(node->source[side+1]!=TM_NONE) {
        result=MUIVersion(&reader,d->saved.review.files.snapshots+side+1,node->source[side+1],versions+side,owned+side);
        if(!result){MUIFileView(versions+side,views+side);paths[side]=versions[side].path;}
    }
    if(!result)result=GDPreview(views,views+1,'\r',rendered,16384,MUIProgress,NULL,&diff);
    result=MUICloseReader(result);
    if(!result) {
        text=MUIViewCopy(node->path,paths[0],paths[1],rendered,diff.truncated);
        if(text) {
            snprintf(prefix,sizeof(prefix),"Rebased prefix %s",d->replayTip);snprintf(candidate,sizeof(candidate),"Original commit %s",d->replayCandidate);
            MUIViewText(rendered,text,node->path,d->replay?prefix:d->saved.state.branch,d->replay?candidate:d->saved.state.otherRef,paths,views,diff.truncated);
        }
        else if(!gDone)Message("Compare Versions","The complete contextual preview could not be allocated within its supported limits. Your choices are unchanged.");
    } else if(!gDone)Message("Compare Versions","The immutable file versions could not be read. Your resolution choices are unchanged. Keep the repository intact and reopen the review if its state changed.");
    for(side=0;side<2;++side)GRContentsFree(owned+side);
    free(rendered);free(text);
    if(!gDone)SetStatus("Reviewing conflict. Choose a version or return to the conflict list.");
}
/* One reason catalog serves the compact caption and both complete Details.
   Structural reasons lead so data-fork wording cannot hide a path decision. */
typedef struct {unsigned flag;const char *label,*detail;} MUIReason;
static const MUIReason gMUIReasons[]={
    {TM_DIRECTORY,"File/folder","A file and a directory need the same path. Resolve related entries together before saving."},
    {TM_PATH_COLLISION,"Destination","Several results need overlapping destinations. Choose compatible paths for every related conflict."},
    {TM_RENAME_DIVERGENT,"Divergent rename","The same original file was renamed to different paths. Choose a version or keep both original names when available."},
    {TM_RENAME_DELETE,"Rename/delete","One side renamed a file that the other removed. Keep the renamed version or choose removal."},
    {TM_RENAME_AMBIGUOUS,"Ambiguous rename","Identical contents match several original or added paths. Names are not paired automatically; resolve related entries together."},
    {FM_PRESENCE,"Delete/modify","A file was removed on one side and changed on the other. Choose the existing version or removal."},
    {FM_KIND,"File type","The sides disagree about the file type. Choose a complete regular file or link version."},
    {FM_MODE,"File mode","The sides changed the Git file mode differently. Choose the intended complete version."},
    {FM_GITLINK,"Submodule","Submodule commit IDs differ. Submodule checkout is not implemented; their commits are not downloaded or treated as file data."},
    {FM_DATA,"Data fork","Both sides changed the data fork. Compare the original versions, then choose a complete version or a file from this Macintosh."},
    {FM_RESOURCE,"Resource fork","Both sides changed the resource fork. Choose a complete version; resource forks are never merged as text."},
    {FM_FINDER,"Finder attributes","Both sides changed Finder attributes differently. Choose the complete version with the intended attributes."},
    {FM_METADATA,"Metadata presence","Macintosh metadata was removed on one side and changed on the other. An absent record differs from an empty resource fork."}
};
static int MUIReasonAppend(char *out,size_t capacity,size_t *used,const char *text) {
    size_t n=strlen(text);if(*used>=capacity || n>=capacity-*used)return 0;
    memcpy(out+*used,text,n+1);*used+=n;return 1;
}
static int MUIConflictText(unsigned flags,int full,char *out,size_t capacity) {
    size_t i,used=0;unsigned known=0;int wrote=0;
    if(!out || !capacity)return 0;out[0]=0;
    for(i=0;i<sizeof(gMUIReasons)/sizeof(gMUIReasons[0]);++i) {
        known|=gMUIReasons[i].flag;if(!(flags&gMUIReasons[i].flag))continue;
        if(wrote && !MUIReasonAppend(out,capacity,&used,full?"\r\r":"; "))goto shortBuffer;
        if(!MUIReasonAppend(out,capacity,&used,gMUIReasons[i].label))goto shortBuffer;
        if(full && (!MUIReasonAppend(out,capacity,&used,": ") || !MUIReasonAppend(out,capacity,&used,gMUIReasons[i].detail)))goto shortBuffer;
        wrote=1;
    }
    if(!wrote || (flags&~known)) {
        if(wrote && !MUIReasonAppend(out,capacity,&used,full?"\r\r":"; "))goto shortBuffer;
        if(!MUIReasonAppend(out,capacity,&used,full?"Other conflict: this saved entry needs an explicit compatible choice. Original versions remain available in Details.":"Other conflict"))goto shortBuffer;
    }
    return 1;
shortBuffer:
    out[0]=0;return 0; /* Do not present a silently incomplete reason list. */
}
static const TMNode *MUIResolutionNode(const MUIDraft *d,size_t at) {
    if(at>=d->count || d->rows[at].node>=d->saved.review.files.count)return NULL;
    return d->saved.review.files.files+d->rows[at].node;
}
static const GRFile *MUIResolutionFile(const MUIDraft *d,size_t at,int side) {
    const TMNode *node=MUIResolutionNode(d,at);const GRFile *file;
    if(!node || side<1 || side>2 || node->source[side]>=d->saved.review.files.snapshots[side].count)return NULL;
    file=d->saved.review.files.snapshots[side].files+node->source[side];return file->path && file->path[0]?file:NULL;
}
static const char *MUIResolutionUnavailable(const GRFile *file) {
    if(!file)return NULL;
    if(file->mode==0160000)return "Submodule checkout is not implemented.\rChoose another supported version, Remove File or Leave Unresolved.";
    if(file->mode!=0100644 && file->mode!=0100755 && file->mode!=0120000)
        return "This file kind cannot be checked out.\rChoose another supported version, Remove File or Leave Unresolved.";
    return NULL;
}
static int MUIResolutionCan(const MUIDraft *d,size_t at,int action) {
    const TMNode *node=MUIResolutionNode(d,at);const GRFile *current,*incoming;int side;
    if(!node || !node->path || !node->conflicts || d->needsRecovery || d->mustReload || action<1 || action>6)return 0;
    for(side=1;side<=2;++side)if(node->source[side]!=TM_NONE && !MUIResolutionFile(d,at,side))return 0;
    if(action==1 || action==2)return !MUIResolutionUnavailable(MUIResolutionFile(d,at,action));
    if(action!=3)return 1;
    current=MUIResolutionFile(d,at,1);incoming=MUIResolutionFile(d,at,2);
    return current && incoming && !MUIResolutionUnavailable(current) && !MUIResolutionUnavailable(incoming) && strcmp(current->path,incoming->path)!=0;
}
static const char *MUIResolutionName(int action) {
    static const char *names[]={"Apply Choice","Use Current","Use Incoming","Keep Both","Choose File...","Remove File","Clear Choice"};
    return names[action>=1 && action<=6?action:0];
}
static const char *MUIResolutionKind(GBWord mode) {
    return mode==0100755?"100755 (executable file)":mode==0100644?"100644 (regular file)":
        mode==0120000?"120000 (symbolic link)":mode==0160000?"160000 (submodule)":"unsupported file kind";
}
static const char *MUIResolutionDescription(const MUIDraft *d,size_t at,int action) {
    const GRFile *file;const char *unavailable;
    if(d->needsRecovery)return "Recover the interrupted operation before choosing versions.\rYour previous draft stays available.";
    if(d->mustReload)return "Reload to check the repository before choosing versions.\rYour previous draft stays available.";
    if(MUIResolutionNode(d,at) && (action==1 || action==2)) {
        file=MUIResolutionFile(d,at,action);unavailable=MUIResolutionUnavailable(file);if(unavailable)return unavailable;
    }
    if(action==3 && (MUIResolutionUnavailable(MUIResolutionFile(d,at,1)) || MUIResolutionUnavailable(MUIResolutionFile(d,at,2))))
        return "Keep Both includes a file kind this Mac cannot check out.\rDetails identifies both versions; choose a supported result.";
    if(action==3 && !MUIResolutionCan(d,at,action))
        return "Keep Both requires two different original paths.\rThese versions cannot both occupy the same destination.";
    if(!MUIResolutionCan(d,at,action))return "Select a resolution above. Nothing changes when you select a row.\rCompare and Details are read-only; Cancel keeps your previous choice.";
    if(action==1 || action==2) {
        file=MUIResolutionFile(d,at,action);
        if(file && file->mode==0120000)return "Keep this symbolic link's target bytes and Git link mode.\rThis does not follow or open the link.";
        return file?
        "Use this complete version at its original path.\rBoth forks and Finder attributes are included.":
        (d->previewTitle?"This side has no file here. This choice removes it from the proposal.\rRelated paths must agree before the final Apply or Pop approval.":
        "This side has no file here. Applying resolves this conflict by removal.\rRelated file/folder choices must agree before Save Choices.");
    }
    if(action==3)return d->previewTitle?"Keep both complete versions at their different original paths.\rThe final Apply or Pop plan checks related destinations.":"Keep both complete versions at their different original paths.\rSave Choices checks related paths and destination conflicts.";
    if(action==4)return "Choose a file graphically; both forks and Finder attributes are copied.\rIts contents replace this conflict path. The selected source is unchanged.";
    if(action==5)return d->previewTitle?"Omit this conflict file from the proposed result.\rThe final Apply or Pop plan checks related destinations.":"Omit this conflict file from the result.\rSave Choices checks related file/folder and destination conflicts.";
    return d->previewTitle?"Clear this draft resolution so the conflict needs a choice again.\rThe stash is kept until a final approved Pop completes.":"Clear the draft resolution for this conflict so it needs a choice again.\rThe saved checkpoint remains unchanged until Save Choices.";
}
static char *MUIResolutionDetails(const MUIDraft *d,size_t at,int action) {
    const TMNode *node=MUIResolutionNode(d,at);const GRFile *file;char *parts[5],*text=NULL,*facts=NULL,*reasons=NULL;
    const char *identities[5],*headings[5]={"Conflict path","Current branch","Incoming branch","Current original path","Incoming original path"};
    size_t i,length=4096;int side;char current[180],incoming[180];
    if(!node)return NULL;memset(parts,0,sizeof(parts));
    facts=(char *)malloc(4096);reasons=(char *)malloc(2048);
    if(!facts || !reasons || !MUIConflictText(node->conflicts,1,reasons,2048))goto done;
    identities[0]=node->path;identities[1]=d->replay?d->replayTip:d->saved.state.branch;identities[2]=d->replay?d->replayCandidate:d->saved.state.otherRef;
    if(d->replay){headings[1]="Rebased prefix commit";headings[2]="Original candidate commit";}
    file=MUIResolutionFile(d,at,1);identities[3]=file?file->path:"(absent)";
    file=MUIResolutionFile(d,at,2);identities[4]=file?file->path:"(absent)";
    for(i=0;i<5;++i) {
        parts[i]=ChoiceIdentityDetails(headings[i],identities[i]?identities[i]:"(unavailable)");
        if(!parts[i])goto done;length+=strlen(parts[i])+2;
    }
    for(side=1;side<=2;++side) {
        char *out=side==1?current:incoming;file=MUIResolutionFile(d,at,side);
        if(file)snprintf(out,180,"%s: data %lu bytes; resource %lu bytes; %s; Finder attributes %s.",side==1?(d->replay?"Rebased":"Current"):(d->replay?"Original":"Incoming"),
            (unsigned long)file->dataLength,(unsigned long)file->resourceLength,MUIResolutionKind(file->mode),file->hasFinderInfo?"included":"absent");
        else snprintf(out,180,"%s: absent. Choosing this side resolves the conflict by removal.",side==1?(d->replay?"Rebased":"Current"):(d->replay?"Original":"Incoming"));
    }
    snprintf(facts,4096,"Repository: %s\r\r%s\r\r%s\r\r%s\r%s\r\rDraft: %s%s\r\r%s\r\r%s",
        gMUIRepository,d->replay && action==1?"Use Rebased":d->replay && action==2?"Use Original":MUIResolutionName(action),reasons,current,incoming,!d->rows[at].chosen?"Needs a choice":!d->rows[at].value.count?"Remove file":
        d->rows[at].value.count==2?"Keep both names":"Chosen complete version",d->previewTitle?" (local stash draft)":d->dirty?" (unsaved)":" (saved)",MUIResolutionDescription(d,at,action),
        d->previewTitle?"This window changes only a local draft. Files and staging change only after the final Apply or Pop approval. Cancel discards this draft and keeps the stash.":
        d->replay?"Apply changes only this window's draft. Save Choices records the rebase checkpoint. Continue replays this original commit and later commits, stopping at the next conflict. Original author and message are retained; rewritten commits are unsigned.":
        (d->saved.state.options & MM_SQUASH)?"Apply changes only this window's draft. Save Choices records the checkpoint; Continue creates one squash commit on the current branch.":
        "Apply changes only this window's draft. Save Choices records the checkpoint; Continue completes the merge.");
    text=(char *)malloc(length);if(!text)goto done;strcpy(text,facts);
    for(i=0;i<5;++i){strcat(text,"\r\r");strcat(text,parts[i]);}
done:
    free(facts);free(reasons);for(i=0;i<5;++i)free(parts[i]);return text;
}
/* A separate six-row list keeps the parent conflict list live while a child
   compares versions or opens a graphical file picker. Selection never applies. */
typedef struct {DialogPtr dialog;MUIDraft *draft;size_t at;ListHandle list;int selected;} MUIResolutionView;
static MUIResolutionView *gMUIResolution;
static pascal void MUIResolutionDraw(DialogPtr dialog,short number) {
    MUIResolutionView *view=gMUIResolution;const TMNode *node;const GRFile *file;
    GrafPtr saved;PenState pen;RGBColor foreground;short font,size,kind;Style face;Handle item;Rect r;
    char path[256],line[700],second[256],*split;const char *branch;int side;
    if(!view || view->dialog!=dialog)return;node=MUIResolutionNode(view->draft,view->at);if(!node)return;
    GetPort(&saved);SetPort((GrafPtr)dialog);font=((GrafPtr)dialog)->txFont;size=((GrafPtr)dialog)->txSize;face=((GrafPtr)dialog)->txFace;
    GetPenState(&pen);GetForeColor(&foreground);PenNormal();GetDialogItem(dialog,number,&kind,&item,&r);
    Box(r.left,r.top,r.right,r.bottom,255,255,255);
    if(number==8) {
        Color(0,0,0);FrameRect(&r);TextFont(gGeneva);TextSize(12);TextFace(0);LUpdate(((WindowPtr)dialog)->visRgn,view->list);
    } else if(number==5) {
        LocalDisplayPath(node->path,path);snprintf(line,sizeof(line),"Conflict: %s",path);
        FitText(r.left,r.top+12,line,gGeneva,12,r.right-r.left,0,0,0);
        if(!MUIConflictText(node->conflicts,0,line,sizeof(line)))strcpy(line,"Conflict reasons are available in Details.");
        FitText(r.left,r.top+24,line,gGeneva,9,r.right-r.left,64,64,64);
    } else if(number==6 || number==7) {
        side=number-5;file=MUIResolutionFile(view->draft,view->at,side);
        branch=view->draft->replay?(side==1?view->draft->replayTip:view->draft->replayCandidate):(side==1?view->draft->saved.state.branch:view->draft->saved.state.otherRef);
        if(branch && !strncmp(branch,"refs/heads/",11))branch+=11;else if(branch && !strncmp(branch,"refs/remotes/",13))branch+=13;
        LocalDisplayPath(branch?branch:"(unavailable)",path);snprintf(line,sizeof(line),"%s: %s",side==1?(view->draft->replay?"REBASED":"CURRENT"):(view->draft->replay?"ORIGINAL":"INCOMING"),path);
        FitText(r.left,r.top+11,line,gGeneva,9,r.right-r.left,39,72,132);
        LocalDisplayPath(file?file->path:"(absent - choosing this side removes the file)",path);
        FitText(r.left,r.top+25,path,gGeneva,12,r.right-r.left,0,0,0);
        if(file)snprintf(line,sizeof(line),"%s; data %lu; resource %lu; Finder %s",MUIResolutionKind(file->mode),(unsigned long)file->dataLength,
            (unsigned long)file->resourceLength,file->hasFinderInfo?"included":"absent");
        else strcpy(line,"No version exists on this side.");
        FitText(r.left,r.top+38,line,gGeneva,9,r.right-r.left,64,64,64);
    } else {
        snprintf(line,sizeof(line),"%s",MUIResolutionDescription(view->draft,view->at,view->selected+1));
        split=strchr(line,'\r');second[0]=0;if(split){*split++=0;strncpy(second,split,255);second[255]=0;}
        FitText(r.left,r.top+11,line,gGeneva,9,r.right-r.left,0,0,0);
        FitText(r.left,r.top+25,second,gGeneva,9,r.right-r.left,0,0,0);
        Text(r.left,r.top+43,view->draft->previewTitle?"Local draft only. Final Apply or Pop requires approval.":"Draft only. Save Choices writes the checkpoint.",gGeneva,9,64,64,64);
    }
    RGBForeColor(&foreground);SetPenState(&pen);TextFont(font);TextSize(size);TextFace(face);SetPort(saved);
}
static void MUIResolutionSelect(int selected) {
    MUIResolutionView *view=gMUIResolution;Cell cell;int enabled;
    if(selected < -1 || selected>=6 || selected==view->selected)return;
    SetPort((GrafPtr)view->dialog);cell.h=0;
    if(view->selected>=0){cell.v=(short)view->selected;LSetSelect(false,cell,view->list);}
    view->selected=selected;if(selected>=0){cell.v=(short)selected;LSetSelect(true,cell,view->list);}
    enabled=MUIResolutionCan(view->draft,view->at,selected+1);ChoiceEnable(view->dialog,1,enabled);
    CheckoutButtonTitle(view->dialog,1,view->draft->replay && selected==0?"Use Rebased":view->draft->replay && selected==1?"Use Original":MUIResolutionName(selected+1));
    SetDialogDefaultItem(view->dialog,enabled?1:2);SetWRefCon((WindowPtr)view->dialog,0x47480002L|((long)(enabled?1:2)<<8));
    MUIResolutionDraw(view->dialog,8);MUIResolutionDraw(view->dialog,9);
}
static pascal Boolean MUIResolutionFilter(DialogPtr dialog,EventRecord *event,short *hit) {
    MUIResolutionView *view=gMUIResolution;Point p;Rect r;short kind;Handle item;Cell cell;int next;unsigned char key;
    *hit=0;
    if(event->what==mouseDown) {
        SetPort((GrafPtr)dialog);p=event->where;GlobalToLocal(&p);GetDialogItem(dialog,8,&kind,&item,&r);
        if(PtInRect(p,&r)) {
            TextFont(gGeneva);TextSize(12);TextFace(0);LClick(p,event->modifiers,view->list);cell.h=cell.v=0;
            if(LGetSelect(true,&cell,view->list))MUIResolutionSelect(cell.v);
            return true;
        }
    }
    if((event->what==keyDown || event->what==autoKey) && !(event->modifiers&cmdKey)) {
        key=(unsigned char)(event->message&charCodeMask);next=view->selected;
        if(key==30)next=next<0?0:next>0?next-1:0;
        else if(key==31)next=next<0?0:next<5?next+1:5;
        else if(key==1 || key==11)next=0;
        else if(key==4 || key==12)next=5;
        else return NativeDialogFilter(dialog,event,hit);
        MUIResolutionSelect(next);return true;
    }
    return NativeDialogFilter(dialog,event,hit);
}
static void MUINode(const FSSpec *folder,MUIDraft *d,size_t at) {
    static const char *labels[]={"Current version","Incoming version","Both original names","File from this Macintosh...","Remove file from the result","Leave unresolved"};
    MUIResolutionView view;DialogPtr dialog;UserItemUPP draw;ModalFilterUPP filter;short hit=0,kind,i;Handle item;Rect r,list,data;Point cellSize;Cell cell;char *details;int changed;
    if(gMUIResolution || !MUIResolutionNode(d,at))return;
    memset(&view,0,sizeof(view));view.draft=d;view.at=at;view.selected=-2;
    dialog=GetNewDialog(150,NULL,(WindowPtr)-1);if(!dialog)return;view.dialog=dialog;
    if(d->replay || d->previewTitle || (d->saved.state.options & MM_SQUASH)){Str255 title;Pascal(d->replay?"Resolve Rebase Conflict":d->previewTitle?d->previewTitle:"Squash Conflict",title);SetWTitle((WindowPtr)dialog,title);}
    draw=NewUserItemProc(MUIResolutionDraw);filter=NewModalFilterProc(MUIResolutionFilter);
    if(!draw || !filter || !PrepareDialogChrome(dialog,10,11) || !MUIHeading(dialog,10))goto done;
    SetPort((GrafPtr)dialog);GetDialogItem(dialog,8,&kind,&item,&r);list=r;InsetRect(&list,1,1);
    SetRect(&data,0,0,1,6);cellSize.h=list.right-list.left;cellSize.v=20;TextFont(gGeneva);TextSize(12);TextFace(0);
    view.list=LNew(&list,&data,cellSize,0,(WindowPtr)dialog,false,false,false,false);if(!view.list)goto done;
    (*view.list)->selFlags=lOnlyOne;cell.h=0;
    for(i=0;i<6;++i){const char *label=d->replay && i==0?"Rebased version":d->replay && i==1?"Original commit version":labels[i];cell.v=i;LSetCell(label,(short)strlen(label),cell,view.list);}
    LSetDrawingMode(true,view.list);gMUIResolution=&view;
    for(i=5;i<=9;++i){GetDialogItem(dialog,i,&kind,&item,&r);SetDialogItem(dialog,i,kind,(Handle)draw,&r);}
    PrepareDialog(dialog,2,2);MUIResolutionSelect(-1);DrawDialog(dialog);
    while(!gDone) {
        hit=0;RunModalDialog(filter,&hit);if(gDone || hit==2)break;
        if(hit==1 && MUIResolutionCan(d,at,view.selected+1)) {
            MUISet(folder,d,at,view.selected+1,&changed);if(changed)break;
        } else if(hit==3)MUICompare(folder,d,at);
        else if(hit==4) {
            details=MUIResolutionDetails(d,at,view.selected+1);
            if(details){Message("Conflict Version Details",details);free(details);}else SysBeep(1);
        }
        SetPort((GrafPtr)dialog);InvalRect(&((WindowPtr)dialog)->portRect);
    }
done:
    gMUIResolution=NULL;if(view.list)LDispose(view.list);
    if(draw)DisposeRoutineDescriptor((UniversalProcPtr)draw);if(filter)DisposeRoutineDescriptor((UniversalProcPtr)filter);
    DisposeDialog(dialog);SetPort(gWindow);
}
static int MUISave(const FSSpec *folder,MUIDraft *d) {
    MMLimits limits;MSLimits sl;TMResolution *values;GQError why;size_t i,n=0;int result,installed=0;
    NativeMergeLimits(&limits);MUIStateLimits(&sl);
    values=(TMResolution *)malloc((d->count?d->count:1)*sizeof(*values));if(!values)return GB_MEMORY;
    for(i=0;i<d->count;++i)if(d->rows[i].chosen)values[n++]=d->rows[i].value;
    result=CheckoutAttach(folder);
    if(!result) {
        CheckoutBegin("Saving conflict choices... Escape stops safely.");
        result=GXMergeResolve(&gUICheckout,d->saved.state.original,d->saved.state.originalLength,values,n,&limits,&sl,&why,&installed);
    }
    result=MUICloseReader(result);free(values);
    if(!result && !installed)result=GS_CONFLICT;
    if(result) {
        if(result==GS_IO || result==GC_RECOVERY)d->needsRecovery=1;
        Message("Choices Not Saved","Your choices are still in this window. Related file/folder choices must agree, and new destinations must be clear. If an operation was interrupted, choose Recover Operation, then Reload Saved Choices.");
    }
    return result;
}
static int MUIDiscard(const MUIDraft *d) {
    DialogPtr dialog;short hit=0,kind;Handle item;Rect rightAction;Str255 title;char context[512];
    if(!d->dirty)return 1;
    dialog=GetNewDialog(146,NULL,(WindowPtr)-1);if(!dialog)return 0;
    Pascal("Discard Unsaved Choices",title);SetWTitle((WindowPtr)dialog,title);PrepareDialogChrome(dialog,5,6);
    GetDialogItem(dialog,1,&kind,&item,&rightAction);HideDialogItem(dialog,1);DialogPlaceControl(dialog,2,&rightAction);
    CheckoutButtonTitle(dialog,3,"Discard Choices");
    snprintf(context,sizeof(context),"Repository: %s\rDiscard the unsaved choices in this window? The last saved %s checkpoint will remain on disk.",gMUIRepository,d->replay?"rebase":(d->saved.state.options & MM_SQUASH)?"squash":"merge");
    DialogText(dialog,4,context);PrepareDialog(dialog,2,2);
    while(hit!=2 && hit!=3)RunModalDialog(gDialogFilter,&hit);
    DisposeDialog(dialog);SetPort(gWindow);return hit==3;
}
static void MUIOperationContext(const FSSpec *folder,const char *branch,const char *other,char repository[256],char state[620],OperationPrompt *p) {
    char current[256],incoming[256];
    memcpy(repository,folder->name+1,folder->name[0]);repository[folder->name[0]]=0;p->repository=repository;
    LocalDisplayPath(branch+(GSValidTrackingRef(branch)?13:11),current);
    LocalDisplayPath(other+(GSValidTrackingRef(other)?13:11),incoming);
    snprintf(state,620,"Current: %s\rIncoming: %s",current,incoming);p->state=state;
    p->labels[0]="Current reference";p->values[0]=branch;p->labels[1]="Incoming reference";p->values[1]=other;
}
static int MUIAbortConfirm(const FSSpec *folder,const MUIDraft *d) {
    OperationPrompt prompt;char repository[256],state[620];
    memset(&prompt,0,sizeof(prompt));MUIOperationContext(folder,d->saved.state.branch,d->saved.state.otherRef,repository,state,&prompt);
    prompt.title=(d->saved.state.options & MM_SQUASH)?"Abort Squash":"Abort Merge";prompt.primary=prompt.title;prompt.canPrimary=1;
    prompt.primaryText="Restore the original working files, forks and index. Unrelated changes are kept.";
    prompt.secondaryText=(d->saved.state.options & MM_SQUASH)?"Return to conflict review. The saved squash and your unsaved choices stay available.":
        "Return to conflict review. The saved merge and your unsaved choices stay available.";
    prompt.footer="Unsaved choices are discarded only if Abort succeeds. Unexpected edits to files owned by this operation stop it.";
    return OperationConfirm(&prompt)==1;
}
static int MUIContinueIdentity(const FSSpec *folder,int squash,char identity[256],char message[256]) {
    GSRepository r;unsigned char *bytes=NULL;size_t n=0;int result;char repository[256],prompt[512];
    identity[0]=0;result=CheckoutAttach(folder);
    if(!result)result=GSMacEnter(&gUICheckout.store,1);
    if(!result){MUIReader(&r);result=r.read(r.context,"identity",&bytes,&n);if(result==GS_NOT_FOUND)result=0;}
    if(!result && n && n<256 && !memchr(bytes,0,n)){memcpy(identity,bytes,n);identity[n]=0;}
    free(bytes);result=MUICloseReader(result);if(result)return 0;
    MUIRepositoryLabel(folder,repository);
    snprintf(prompt,sizeof(prompt),"Repository: %s\rChoose the author recorded in this %s commit. This is separate from your GitHub login.",repository,squash?"squash":"merge");
    while(!GSValidIdentity(identity))if(!AskAction(squash?"Squash Commit Author":"Merge Commit Author",prompt,"Use Author",ASK_AUTHOR,identity))return 0;
    snprintf(prompt,sizeof(prompt),"Repository: %s\r%s",repository,squash?
        "Combine the selected changes in one commit on the current branch. Incoming ancestry is not recorded; no empty commit is created.":
        "This completes the saved merge locally. Your selected conflict resolutions will be committed.");
    strcpy(message,squash?"Squash branch":"Merge branch");return AskAction(squash?"Squash Commit":"Merge Commit",prompt,squash?"Commit Squash":"Commit Merge",ASK_MESSAGE,message) && message[0];
}
static int MUIExit(const FSSpec *folder,MUIDraft *d,int action) {
    MMLimits limits;MSLimits sl;GQError why;unsigned char oid[20];char identity[256],message[256],seconds[32];
    unsigned long macTime;long delta;MachineLocation location;int result,finished=0;
    if(action==2 && !MUIAbortConfirm(folder,d))return 0;
    if(action==1 && !MUIContinueIdentity(folder,(d->saved.state.options & MM_SQUASH)!=0,identity,message))return 0;
    NativeMergeLimits(&limits);MUIStateLimits(&sl);result=CheckoutAttach(folder);
    if(!result) {
        CheckoutBegin(action==1?((d->saved.state.options & MM_SQUASH)?"Completing squash... Escape stops safely.":"Completing merge... Escape stops safely."):"Restoring the original files... Escape stops safely.");
        if(action==1) {
            GetDateTime(&macTime);ReadLocation(&location);delta=location.u.gmtDelta & 0x00ffffffL;
            if(delta & 0x00800000L)delta|=0xff000000L;snprintf(seconds,sizeof(seconds),"%lu",macTime-delta-2082844800UL);
            result=GXMergeContinue(&gUICheckout,d->saved.state.original,d->saved.state.originalLength,&limits,&sl,
                identity,identity,seconds,"+0000",message,&why,&finished,oid);
        } else result=GXMergeAbort(&gUICheckout,d->saved.state.original,d->saved.state.originalLength,&limits,&sl,&why,&finished);
    }
    result=MUICloseReader(result);
    if(result) {
        if(result==GS_IO || result==GC_RECOVERY)d->needsRecovery=1;
        Message((d->saved.state.options & MM_SQUASH)?"Squash Paused":"Merge Paused","The operation could not finish. Your choices are still in this window. Unexpected file edits or a changed saved checkpoint can stop the operation. Use Recover Operation after an interruption, then Reload Saved Choices.");
    }
    if(!result && finished && action==1 && (d->saved.state.options & MM_SQUASH))
        SetStatus(!memcmp(oid,d->saved.state.tips,20)?"Squash finished with no net changes. No empty commit created.":"Squash complete. One commit created on the current branch.");
    return !result && finished;
}
#define MUI_REVIEW 1
#define MUI_SAVE 2
#define MUI_CONTINUE 4
#define MUI_ABORT 8
#define MUI_RELOAD 16
#define MUI_RECOVER 32
static unsigned MUIActions(const MUIDraft *d) {
    unsigned actions;
    if(d->needsRecovery)return MUI_RECOVER;
    if(d->mustReload)return MUI_RELOAD;
    actions=MUI_RELOAD|MUI_ABORT;
    if(d->count)actions|=MUI_REVIEW;
    if(d->dirty)actions|=MUI_SAVE;
    else if(!d->saved.drafts.index.unresolved)actions|=MUI_CONTINUE;
    return actions;
}
static const char *MUIChoiceStatus(const MUIChoice *row) {
    return !row->chosen?"Needs a choice":!row->value.count?"Delete":row->value.count==2?"Keep both names":"Chosen version";
}
static int MUIConflictRow(void *context,size_t at,char label[256],char name[256],char info[256]) {
    const MUIDraft *d=(const MUIDraft *)context;const char *path=MUIRowPath(d,at);
    if(!path)return 0;HistoryDisplayName(path,name);
    snprintf(label,256,"%s: %.230s",MUIChoiceStatus(d->rows+at),name);
    snprintf(info,256,"%s%s",MUIChoiceStatus(d->rows+at),d->dirty?"; not saved.":".");return 1;
}
static char *MUIConflictDetails(void *context,size_t at) {
    const MUIDraft *d=(const MUIDraft *)context;const char *path=MUIRowPath(d,at);const TMNode *node;char *heading,*reasons,*identity=NULL,*text=NULL;
    if(!path)return NULL;node=d->saved.review.files.files+d->rows[at].node;
    heading=(char *)malloc(3072);reasons=(char *)malloc(2048);
    if(heading && reasons && MUIConflictText(node->conflicts,1,reasons,2048)) {
        snprintf(heading,3072,"Repository: %s\r\r%s conflict: %s%s\r\r%s\r\rChoices include complete data/resource forks and Finder attributes when present. Related file/folder choices must agree before saving.",
            gMUIRepository,d->replay?"Rebase":(d->saved.state.options & MM_SQUASH)?"Squash":"Merge",MUIChoiceStatus(d->rows+at),d->dirty?" (draft not saved)":"",reasons);
        identity=ChoiceIdentityDetails("Conflict path",path);
        if(identity) {
            text=(char *)malloc(strlen(heading)+strlen(identity)+3);
            if(text){strcpy(text,heading);strcat(text,"\r\r");strcat(text,identity);}
        }
    }
    free(heading);free(reasons);free(identity);return text;
}
static MUIDraft *gMUIActive;
static pascal void MUIContextDraw(DialogPtr dialog,short number) {
    GrafPtr previous;PenState pen;RGBColor foreground;short font,size,kind;Style face;Rect bounds;Handle item;
    char name[256],line[340];const char *first,*second;MUIDraft *d=gMUIActive;size_t remaining;
    if(!d)return;
    GetPort(&previous);SetPort((GrafPtr)dialog);font=((GrafPtr)dialog)->txFont;size=((GrafPtr)dialog)->txSize;face=((GrafPtr)dialog)->txFace;
    GetPenState(&pen);GetForeColor(&foreground);PenNormal();GetDialogItem(dialog,number,&kind,&item,&bounds);
    Box(bounds.left,bounds.top,bounds.right,bounds.bottom,255,255,255);
    if(number==11) {
        LocalDisplayPath(d->saved.state.branch+11,name);snprintf(line,sizeof(line),"%s: %s",d->replay?"Rebasing":"Current",name);
        FitText(bounds.left,(short)(bounds.top+12),line,gGeneva,12,(short)(bounds.right-bounds.left),0,0,0);
        LocalDisplayPath(d->saved.state.otherRef+(GSValidTrackingRef(d->saved.state.otherRef)?13:11),name);
        snprintf(line,sizeof(line),"%s: %s",d->replay?"Onto":"Incoming",name);
        FitText(bounds.left,(short)(bounds.top+28),line,gGeneva,12,(short)(bounds.right-bounds.left),0,0,0);
        remaining=MUIUnchosen(d);
        snprintf(line,sizeof(line),"%lu conflict%s; %lu remaining. %s",(unsigned long)d->count,d->count==1?"":"s",(unsigned long)remaining,
            d->needsRecovery?"Operation interrupted.":d->mustReload?"Reload required.":d->dirty?"Unsaved choices.":"Saved checkpoint.");
        if(d->replay)snprintf(line,sizeof(line),"Commit %lu of %lu; %lu of %lu conflicts need choices. %s",(unsigned long)d->replayStep,(unsigned long)d->replayTotal,
            (unsigned long)remaining,(unsigned long)d->count,d->needsRecovery?"Recover first.":d->mustReload?"Reload required.":d->dirty?"Unsaved.":"Saved.");
        FitText(bounds.left,(short)(bounds.top+44),line,gGeneva,9,(short)(bounds.right-bounds.left),0,0,0);
    } else {
        first=d->needsRecovery?"Recover the interrupted operation before reviewing or saving choices.":
            d->mustReload?"The repository needs to be checked again. Reload before editing choices.":
            d->dirty?"Save Choices records a recoverable checkpoint before Continue.":
            "Select a conflict to compare complete versions, forks and Finder attributes.";
        second=d->needsRecovery?"Your draft choices stay in this window.":d->mustReload?"Reload asks before discarding unsaved choices.":
            d->replay?"Continue replays commits until finished or another conflict. Abort restores the original files.":
            (d->saved.state.options & MM_SQUASH)?"Continue creates one squash commit. Abort restores the original files.":
            "Continue creates the merge commit. Abort restores the original files.";
        FitText(bounds.left,(short)(bounds.top+10),first,gGeneva,9,(short)(bounds.right-bounds.left),0,0,0);
        FitText(bounds.left,(short)(bounds.top+24),second,gGeneva,9,(short)(bounds.right-bounds.left),0,0,0);
    }
    RGBForeColor(&foreground);SetPenState(&pen);TextFont(font);TextSize(size);TextFace(face);SetPort(previous);
}
static void MUIUpdateDialog(DialogPtr dialog,MUIDraft *d) {
    unsigned actions=MUIActions(d);int squash=(d->saved.state.options & MM_SQUASH)!=0;
    gChoiceActionEnabled=(actions&MUI_REVIEW)!=0;ChoiceRefresh(dialog);
    ChoiceEnable(dialog,7,(actions&MUI_SAVE)!=0);ChoiceEnable(dialog,8,(actions&MUI_CONTINUE)!=0);
    ChoiceEnable(dialog,9,(actions&MUI_ABORT)!=0);ChoiceEnable(dialog,13,(actions&MUI_RELOAD)!=0);
    ChoiceEnable(dialog,14,(actions&MUI_RECOVER)!=0);
    if(actions&MUI_RECOVER){HideDialogItem(dialog,13);ShowDialogItem(dialog,14);}
    else {HideDialogItem(dialog,14);ShowDialogItem(dialog,13);}
    MUIContextDraw(dialog,11);MUIContextDraw(dialog,12);
    SetStatus(d->needsRecovery?"Conflict review paused. Recover the interrupted operation; your draft choices are retained.":
        d->mustReload?"Review required. Reload Saved Choices to check the repository; unsaved choices are retained.":
        d->replay?(d->dirty?"Reviewing rebase. Save Choices before Continue; the original author and message are retained.":"Reviewing saved rebase. Rebased is the new prefix; Original is the commit being replayed."):
        d->dirty?(squash?"Reviewing squash. Choices are unsaved; Save Choices records them before Commit Squash.":
        "Reviewing merge. Choices are unsaved; Save Choices records them before Continue."):
        squash?"Reviewing saved squash. Choose a conflict to compare versions or change its resolution.":
        "Reviewing saved merge. Choose a conflict to compare versions or change its resolution.");
}
/* A persistent single-selection list shares the tested picker controller.
   Return reviews the selected conflict; Escape/Command-period close safely. */
static int MUIModal(const FSSpec *folder,MUIDraft *d) {
    const ChoiceItems items={1,2,3,4,5,6,15};NativeChoices choices;
    DialogPtr dialog;UserItemUPP draw;short hit=0,kind;Handle item;Rect bounds;
    dialog=GetNewDialog(149,NULL,(WindowPtr)-1);if(!dialog)return 10;
    if(d->replay){Str255 title;Pascal("Resolve Rebase Conflicts",title);SetWTitle((WindowPtr)dialog,title);
        CheckoutButtonTitle(dialog,8,"Continue Rebase");CheckoutButtonTitle(dialog,9,"Abort Rebase");}
    if(d->saved.state.options & MM_SQUASH){Str255 title;Pascal("Squash Conflicts",title);SetWTitle((WindowPtr)dialog,title);
        CheckoutButtonTitle(dialog,8,"Commit Squash");CheckoutButtonTitle(dialog,9,"Abort Squash");}
    choices.context=d;choices.count=d->count;choices.initial=d->selected;choices.row=MUIConflictRow;choices.details=MUIConflictDetails;
    choices.noun="Conflicts";choices.title=choices.description=choices.action="";
    draw=NewUserItemProc(MUIContextDraw);
    if(!draw || !PrepareDialogChrome(dialog,16,17) || !MUIHeading(dialog,16) || !ChoiceCreate(dialog,&choices,&items,(MUIActions(d)&MUI_REVIEW)!=0)) {
        if(draw)DisposeRoutineDescriptor((UniversalProcPtr)draw);DisposeDialog(dialog);SetPort(gWindow);return 10;
    }
    gMUIActive=d;
    GetDialogItem(dialog,11,&kind,&item,&bounds);SetDialogItem(dialog,11,kind,(Handle)draw,&bounds);
    GetDialogItem(dialog,12,&kind,&item,&bounds);SetDialogItem(dialog,12,kind,(Handle)draw,&bounds);
    PrepareDialog(dialog,1,10);
    if(d->count)ChoiceSelect(dialog,d->selected<d->count?d->selected:0);
    MUIUpdateDialog(dialog,d);SetPort((GrafPtr)dialog);DrawDialog(dialog);
    while(!gDone) {
        hit=0;RunModalDialog(gChoiceFilter,&hit);
        if(gChoiceSelected<d->count)d->selected=gChoiceSelected;
        if(hit==1 && d->selected<d->count && (MUIActions(d)&MUI_REVIEW)) {
            MUINode(folder,d,d->selected);MUIUpdateDialog(dialog,d);InvalRect(&((WindowPtr)dialog)->portRect);
        } else if(hit==5 && gChoiceFirst)ChoiceSelect(dialog,gChoiceFirst-CHOICE_PAGE);
        else if(hit==6 && gChoiceFirst+gChoiceRows<d->count)ChoiceSelect(dialog,gChoiceFirst+CHOICE_PAGE);
        else if(hit==15){ChoiceDetails();SetPort((GrafPtr)dialog);InvalRect(&((WindowPtr)dialog)->portRect);}
        else if(hit>=7 && hit<=14)break;
    }
    ChoiceDispose();gMUIActive=NULL;DisposeRoutineDescriptor((UniversalProcPtr)draw);
    DisposeDialog(dialog);SetPort(gWindow);return gDone?10:hit;
}
/* Returns1 only after the merge no longer exists;0 leaves it safely pending. */
static int MergeManage(const FSSpec *folder) {
    MUIDraft draft;int result,action,done=0;if(gMUIRepository[0])return 0;MUIInit(&draft);
    result=MUILoad(folder,&draft);
    if(result){if(result!=MUI_NO_SESSION)CheckoutError("Read Merge",result);MUIFree(&draft);return result==MUI_NO_SESSION;}
    MUIRepositoryLabel(folder,gMUIRepository);
    for(;;) {
        action=MUIModal(folder,&draft);
        if(action==10){if(MUIDiscard(&draft))break;if(gDone)gDone=0;continue;}
        if(action==7 && draft.dirty && !draft.mustReload && !draft.needsRecovery) {
            if(MUISave(folder,&draft))continue;
        } else if(action==8 && !draft.dirty && !draft.saved.drafts.index.unresolved && !draft.mustReload && !draft.needsRecovery) {
            if(MUIExit(folder,&draft,1)){done=1;break;}continue;
        } else if(action==9 && !draft.mustReload && !draft.needsRecovery) {
            if(MUIExit(folder,&draft,2)){done=1;break;}continue;
        } else if(action==13) {if(!MUIDiscard(&draft))continue;}
        else if(action==14 && draft.needsRecovery) {
            if(CheckoutRecovery(folder)) {
                MUIDraft recovered;MUIInit(&recovered);result=MUILoad(folder,&recovered);
                if(result==MUI_NO_SESSION){MUIFree(&recovered);done=1;break;}
                if(!result) {
                    draft.needsRecovery=0;
                    if(draft.saved.state.originalLength==recovered.saved.state.originalLength &&
                       !memcmp(draft.saved.state.original,recovered.saved.state.original,draft.saved.state.originalLength))draft.mustReload=0;
                    else if(draft.dirty)draft.mustReload=1;
                    else {MUIKeepSelection(&recovered,&draft);MUIFree(&draft);draft=recovered;MUIInit(&recovered);}
                } else {draft.mustReload=1;Message("Read Recovered Merge","Your draft choices are retained. The recovered checkpoint could not be read. Keep the folder intact and try recovery or reload again.");}
                MUIFree(&recovered);
            }
            continue;
        } else continue;
        result=MUILoad(folder,&draft);
        if(result==MUI_NO_SESSION){done=1;break;}
        if(result){draft.mustReload=1;Message("Reload Merge","The saved checkpoint could not be read. Your choices are still here. Keep the repository folder intact and try Recover Operation or Reload Saved Choices.");}
    }
    MUIFree(&draft);gMUIRepository[0]=0;return done;
}
static int MUIBeginConfirm(const FSSpec *folder,const MMPlan *plan) {
    OperationPrompt prompt;char repository[256],state[620],current[41],incoming[41];
    if(plan->kind!=MM_FAST_FORWARD && plan->kind!=MM_CONFLICT && plan->kind!=MM_MERGE)return 0;
    memset(&prompt,0,sizeof(prompt));MUIOperationContext(folder,plan->branch,plan->otherRef,repository,state,&prompt);
    GBOIDFormat(plan->tips,current);GBOIDFormat(plan->tips+20,incoming);
    prompt.labels[2]="Current commit";prompt.values[2]=current;prompt.labels[3]="Incoming commit";prompt.values[3]=incoming;
    prompt.title=(plan->options & MM_SQUASH)?"Squash and Merge":"Merge Branch";
    prompt.primary=(plan->options & MM_SQUASH)?(plan->kind==MM_CONFLICT?"Review Conflicts":"Create Squash"):plan->kind==MM_FAST_FORWARD?"Advance Branch":"Merge Branch";prompt.canPrimary=1;
    prompt.primaryText=(plan->options & MM_SQUASH)?(plan->kind==MM_CONFLICT?
        "Start a saved squash review. Choose complete conflict versions, save them, then Continue to create one commit on the current branch.":
        "Combine incoming changes in one new commit with the current commit as its only parent. Incoming ancestry is not recorded."):
        plan->kind==MM_FAST_FORWARD?"Advance the current branch to the incoming commit. No merge commit is created.":
        plan->kind==MM_CONFLICT?"Start a saved merge review. Conflicting files need explicit choices before a merge commit is created.":
        "Combine both branches in a new merge commit. The original commits remain in history.";
    prompt.secondaryText="Return without starting this operation. Your current branch and working files stay in place.";
    prompt.footer="Local changes that would be replaced stop the operation; unrelated changes are kept.";
    return OperationConfirm(&prompt)==1;
}
static void MergeBranchCommand(int squash) {
    CUIBranches branches;MMLimits limits;MSLimits sl;MMPlan plan;MSChoices none;GSRepository r;GQError why;
    char *chosen=NULL,*branch=NULL,seconds[32],message[768],display[256],identity[256];FSSpec folder;
    unsigned char left[20],right[20],oid[20];unsigned long macTime;long delta;MachineLocation location;
    int result,closed,started=0,advanced=0,performed=0;
    if(!gLocal || gBusy)return;
    HiliteMenu(0);
    if(gMergePending) {
        if(MergeManage(&gWork.folder)){gMergePending=0;LocalRefresh();}else MergePaused();
        return;
    }
    LocalRefresh();if(gLocalBlocked || gDone || !gWork.haveHead)return;
    folder=gWork.folder;result=CUILoadNamed(&branches,1);
    if(result){CUIFree(&branches);CheckoutError("Read Merge Branches",result);return;}
    chosen=CUIPickNamed(&branches,squash?"Squash and Merge":"Merge into Current Branch");
    if(!chosen || gDone){CUIFree(&branches);return;}
    MMInit(&plan);MSChoicesInit(&none);NativeMergeLimits(&limits);MUIStateLimits(&sl);
    result=CheckoutAttach(&folder);
    if(!result){CheckoutBegin("Reviewing selected branches...");result=GSMacEnter(&gUICheckout.store,0);}
    if(!result){MUIReader(&r);result=GSHead(&r,&branch,left);}
    if(!result && (strcmp(branch,gWork.branch) || memcmp(left,gWork.tip,20)))result=GS_CONFLICT;
    if(!result)result=GSReadRef(&r,chosen,right);
    if(gUICheckout.store.leaseHeld){closed=GSMacLeave(&gUICheckout.store);if(!result)result=closed;}
    if(!result)result=GXMergePrepare(&gUICheckout,branch,left,chosen,right,squash?MM_SQUASH:0,'\n',&limits,&plan);
    result=MUICloseReader(result);
    if(result)CheckoutError("Review Merge",result);
    else if(plan.kind==MM_UPTODATE)Message("Already Up to Date","The selected branch is already included in the current branch.");
    else if(plan.kind==MM_MULTIPLE_BASES)Message("Merge Needs More Support","These branches have multiple common ancestors. Recursive merge-base handling is not available yet. Your files and branches have not been changed.");
    else if(plan.kind==MM_UNRELATED)Message("Unrelated Histories","These branches have no common ancestor. This merge needs an explicit unrelated-history policy; it has not been started.");
    else if(!gDone && MUIBeginConfirm(&folder,&plan)) {
        if(plan.kind!=MM_CONFLICT && plan.kind!=MM_FAST_FORWARD) {
            if(squash){if(!MUIContinueIdentity(&folder,1,identity,message))goto cleanup;}
            else if(!LocalAuthor(0))goto cleanup;
        }
        result=CheckoutAttach(&folder);
        if(!result) {
            CheckoutBegin(squash?(plan.kind==MM_CONFLICT?"Saving a recoverable squash review...":"Creating the squash commit..."):
                plan.kind==MM_CONFLICT?"Saving a recoverable merge session...":"Merging the selected branch...");
            performed=1;
            if(plan.kind==MM_CONFLICT) {
                result=MSPlanID(&plan,none.planID);
                if(!result)result=GXMergeBegin(&gUICheckout,&plan,&none,&sl,&why,&started);
            } else {
                GetDateTime(&macTime);ReadLocation(&location);delta=location.u.gmtDelta & 0x00ffffffL;
                if(delta & 0x00800000L)delta|=0xff000000L;
                snprintf(seconds,sizeof(seconds),"%lu",macTime-delta-2082844800UL);
                LocalDisplayPath(chosen+(GSValidTrackingRef(chosen)?13:11),display);
                if(!squash)snprintf(message,sizeof(message),"Merge %.255s",display);
                result=GXMergeApply(&gUICheckout,&plan,squash?identity:gLocalIdentity,squash?identity:gLocalIdentity,seconds,"+0000",message,&why,&advanced,oid);
            }
        }
        result=MUICloseReader(result);
        if(result)CheckoutError("Merge Branch",result);
    }
cleanup:
    free(branch);CUIFree(&branches);MSChoicesFree(&none);MMFree(&plan);
    if(!gDone)LocalRefresh();
    if(!gDone && performed && !result && squash) {
        /* Refresh may run the saved resolver through Continue or Abort before
           returning. Do not overwrite its finished state with a pending claim. */
        if(started){if(gMergePending)SetStatus("Squash paused. Reopen the saved review to resolve conflicts and Commit Squash.");}
        else SetStatus(advanced?"Squash complete. One commit created on the current branch.":"No net changes to squash. No empty commit created.");
    }
}
static void MergeCommand(void){MergeBranchCommand(0);}
static void SquashCommand(void){MergeBranchCommand(1);}
