/* Branch selection and explicit recovery, included after the native menu helpers. */
static GXCheckout gUICheckout; /* Never discard a context whose close failed. */
static int gCheckoutStopped;

static int CheckoutRelease(void) {
    int result = SettingsRelease();
    return result ? result : GXClose(&gUICheckout);
}
static int CheckoutAttach(const FSSpec *folder) {
    int result = CheckoutRelease();
    return result ? result : GXAttach(&gUICheckout, folder);
}
static void CheckoutError(const char *step, int result) {
    char message[768];
    snprintf(message, sizeof(message),
             "%s stopped (error %d).\r\rRefresh the repository before continuing. If recovery "
             "is offered, choose Finish or Undo Operation. Keep the repository folder intact.",
             step, result);
    SetStatus(message);
    if (!gDone)
        Message(step, message);
}
static int CheckoutDialogBody(DialogPtr d, short number, const char *text) {
    Handle item;
    short kind;
    Rect r;
    GetDialogItem(d, number, &kind, &item, &r);
    SetHandleSize(item, (Size)strlen(text));
    if (MemError())
        return GB_MEMORY;
    BlockMoveData(text, *item, (Size)strlen(text));
    return 0;
}
static void CheckoutButtonTitle(DialogPtr d, short number, const char *text) {
    Handle item;
    short kind;
    Rect r;
    Str255 p;
    GetDialogItem(d, number, &kind, &item, &r);
    Pascal(text, p);
    SetControlTitle((ControlHandle)item, p);
}
static void CheckoutEnable(DialogPtr d, short number, int enabled) {
    Handle item;
    short kind;
    Rect r;
    GetDialogItem(d, number, &kind, &item, &r);
    if ((unsigned char)(*(ControlHandle)item)->contrlHilite != (enabled ? 0 : 255))
        HiliteControl((ControlHandle)item, enabled ? 0 : 255);
}
static int CheckoutProgress(void *unused, const char *point) {
    EventRecord e;
    (void)unused;
    (void)point;
    /* Never dispatch ordinary commands while a transaction owns the lease. */
    while (GetNextEvent(everyEvent, &e)) {
        if (e.what == updateEvt && (WindowPtr)e.message == gWindow) {
            BeginUpdate(gWindow);
            Draw();
            EndUpdate(gWindow);
        } else if (e.what == kHighLevelEvent)
            AEProcessAppleEvent(&e);
        else if (e.what == keyDown && (e.message & charCodeMask) == 27)
            gCheckoutStopped = 1;
    }
    return gDone || gCheckoutStopped ? GS_IO : 0;
}
static void CheckoutBegin(const char *message) {
    gBusy = 1;
    gCheckoutStopped = 0;
    HiliteMenu(0);
    SetStatus(message);
    if (gLocal) {
        gLocalBlocked = 1;
        gLocalRowCount = gLocalStaged = 0;
        gLocalHistoryCount = 0;
        gLocalSelection = -1;
        strcpy(gPatch, "Working on the repository. Escape stops at a recoverable checkpoint.\r");
        gDiffTop = 0;
        FindReset(); DiffScroll();
        gDiffLines = 1;
        LocalEditState();
    }
    Draw();
    gUICheckout.checkpoint = CheckoutProgress;
}
static const char *CUIRecoveryPhase(GBWord phase) {
    switch(phase) {
        case 0:return "Saved cleanup is pending.";
        case GC_PREPARE:return "Interrupted while preparing new files.";
        case GC_BACKING_UP:return "Interrupted while securing original files.";
        case GC_INSTALLING:return "Interrupted while installing new files.";
        case GC_METADATA:return "Interrupted while updating repository state.";
        case GC_COMMITTED:return "Operation committed; cleanup is pending.";
        case GC_ROLLBACK_META:return "Undo started; repository state is being restored.";
        case GC_UNINSTALLING:return "Undo started; installed files are being removed.";
        case GC_RESTORING:return "Undo started; original files are being restored.";
        case GC_ROLLED_BACK:return "Original state restored; cleanup is pending.";
    }
    return "The saved operation needs inspection.";
}
static void CUIRecoveryPrompt(const GXPendingInfo *info,const char *repository,char state[256],OperationPrompt *p) {
    memset(p,0,sizeof(*p));p->title="Recover Repository Operation";p->repository=repository;
    snprintf(state,256,"%s\r%lu file change%s; data and resource forks are included.",CUIRecoveryPhase(info->phase),
        (unsigned long)info->fileCount,info->fileCount==1?"":"s");p->state=state;
    p->primary="Finish";p->secondary="Undo Operation";p->canPrimary=info->canFinish;p->canSecondary=info->canRestore;
    p->primaryText=!info->phase?"Complete the saved cleanup without reapplying working files.":
        info->phase==GC_COMMITTED?"Complete cleanup of the committed operation. Later edits to working files are kept.":
        info->phase==GC_ROLLED_BACK?"Complete cleanup of the restored repository. Later edits to working files are kept.":
        !info->canFinish?"Finish is unavailable because Undo has already started. Continue restoring with Undo Operation.":
        "Continue the interrupted operation using its saved files and checkpoint.";
    p->secondaryText=info->canRestore?
        "Restore the state before this interrupted operation. An earlier saved operation may remain afterward.":
        "Undo is unavailable because only cleanup remains. Finish keeps the already committed or restored state.";
    p->footer="Cancel leaves the operation pending. The saved checkpoint and owned files are checked again before recovery.";
}
static int CheckoutRecovery(const FSSpec *folder) {
    GXPendingInfo info;
    OperationPrompt prompt;
    char repository[256],state[256];
    int hit;
    int result, closed;
    result = CheckoutAttach(folder);
    if (!result)
        result = GXPending(&gUICheckout, &info);
    closed = GXClose(&gUICheckout); /* No modal interaction while holding a lease. */
    if (!result)
        result = closed;
    if (result) {
        CheckoutError("Inspect Checkout Recovery", result);
        return 0;
    }
    if (!info.pending)
        return 1;
    memcpy(repository,folder->name+1,folder->name[0]);repository[folder->name[0]]=0;
    CUIRecoveryPrompt(&info,repository,state,&prompt);hit=OperationConfirm(&prompt);
    if (!hit || gDone) {
        SetStatus("Checkout recovery is pending. Choose Repository > Refresh when ready.");
        return 0;
    }
    result = CheckoutAttach(folder);
    if (!result) {
        CheckoutBegin(hit == 2 ? "Restoring the previous repository state... Escape stops safely."
                               : "Finishing checkout recovery... Escape stops safely.");
        result = GXRecoverExpected(&gUICheckout, &info, hit == 2);
        gBusy = 0;
    }
    closed = GXClose(&gUICheckout);
    if (!result)
        result = closed;
    if (result) {
        if (result == GX_RECOVERY_CHANGED) {
            SetStatus("The saved operation changed. Refresh to inspect it before choosing recovery.");
            if(!gDone)Message("Recovery Changed","The saved operation changed while its confirmation was open. No recovery was applied. Refresh the repository to inspect its current state.");
        } else if (gCheckoutStopped)
            SetStatus("Recovery stopped safely. Refresh to continue or restore the checkout.");
        else
            CheckoutError("Checkout Recovery", result);
        return 0;
    }
    SetStatus("Checkout recovery finished. Reading the current repository...");
    return 1;
}

typedef struct {
    char **names;
    size_t count;
    int includeTracking;
} CUIBranches;
static void CUIFree(CUIBranches *b) {
    size_t i;
    for (i = 0; i < b->count; ++i)
        free(b->names[i]);
    free(b->names);
    b->names = NULL;
    b->count = 0;
}
static int CUIHex(const unsigned char *name, size_t length) {
    size_t i;
    if (name[0] != length)
        return 0;
    for (i = 1; i <= length; ++i)
        if (!((name[i] >= '0' && name[i] <= '9') || (name[i] >= 'a' && name[i] <= 'f')))
            return 0;
    return 1;
}
static int CUICollect(CUIBranches *b, long directory, const char *prefix, int depth) {
    CInfoPBRec pb;
    Str31 name;
    long index;
    OSErr error;
    unsigned char *bytes, *end, tip[20], parsed[20];
    size_t length, n;
    char key[64], expected[64], hex[41], *copy, **grown;
    int result;
    for (index = 1; index <= 32767; ++index) {
        memset(&pb, 0, sizeof(pb));
        pb.dirInfo.ioVRefNum = gUICheckout.store.volume;
        pb.dirInfo.ioDrDirID = directory;
        pb.dirInfo.ioFDirIndex = (short)index;
        pb.dirInfo.ioNamePtr = name;
        error = PBGetCatInfoSync(&pb);
        if (error == fnfErr)
            return 0;
        if (error)
            return GS_IO;
        /* Unknown files and legacy lock names are retained and never listed. */
        if (!CUIHex(name, depth == 0 ? 2 : depth == 1 ? 12 : 26))
            continue;
        sprintf(key, "%s/%.*s", prefix, (int)name[0], name + 1);
        if (depth < 2) {
            if (!(pb.dirInfo.ioFlAttrib & 16))
                return GS_FORMAT;
            result = CUICollect(b, pb.dirInfo.ioDrDirID, key, depth + 1);
            if (result)
                return result;
            continue;
        }
        if ((pb.hFileInfo.ioFlAttrib & 16) || pb.hFileInfo.ioFlLgLen < 43 ||
            pb.hFileInfo.ioFlLgLen > 16384)
            return GS_FORMAT;
        result = gUICheckout.raw.read(gUICheckout.raw.context, key, &bytes, &length);
        if (result)
            return result;
        end = (unsigned char *)memchr(bytes, 0, length);
        n = end ? (size_t)(end - bytes) : length;
        result = n + 42 != length || !end ||
                         (!GSValidRef((char *)bytes) && !GSValidTrackingRef((char *)bytes) && strcmp((char *)bytes,"refs/stash"))
                     ? GS_FORMAT : 0;
        if (!result)
            result = GSRefKey((char *)bytes, expected);
        if (!result && strcmp(key, expected))
            result = GS_CONFLICT;
        if (!result) {
            memcpy(hex, end + 1, 40);
            hex[40] = 0;
            result = bytes[length - 1] != '\n' ? GS_FORMAT : GBOIDParse(hex, parsed);
        }
        if (!result)
            result = GSReadRef(&gUICheckout.raw, (char *)bytes, tip);
        if (!result && memcmp(parsed, tip, 20))
            result = GS_CONFLICT;
        /* Stash shares ref storage but is never a checkout/compare choice.
           Validate its identity/hash first, including when tracking is shown. */
        if (!result && (!strcmp((char *)bytes,"refs/stash") ||
            (GSValidTrackingRef((char *)bytes) && !b->includeTracking))) {
            free(bytes);
            continue;
        }
        copy = NULL;
        if (!result) {
            if (b->count >= 4096)
                result = GB_SPACE;
            else {
                copy = (char *)malloc(n + 1);
                if (!copy)
                    result = GB_MEMORY;
                else
                    memcpy(copy, bytes, n + 1);
            }
        }
        free(bytes);
        if (result)
            return result;
        grown = (char **)realloc(b->names, (b->count + 1) * sizeof(*grown));
        if (!grown) {
            free(copy);
            return GB_MEMORY;
        }
        b->names = grown;
        b->names[b->count++] = copy;
        if (index == 32767)
            return GB_SPACE;
    }
    return GB_SPACE;
}
static int CUIOrder(const void *a, const void *b) {
    return strcmp(*(const char *const *)a, *(const char *const *)b);
}
static int CUILoadNamed(CUIBranches *branches, int tracking) {
    FSSpec refs;
    long id;
    int kind, result, closed;
    OSErr error;
    memset(branches, 0, sizeof(*branches));
    branches->includeTracking=tracking;
    result = CheckoutAttach(&gWork.folder);
    if (!result)
        result = GSMacEnter(&gUICheckout.store, 0);
    if (!result)
        result = GFResolve(&gUICheckout.store, "refs", &refs, &kind, &id, &error);
    if (!result && kind == 2)
        result = CUICollect(branches, id, "refs", 0);
    else if (!result && kind)
        result = GS_FORMAT;
    closed = CheckoutRelease();
    if (!result)
        result = closed;
    if (!result && branches->count > 1)
        qsort(branches->names, branches->count, sizeof(*branches->names), CUIOrder);
    return result;
}
static int CUILoad(CUIBranches *branches) {return CUILoadNamed(branches,0);}
/* Keep each List Manager data Handle below its classic signed-short limit.
   The complete validated branch vector remains the authority for selection. */
#define CUI_LIST_PAGE 32
static ListHandle gCUIList;
static CUIBranches *gCUIBranches;
static size_t gCUIFirst,gCUISelected;
static short gCUIRows;
static char gCUISearch[128];
static unsigned long gCUISearchTick;
static int CUISelectable(size_t at) {
    return at<gCUIBranches->count && strcmp(gCUIBranches->names[at],gWork.branch)!=0;
}
static const char *CUIShortName(size_t at) {
    const char *name=gCUIBranches->names[at];
    return name+(GSValidTrackingRef(name)?13:11);
}
static pascal void CUIListDraw(DialogPtr dialog,short number) {
    GrafPtr saved;PenState pen;RGBColor foreground;short font,size,kind;Style face;Rect r;Handle item;char display[256],label[256];
    if(!gCUIList)return;
    GetPort(&saved);SetPort((GrafPtr)dialog);font=((GrafPtr)dialog)->txFont;size=((GrafPtr)dialog)->txSize;face=((GrafPtr)dialog)->txFace;
    GetPenState(&pen);GetForeColor(&foreground);PenNormal();GetDialogItem(dialog,number,&kind,&item,&r);
    if(number==4) {
        LocalDisplayPath(gWork.branch+11,display);snprintf(label,sizeof(label),"Current branch: %.230s",display);
        FitText(r.left,(short)(r.top+14),label,gGeneva,12,(short)(r.right-r.left),0,0,0);
    } else {
        Color(0,0,0);FrameRect(&r);TextFont(gGeneva);TextSize(12);TextFace(0);LUpdate(((WindowPtr)dialog)->visRgn,gCUIList);
    }
    RGBForeColor(&foreground);SetPenState(&pen);TextFont(font);TextSize(size);TextFace(face);SetPort(saved);
}
static void CUIListSelect(DialogPtr dialog,size_t selected) {
    Cell cell;size_t first,at;short rows,i;char display[256],label[256];int changed=selected!=gCUISelected;
    if(selected>=gCUIBranches->count)return;
    SetPort((GrafPtr)dialog);
    first=(selected/CUI_LIST_PAGE)*CUI_LIST_PAGE;
    if(first!=gCUIFirst || !gCUIRows) {
        LSetDrawingMode(false,gCUIList);
        if(gCUIRows)LDelRow(gCUIRows,0,gCUIList);
        rows=(short)(gCUIBranches->count-first>CUI_LIST_PAGE?CUI_LIST_PAGE:gCUIBranches->count-first);
        LAddRow(rows,0,gCUIList);gCUIFirst=first;gCUIRows=rows;
        for(i=0;i<rows;++i) {
            at=first+i;LocalDisplayPath(CUIShortName(at),display);
            snprintf(label,sizeof(label),"%s%.230s",!strcmp(gCUIBranches->names[at],gWork.branch)?"Current: ":
                GSValidTrackingRef(gCUIBranches->names[at])?"Remote: ":"",display);
            cell.h=0;cell.v=i;LSetCell(label,(short)strlen(label),cell,gCUIList);
        }
        LSetDrawingMode(true,gCUIList);changed=1;
    } else if(gCUISelected>=first && gCUISelected<first+(size_t)gCUIRows) {
        cell.h=0;cell.v=(short)(gCUISelected-first);LSetSelect(false,cell,gCUIList);
    }
    gCUISelected=selected;cell.h=0;cell.v=(short)(selected-first);LSetSelect(true,cell,gCUIList);
    if(changed)LAutoScroll(gCUIList); /* Scrolling alone must not snap back. */
    snprintf(label,sizeof(label),"Branches %lu-%lu of %lu\r%s",(unsigned long)(first+1),
        (unsigned long)(first+gCUIRows),(unsigned long)gCUIBranches->count,
        !CUISelectable(selected)?"This is the current branch.":GSValidTrackingRef(gCUIBranches->names[selected])?"Fetched remote branch selected.":"Local branch selected.");
    DialogText(dialog,7,label);CheckoutEnable(dialog,1,CUISelectable(selected));
    CheckoutEnable(dialog,9,first>0);CheckoutEnable(dialog,10,first+gCUIRows<gCUIBranches->count);
    /* Re-enabling List Manager drawing does not repaint replaced page cells. */
    CUIListDraw(dialog,5);
}
static int CUIListPrefix(const char *name,const char *prefix) {
    unsigned char a,b;
    while(*prefix){a=(unsigned char)*name++;b=(unsigned char)*prefix++;if(a>='A' && a<='Z')a+=32;if(b>='A' && b<='Z')b+=32;if(a!=b)return 0;}
    return 1;
}
static pascal Boolean CUIListFilter(DialogPtr dialog,EventRecord *event,short *hit) {
    Point point;Rect r;Handle item;Cell cell;short kind;size_t next=gCUISelected,i,n;unsigned char key;int doubled;
    *hit=0;
    /* Keep the default action consistent after activation, before any gesture. */
    if(event->what==nullEvent || event->what==activateEvt)CheckoutEnable(dialog,1,CUISelectable(gCUISelected));
    if(event->what==mouseDown) {
        SetPort((GrafPtr)dialog);point=event->where;GlobalToLocal(&point);GetDialogItem(dialog,5,&kind,&item,&r);
        if(PtInRect(point,&r)) {
            TextFont(gGeneva);TextSize(12);TextFace(0);doubled=LClick(point,event->modifiers,gCUIList);
            cell.h=cell.v=0;
            if(LGetSelect(true,&cell,gCUIList))CUIListSelect(dialog,gCUIFirst+cell.v);
            if(doubled){if(CUISelectable(gCUISelected))*hit=1;else SysBeep(1);}
            return true;
        }
    }
    if(event->what==keyDown || event->what==autoKey) {
        key=(unsigned char)(event->message&charCodeMask);
        if(!(event->modifiers&cmdKey)) {
            if(key==30)next=next?next-1:0;
            else if(key==31){if(next+1<gCUIBranches->count)++next;}
            else if(key==1)next=0;
            else if(key==4)next=gCUIBranches->count-1;
            else if(key==11)next=next>9?next-9:0;
            else if(key==12)next=gCUIBranches->count-1-next>9?next+9:gCUIBranches->count-1;
            else if((key>=32 && key<=126) || key==8) {
                if((unsigned long)(event->when-gCUISearchTick)>60)gCUISearch[0]=0;
                gCUISearchTick=event->when;n=strlen(gCUISearch);
                if(key==8){if(n)gCUISearch[--n]=0;}
                else if(n+1<sizeof(gCUISearch)){gCUISearch[n++]=(char)key;gCUISearch[n]=0;}
                if(n){for(i=0;i<gCUIBranches->count;++i)if(CUIListPrefix(CUIShortName(i),gCUISearch)){next=i;break;}
                    if(i==gCUIBranches->count)SysBeep(1);}
            } else if((key==13 || key==3) && !CUISelectable(next)){SysBeep(1);return true;}
            else return NativeDialogFilter(dialog,event,hit);
            CUIListSelect(dialog,next);return true;
        }
    }
    return NativeDialogFilter(dialog,event,hit);
}
static void CUIListDetails(void) {
    const unsigned char *p=(const unsigned char *)gCUIBranches->names[gCUISelected];
    char *text,*out;size_t length=strlen((const char *)p);
    /* Reversible byte escapes preserve branch identities unsupported by Geneva.
       Backslash itself cannot occur in a validated Git ref. */
    text=(char *)malloc(length*4+192);if(!text){SysBeep(1);return;}
    strcpy(text,"Full reference (non-ASCII bytes use \\xNN escapes):\r\r");out=text+strlen(text);
    while(*p){if(*p<128)*out++=(char)*p;else {sprintf(out,"\\x%02X",(unsigned)*p);out+=4;}++p;}
    *out=0;Message("Branch Information",text);free(text);
}
static char *CUIPickNamed(CUIBranches *branches,const char *title) {
    DialogPtr d;UserItemUPP draw;ModalFilterUPP filter;Rect bounds,view,data;Point cellSize;
    short kind,hit=0;Handle item;size_t initial=0,i;Str255 ptitle;char *chosen=NULL;
    if(!branches->count)return NULL;
    d=GetNewDialog(141,NULL,(WindowPtr)-1);if(!d)return NULL;
    draw=NewUserItemProc(CUIListDraw);filter=NewModalFilterProc(CUIListFilter);
    gCUIBranches=branches;gCUIRows=0;gCUIFirst=(size_t)-1;gCUISelected=(size_t)-1;gCUISearch[0]=0;gCUISearchTick=0;
    Pascal(title,ptitle);SetWTitle((WindowPtr)d,ptitle);PrepareDialogChrome(d,6,8);
    CheckoutButtonTitle(d,1,!strcmp(title,"Compare to Branch")?"Compare":!strcmp(title,"Merge into Current Branch")?"Merge":(!strcmp(title,"Squash and Merge") || !strcmp(title,"Rebase Current Branch"))?"Choose":"Switch");
    if(branches->includeTracking)DialogText(d,3,!strcmp(title,"Rebase Current Branch")?
        "Choose the branch to replay onto. Local and fetched branches are listed. Nothing changes until the next review.":!strcmp(title,"Squash and Merge")?
        "Choose an incoming branch to combine in one commit on the current branch. Local and fetched remote branches are listed.":!strcmp(title,"Merge into Current Branch")?
        "Choose an incoming branch to merge into the current branch. Local and fetched remote branches are listed.":
        "Choose a branch to compare. Local and fetched remote branches are listed. Staged and working edits are excluded.");
    GetDialogItem(d,5,&kind,&item,&bounds);view=bounds;InsetRect(&view,1,1);view.right-=15;
    SetRect(&data,0,0,1,0);cellSize.h=(short)(view.right-view.left);cellSize.v=20;
    SetPort((GrafPtr)d);TextFont(gGeneva);TextSize(12);TextFace(0);
    gCUIList=LNew(&view,&data,cellSize,0,(WindowPtr)d,false,false,false,true);
    if(!draw || !filter || !gCUIList)goto done;
    (*gCUIList)->selFlags=lOnlyOne;(*gCUIList)->listFlags|=lDoVAutoscroll;
    SetDialogItem(d,5,kind,(Handle)draw,&bounds);
    GetDialogItem(d,4,&kind,&item,&bounds);SetDialogItem(d,4,kind,(Handle)draw,&bounds);
    for(i=0;i<branches->count;++i)if(!strcmp(branches->names[i],gWork.branch)){initial=i;break;}
    PrepareDialog(d,1,2);CUIListSelect(d,initial);DrawDialog(d);
    for(;;) {
        hit=0;RunModalDialog(filter,&hit);
        if(hit==2 || gDone)break;
        if(hit==1 && CUISelectable(gCUISelected)){chosen=branches->names[gCUISelected];break;}
        if(hit==9 && gCUIFirst)CUIListSelect(d,gCUIFirst-CUI_LIST_PAGE);
        if(hit==10 && gCUIFirst+gCUIRows<branches->count)CUIListSelect(d,gCUIFirst+CUI_LIST_PAGE);
        if(hit==11){CUIListDetails();SetPort((GrafPtr)d);InvalRect(&((WindowPtr)d)->portRect);}
    }
done:
    if(gCUIList)LDispose(gCUIList);gCUIList=NULL;gCUIBranches=NULL;gCUIRows=0;
    if(draw)DisposeRoutineDescriptor((UniversalProcPtr)draw);if(filter)DisposeRoutineDescriptor((UniversalProcPtr)filter);
    DisposeDialog(d);SetPort(gWindow);return chosen;
}
static char *CUIPick(CUIBranches *branches) {return CUIPickNamed(branches,"Switch Branch");}
static void CheckoutSwitch(void) {
    CUIBranches branches;
    GQError why;
    char *chosen, display[256], status[256];
    int result, closed;
    if (!gLocal || gBusy)
        return;
    LocalRefresh();
    if (gLocalBlocked || gDone)
        return;
    result = CUILoad(&branches);
    if (result) {
        CUIFree(&branches);
        if (result == GC_RECOVERY)
            LocalRefresh();
        else
            CheckoutError("Read Branches", result);
        return;
    }
    if (!branches.count) {
        CUIFree(&branches);
        Message("Switch Branch",
                "There are no saved branches yet. Make a first commit, then create a branch.");
        return;
    }
    chosen = CUIPick(&branches);
    if (!chosen) {
        CUIFree(&branches);
        return;
    }
    LocalDisplayPath(chosen + 11, display);
    memset(&why, 0, sizeof(why));
    result = CheckoutAttach(&gWork.folder);
    if (!result) {
        CheckoutBegin("Switching branches... Escape stops at a recoverable checkpoint.");
        result = GXBranch(&gUICheckout, chosen, &why);
        gBusy = 0;
    }
    closed = GXClose(&gUICheckout);
    if (!result)
        result = closed;
    CUIFree(&branches);
    if (gDone)
        return;
    if (result) {
        if (why.reason) {
            char path[256], message[768];
            LocalDisplayPath(why.path, path);
            snprintf(
                message, sizeof(message),
                "The branch cannot be switched because it would replace local changes or an "
                "existing file or folder.\r\r%s\r\rCommit or move those changes, then try again.",
                path);
            LocalRefresh();
            Message("Keep Local Changes", message);
        } else {
            if (!gCheckoutStopped && result != GC_RECOVERY)
                CheckoutError("Switch Branch", result);
            LocalRefresh();
        }
        return;
    }
    LocalRefresh();
    if (!gLocalBlocked) {
        snprintf(status, sizeof(status),
                 "Switched to %.180s. Both forks and Macintosh attributes are preserved.", display);
        SetStatus(status);
    }
}
